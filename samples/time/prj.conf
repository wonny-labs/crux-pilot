## CMakeLists.txt
```
# SPDX-License-Identifier: Apache-2.0

cmake_minimum_required(VERSION 3.20.0)
find_package(Zephyr REQUIRED HINTS $ENV{ZEPHYR_BASE})

project(crux_time_sample)

if(NOT CONFIG_CRUX_TIME)
    message(FATAL_ERROR "The Crux Time sample requires CONFIG_CRUX_TIME=y")
endif()

target_sources(app PRIVATE src/main.c src/time_shell.c src/time_command.c)
target_include_directories(app PRIVATE include)
target_link_libraries(app PRIVATE crux::time)
target_compile_options(app PRIVATE -Wall -Wextra -Werror)
```

## prj.conf
```kconfig
CONFIG_STD_C17=y
CONFIG_RTC=y
CONFIG_SHELL=y
CONFIG_SHELL_BACKEND_SERIAL=y
CONFIG_PRINTK=y
CONFIG_LOG=n
```

## boards/mimxrt1060_evk_mimxrt1062_qspi.conf
```kconfig
# The RTC counter wrapper initializes after the SNVS counter (priority 60).
CONFIG_RTC_INIT_PRIORITY=61
```

## src/main.c
```c
#include <crux/status.h>
#include <crux/time.h>

#include <zephyr/sys/printk.h>

int main(void)
{
    const crux_status_t status = crux_realtime_init();

    if (status != CRUX_OK) {
        printk("CRUX_TIME_INIT_FAILED status=%d\n", (int)status);
        return -1;
    }

    printk("Crux Time sample. Use `time help` for commands.\n");
    printk("CRUX_TIME_READY composition=zephyr\n");
    return 0;
}
```

## include/crux_time_command.h
```c
#ifndef CRUX_TIME_COMMAND_H
#define CRUX_TIME_COMMAND_H

#include <crux/status.h>

#ifdef __cplusplus
extern "C" {
#endif

typedef enum crux_time_command_kind {
    CRUX_TIME_COMMAND_LINE,
    CRUX_TIME_COMMAND_HELP,
} crux_time_command_kind_t;

typedef struct crux_time_command_result {
    crux_status_t status;
    crux_time_command_kind_t kind;
    char text[32];
} crux_time_command_result_t;

crux_time_command_result_t crux_time_command_execute(const char *input);
const char *crux_time_command_help_text(void);
const char *crux_time_command_cli_error_text(crux_status_t status);

#ifdef __cplusplus
}
#endif

#endif
```

## src/time_command.c
```c
#include "crux_time_command.h"

#include <crux/time_authority.h>
#include <crux/time_calendar.h>

#include <stdbool.h>
#include <stddef.h>
#include <stdio.h>
#include <string.h>

struct token {
    const char *data;
    size_t size;
};

static bool is_space(char value)
{
    return value == ' ' || value == '\t' || value == '\n' || value == '\r' || value == '\v' ||
           value == '\f';
}

static bool token_equals(struct token value, const char *expected)
{
    const size_t expected_size = strlen(expected);
    return value.size == expected_size && memcmp(value.data, expected, expected_size) == 0;
}

static bool tokenize(const char *input, struct token *tokens, size_t capacity, size_t *count)
{
    const char *cursor = input;
    size_t used = 0;

    while (*cursor != '\0') {
        while (is_space(*cursor)) {
            ++cursor;
        }
        if (*cursor == '\0') {
            break;
        }
        if (used == capacity) {
            return false;
        }
        tokens[used].data = cursor;
        while (*cursor != '\0' && !is_space(*cursor)) {
            ++cursor;
        }
        tokens[used].size = (size_t)(cursor - tokens[used].data);
        ++used;
    }

    *count = used;
    return true;
}

static bool parse_digits(const char *input, size_t count, int32_t *out)
{
    int32_t value = 0;

    for (size_t index = 0; index < count; ++index) {
        const char digit = input[index];
        if (digit < '0' || digit > '9') {
            return false;
        }
        value = (value * 10) + (digit - '0');
    }
    *out = value;
    return true;
}

static bool parse_timestamp(struct token value, crux_datetime_t *out)
{
    if (value.size != 19 || value.data[4] != '-' || value.data[7] != '-' || value.data[10] != 'T' ||
        value.data[13] != ':' || value.data[16] != ':') {
        return false;
    }

    return parse_digits(value.data, 4, &out->year) &&
           parse_digits(value.data + 5, 2, &out->month) &&
           parse_digits(value.data + 8, 2, &out->day) &&
           parse_digits(value.data + 11, 2, &out->hour) &&
           parse_digits(value.data + 14, 2, &out->minute) &&
           parse_digits(value.data + 17, 2, &out->second);
}

static crux_time_command_result_t make_result(crux_status_t status, crux_time_command_kind_t kind,
                                              const char *text)
{
    crux_time_command_result_t value = {0};
    value.status = status;
    value.kind = kind;
    if (text != NULL) {
        const size_t text_size = strlen(text);
        if (text_size >= sizeof(value.text)) {
            value.status = CRUX_ERR_IO;
        } else {
            memcpy(value.text, text, text_size + 1);
        }
    }
    return value;
}

static void write_two_digits(char *output, int32_t value)
{
    output[0] = (char)('0' + (value / 10));
    output[1] = (char)('0' + (value % 10));
}

crux_time_command_result_t crux_time_command_execute(const char *input)
{
    struct token tokens[4] = {0};
    size_t count = 0;

    if (input == NULL) {
        return make_result(CRUX_ERR_INVALID_ARGUMENT, CRUX_TIME_COMMAND_LINE, NULL);
    }
    if (!tokenize(input, tokens, sizeof(tokens) / sizeof(tokens[0]), &count)) {
        return make_result(CRUX_ERR_INVALID_ARGUMENT, CRUX_TIME_COMMAND_LINE, NULL);
    }
    if (count == 1 && token_equals(tokens[0], "help")) {
        return make_result(CRUX_OK, CRUX_TIME_COMMAND_HELP, NULL);
    }
    if (count == 2 && token_equals(tokens[0], "time") && token_equals(tokens[1], "help")) {
        return make_result(CRUX_OK, CRUX_TIME_COMMAND_HELP, NULL);
    }
    if (count < 2 || !token_equals(tokens[0], "time")) {
        return make_result(CRUX_ERR_INVALID_ARGUMENT, CRUX_TIME_COMMAND_LINE, NULL);
    }

    if (count == 2 && token_equals(tokens[1], "get")) {
        crux_realtime_t instant;
        crux_datetime_t calendar;
        crux_status_t status = crux_realtime_now(&instant);
        if (status != CRUX_OK) {
            return make_result(status, CRUX_TIME_COMMAND_LINE, NULL);
        }
        status = crux_realtime_to_utc(instant, &calendar);
        if (status != CRUX_OK) {
            return make_result(status, CRUX_TIME_COMMAND_LINE, NULL);
        }

        crux_time_command_result_t value = {0};
        value.status = CRUX_OK;
        value.kind = CRUX_TIME_COMMAND_LINE;
        value.text[0] = (char)('0' + (calendar.year / 1000));
        value.text[1] = (char)('0' + ((calendar.year / 100) % 10));
        value.text[2] = (char)('0' + ((calendar.year / 10) % 10));
        value.text[3] = (char)('0' + (calendar.year % 10));
        value.text[4] = '-';
        write_two_digits(value.text + 5, calendar.month);
        value.text[7] = '-';
        write_two_digits(value.text + 8, calendar.day);
        value.text[10] = 'T';
        write_two_digits(value.text + 11, calendar.hour);
        value.text[13] = ':';
        write_two_digits(value.text + 14, calendar.minute);
        value.text[16] = ':';
        write_two_digits(value.text + 17, calendar.second);
        memcpy(value.text + 19, " UTC", sizeof(" UTC"));
        return value;
    }

    if (count == 3 && token_equals(tokens[1], "set")) {
        crux_datetime_t calendar = {0};
        crux_realtime_t instant;
        if (!parse_timestamp(tokens[2], &calendar)) {
            return make_result(CRUX_ERR_INVALID_ARGUMENT, CRUX_TIME_COMMAND_LINE, NULL);
        }
        crux_status_t status = crux_realtime_from_utc(&calendar, &instant);
        if (status != CRUX_OK) {
            return make_result(status, CRUX_TIME_COMMAND_LINE, NULL);
        }
        status = crux_realtime_set(&instant, CRUX_REALTIME_SOURCE_MANUAL, false);
        return status == CRUX_OK ? make_result(CRUX_OK, CRUX_TIME_COMMAND_LINE, "OK")
                                 : make_result(status, CRUX_TIME_COMMAND_LINE, NULL);
    }

    return make_result(CRUX_ERR_INVALID_ARGUMENT, CRUX_TIME_COMMAND_LINE, NULL);
}

const char *crux_time_command_help_text(void)
{
    return "Commands:\n"
           "  time set YYYY-MM-DDTHH:MM:SS\n"
           "  time get\n"
           "  help\n"
           "Input is UTC.\n";
}

const char *crux_time_command_cli_error_text(crux_status_t status)
{
    switch (status) {
    case CRUX_OK:
        return "OK";
    case CRUX_ERR_INVALID_ARGUMENT:
        return "ERR INVALID_ARGUMENT";
    case CRUX_ERR_OUT_OF_RANGE:
        return "ERR OUT_OF_RANGE";
    case CRUX_ERR_NOT_READY:
        return "ERR NOT_READY";
    case CRUX_ERR_NO_DATA:
        return "ERR NOT_SET";
    default:
        return "ERR IO_ERROR";
    }
}
```

## src/time_shell.c
```c
#include "crux_time_command.h"

#include <zephyr/shell/shell.h>

#include <stddef.h>
#include <stdio.h>
#include <string.h>

#define COMMAND_CAPACITY 64

static int time_command(const struct shell *shell, size_t argc, char **argv)
{
    char command[COMMAND_CAPACITY] = "time";
    size_t used = sizeof("time") - 1;

    if (argc == 0 || argc > 3 || argv == NULL || argv[0] == NULL || strcmp(argv[0], "time") != 0) {
        shell_print(shell, "ERR INVALID_ARGUMENT");
        return 0;
    }

    for (size_t index = 1; index < argc; ++index) {
        if (argv[index] == NULL) {
            shell_print(shell, "ERR INVALID_ARGUMENT");
            return 0;
        }

        const size_t token_size = strlen(argv[index]);
        if (token_size >= sizeof(command) - used - 1) {
            shell_print(shell, "ERR INVALID_ARGUMENT");
            return 0;
        }

        const int written = snprintf(command + used, sizeof(command) - used, " %s", argv[index]);
        if (written < 0 || (size_t)written >= sizeof(command) - used) {
            shell_print(shell, "ERR INVALID_ARGUMENT");
            return 0;
        }
        used += (size_t)written;
    }

    const crux_time_command_result_t response = crux_time_command_execute(command);
    if (response.kind == CRUX_TIME_COMMAND_HELP && response.status == CRUX_OK) {
        shell_print(shell, "%s", crux_time_command_help_text());
    } else if (response.status == CRUX_OK) {
        shell_print(shell, "%s", response.text);
    } else {
        shell_print(shell, "%s", crux_time_command_cli_error_text(response.status));
    }

    return 0;
}

SHELL_CMD_ARG_REGISTER(time, NULL, "Crux UTC Time commands", time_command, 1,
                       SHELL_OPT_ARG_CHECK_SKIP);
```
