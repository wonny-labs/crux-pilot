## samples/controller/zephyr/Kconfig
```kconfig
mainmenu "Crux reference controller"

source "Kconfig.zephyr"

config CRUX_CONTROLLER_M3
	bool "Build the independent M3 GPIO/health probe"
	default n

config CRUX_M3_TEST_COMMANDS
	bool "Enable development watchdog arm/stall commands"
	depends on CRUX_CONTROLLER_M3 && SHELL
	default n

config CRUX_M3_NETWORK_PROBE
	bool "Build the bounded isolated M3 network probe"
	default n

config CRUX_M3_PHY_DIAGNOSTIC
	bool "Observe PHY and MAC state in a diagnostic-only network image"
	depends on CRUX_M3_NETWORK_PROBE && SOC_MIMXRT1062
	default n

config CRUX_M3_INTEGRATED
	bool "Require bounded network work in the M3 controller"
	depends on CRUX_CONTROLLER_M3 && NETWORKING
	default n

config CRUX_M3_MDIO_COMPLETION_FIX
	bool "Use the pinned reference-only MDIO completion correction"
	depends on SOC_MIMXRT1062 && MDIO_NXP_ENET && !SMP && !ZERO_LATENCY_IRQS
	default n
	help
	  Apply a maintained native driver patch to a generated build copy.
	  A transaction timeout disables further MDIO requests until a fresh boot.
	  This option does not establish physical Ethernet qualification.

config CRUX_M3_MDIO_FAILURE_TRACE
	bool "Retain and observe the first native MDIO wait failure"
	depends on CRUX_M3_MDIO_COMPLETION_FIX && CRUX_M3_PHY_DIAGNOSTIC
	default n
	help
	  Retain a private first-failure record and print it once after app startup.
	  This diagnostic does not alter timeout, IRQ or failed-transaction policy.

config CRUX_M3_DEFERRED_OUTPUT
	bool "Evaluate native deferred UART records in the MDIO diagnostic"
	depends on CRUX_M3_MDIO_FAILURE_TRACE
	depends on LOG_PRINTK && LOG_MODE_DEFERRED && LOG_PROCESS_THREAD
	depends on THREAD_MONITOR && THREAD_NAME
	default n
	help
	  Private diagnostic evaluation only, with bounded native logging resources.
	  This is not an adopted network or integrated-controller output profile.

config CRUX_M3_NATIVE_OUTPUT
	bool "Use bounded native deferred UART output in the M3 reference consumer"
	depends on (CRUX_M3_NETWORK_PROBE || CRUX_M3_INTEGRATED) && !CRUX_M3_PHY_DIAGNOSTIC
	depends on CRUX_M3_MDIO_COMPLETION_FIX && !CRUX_M3_DEFERRED_OUTPUT
	depends on LOG_PRINTK && LOG_MODE_DEFERRED && LOG_PROCESS_THREAD
	depends on THREAD_MONITOR && THREAD_NAME
	default n
	help
	  Sample-only composition with explicit logger resources and loss checks.
	  Physical Ethernet qualification remains a separate requirement.
```

## samples/controller/zephyr/testcase.yaml
```yaml
tests:
  crux.controller.functional_pytest:
    platform_allow:
      - native_sim/native/64
    harness: pytest
    harness_config:
      pytest_root:
        - pytest/test_controller.py
    tags:
      - crux
      - controller
      - pytest
    timeout: 30
```

## samples/flash_target_candidate/dts/bindings/misc/crux,candidate-storage-proxy.yaml
```yaml
description: Private compile-only maintenance owner for the RT1060 storage experiment
compatible: "crux,candidate-storage-proxy"
include: base.yaml
```

## samples/rom_observation_diagnostic/Kconfig
```kconfig
mainmenu "Private ROM observation diagnostic"
source "Kconfig.zephyr"
config CRUX_PRIVATE_ROM_OBSERVATION
    bool
    default y
    select MEMC_MCUX_FLEXSPI
```

## samples/storage_emmc/Kconfig
```kconfig
# SPDX-License-Identifier: Apache-2.0
mainmenu "Crux eMMC composition"

config SAMPLE_EMMC_DISK_NAME
	string "Disk name of the eMMC"
	default "MMC"
	help
	  The disk_access name that emmc_storage.c initialises and mounts. The mount point stays
	  /MMC:, so the name can differ without changing the paths that the File component sees.

config SAMPLE_EMMC_START
	bool "Run the eMMC mount sequence at boot"
	help
	  Off by default. When on, the image initialises the disk and mounts the volume without
	  formatting it. Physical use needs approval for the current task.

source "Kconfig.zephyr"
```

## samples/storage_reliance_sd/Kconfig
```kconfig
# SPDX-License-Identifier: Apache-2.0
mainmenu "Crux Reliance Edge microSD Stage A images"

config SAMPLE_EMMC_DISK_NAME
	string "Disk name of the microSD card"
	default "SD"
	help
	  The disk_access name that emmc_storage.c initialises and mounts. The mount point stays
	  /MMC:, so the name differs without changing the paths that the File component sees. The
	  EVKB's microSD slot is the disk "SD".

config SAMPLE_EMMC_START
	bool "Run the mount sequence at boot"
	depends on !SAMPLE_RELIANCE_SD_APPEND_TEST && !SAMPLE_RELIANCE_SD_REPLACE_TEST
	help
	  Off by default. When on, the image initialises the disk and mounts the volume without
	  formatting it (the mount-check image). It reads the card and does not write the volume.
	  Physical use needs approval for the current task.

config SAMPLE_RELIANCE_SD_APPEND_TEST
	bool "Run the interrupted-write test at boot"
	help
	  Off by default. When on, the image mounts the volume without formatting it, reports what the
	  previous boot's run file holds, then appends and syncs records until power is cut. This
	  WRITES to the card and is meant to be interrupted; physical use needs approval for the
	  current task.

config SAMPLE_RELIANCE_SD_REPLACE_TEST
	bool "Run the replace-pattern test at boot"
	depends on !SAMPLE_RELIANCE_SD_APPEND_TEST
	help
	  Off by default. When on, the image mounts the volume without formatting it, classifies the
	  settings files that a previous power cut left behind, then replaces "cfg" through "cfg.cmp"
	  and fs_rename in a loop until power is cut. This WRITES to the card and is meant to be
	  interrupted; physical use needs approval for the current task.

config SAMPLE_RELIANCE_SD_FORMAT
	bool "Format the card once at boot (format image)"
	depends on !SAMPLE_RELIANCE_SD_APPEND_TEST && !SAMPLE_RELIANCE_SD_REPLACE_TEST && \
		   !SAMPLE_EMMC_START
	select FILE_SYSTEM_MKFS
	select CRUX_FS_RELIANCE_EDGE_FORMAT
	help
	  Off by default. When on, the image is the format image: it has its own main, compiles the
	  Reliance Edge formatter and no other scenario's source, tries to mount first, and formats the
	  card and creates /MMC:/files and /MMC:/settings only if that mount failed. A card on which a
	  volume mounts is left as it is, but a volume that fails to mount (an I/O error, damage) is
	  formatted, so use only a card that the test owns. It excludes the other three options. This
	  WRITES to the card; physical use needs approval for the current task.

# The reused main.c files of samples/storage_sd_interrupt and samples/storage_sd_replace test these
# names. They follow the two options above and are not set on their own.
config SAMPLE_SD_INTERRUPT_TEST
	bool
	default y if SAMPLE_RELIANCE_SD_APPEND_TEST

config SAMPLE_SD_REPLACE_TEST
	bool
	default y if SAMPLE_RELIANCE_SD_REPLACE_TEST

# The simulator's options exist for the native_sim rehearsal only: the symbols depend on
# BOARD_NATIVE_SIM and are inert on the RT1060.
rsource "../../tests/support/emmc_sim/Kconfig"

source "Kconfig.zephyr"
```

## samples/storage_sd/Kconfig
```kconfig
# SPDX-License-Identifier: Apache-2.0
mainmenu "Crux microSD composition"

config SAMPLE_SD_START
	bool "Run the microSD mount sequence at boot"
	help
	  Off by default. When on, the image initialises the SD disk and mounts the card without
	  formatting it. Physical use needs approval for the current task.

config SAMPLE_SD_FILE_CHECK
	bool "Write and verify files on the card after the mount"
	depends on SAMPLE_SD_START
	help
	  Off by default. Advances a boot counter file and verifies a fixed pattern file through
	  crux_file_*, so a restart shows what the previous boot left on the card. This WRITES to the
	  card; physical use needs approval for the current task.

config SAMPLE_SD_FILE_OPS
	bool "Create, seek in and remove a scratch file after the mount"
	depends on SAMPLE_SD_START
	help
	  Off by default. Writes a 256-byte scratch file, seeks and reads inside it, removes it and
	  checks that it is gone, all through crux_file_*. This WRITES to the card; physical use needs
	  approval for the current task.

source "Kconfig.zephyr"
```

## samples/storage_sd/testcase.yaml
```yaml
sample:
  name: Crux microSD composition (link only)
common:
  build_only: true
  platform_allow: [mimxrt1060_evk@B/mimxrt1062/qspi]
  tags: [filesystem, crux, link_only]
tests:
  crux.sample.storage_sd:
    extra_args: []
  crux.sample.storage_sd.start:
    extra_configs:
      - CONFIG_SAMPLE_SD_START=y
```

## samples/storage_sd_interrupt/Kconfig
```kconfig
# SPDX-License-Identifier: Apache-2.0
mainmenu "Crux microSD interrupted-write test"

config SAMPLE_SD_INTERRUPT_TEST
	bool "Run the interrupted-write test at boot"
	help
	  Off by default. When on, the image mounts the card without formatting it, reports what the
	  previous boot's run file holds, then appends and syncs records until power is cut. This WRITES
	  to the card and is meant to be interrupted; physical use needs approval for the current task.

source "Kconfig.zephyr"
```

## samples/storage_sd_interrupt/testcase.yaml
```yaml
sample:
  name: Crux microSD interrupted-write test (link only)
common:
  build_only: true
  platform_allow: [mimxrt1060_evk@B/mimxrt1062/qspi]
  tags: [filesystem, crux, link_only]
tests:
  crux.sample.storage_sd_interrupt:
    extra_args: []
  crux.sample.storage_sd_interrupt.test:
    extra_configs:
      - CONFIG_SAMPLE_SD_INTERRUPT_TEST=y
```

## samples/storage_sd_probe/Kconfig
```kconfig
# SPDX-License-Identifier: Apache-2.0
mainmenu "Crux microSD physical-gate probes"

choice SAMPLE_SD_PROBE_MODE
	prompt "Probe to run at boot"
	default SAMPLE_SD_PROBE_NONE
	help
	  Both probes write to the card; physical use needs approval for the current task.

config SAMPLE_SD_PROBE_NONE
	bool "None (the image touches no card)"

config SAMPLE_SD_STACK_PROBE
	bool "Stack-use probe"
	help
	  Mounts the card without formatting it, runs the file check and a workload that exercises the
	  deepest FatFs paths, then prints the Zephyr thread analyzer report (stack size and unused
	  bytes per thread, and an ISR line for the interrupt stack, which includes early boot).

config SAMPLE_SD_REMOVAL_PROBE
	bool "Card-removal probe"
	help
	  Mounts the card without formatting it and keeps writing one small file, printing the result
	  codes of every failing step (successful steps print every 25th time). After the first failure it unmounts and retries a remount until the volume returns, so a
	  removal and reinsertion shows whether recovery needs a reboot.

endchoice

source "Kconfig.zephyr"
```

## samples/storage_sd_probe/testcase.yaml
```yaml
sample:
  name: Crux microSD physical-gate probes (link only)
common:
  build_only: true
  platform_allow: [mimxrt1060_evk@B/mimxrt1062/qspi]
  tags: [filesystem, crux, link_only]
tests:
  crux.sample.storage_sd_probe:
    extra_args: []
  crux.sample.storage_sd_probe.stack:
    extra_configs:
      - CONFIG_SAMPLE_SD_STACK_PROBE=y
  crux.sample.storage_sd_probe.removal:
    extra_configs:
      - CONFIG_SAMPLE_SD_REMOVAL_PROBE=y
```

## samples/storage_sd_replace/Kconfig
```kconfig
# SPDX-License-Identifier: Apache-2.0
mainmenu "Crux microSD replace-pattern power-cut test"

config SAMPLE_SD_REPLACE_TEST
	bool "Run the replace-pattern test at boot"
	help
	  Off by default. When on, the image mounts the card without formatting it, classifies the
	  settings files a previous power cut left behind, then replaces "cfg" through "cfg.cmp" and
	  fs_rename in a loop until power is cut. This WRITES to the card and is meant to be
	  interrupted; physical use needs approval for the current task.

source "Kconfig.zephyr"
```

## samples/storage_sd_replace/testcase.yaml
```yaml
sample:
  name: Crux microSD replace-pattern power-cut test (link only)
common:
  build_only: true
  platform_allow: [mimxrt1060_evk@B/mimxrt1062/qspi]
  tags: [filesystem, crux, link_only]
tests:
  crux.sample.storage_sd_replace:
    extra_args: []
  crux.sample.storage_sd_replace.test:
    extra_configs:
      - CONFIG_SAMPLE_SD_REPLACE_TEST=y
```

## tests/configuration/zephyr/testcase.yaml
```yaml
tests:
  crux.configuration.software:
    tags: configuration
    platform_allow: native_sim/native/64
    integration_platforms:
      - native_sim/native/64
```

## tests/controller_integrated/testcase.yaml
```yaml
tests:
  crux.controller.integrated.composition:
    platform_allow:
      - native_sim/native/64
    tags:
      - controller
      - network
    timeout: 30
```

## tests/controller_m3/testcase.yaml
```yaml
common:
  harness: ztest
  platform_allow:
    - native_sim/native/64
  integration_platforms:
    - native_sim/native/64
  tags:
    - crux
    - gpio
    - health
tests:
  crux.m3.gpio_health:
    extra_args:
      - DTC_OVERLAY_FILE=boards/native_sim.overlay
      - M3_GPIO_SCENARIO=emulated
  crux.m3.missing_gpio:
    extra_args:
      - DTC_OVERLAY_FILE=boards/native_sim.overlay
      - M3_GPIO_SCENARIO=missing
      - EXTRA_DTC_OVERLAY_FILE=boards/missing_button.overlay
  crux.m3.read_error:
    extra_args:
      - DTC_OVERLAY_FILE=boards/native_sim.overlay
      - M3_GPIO_SCENARIO=fault
      - EXTRA_DTC_OVERLAY_FILE=boards/fault_gpio.overlay
```

## tests/controller_network/testcase.yaml
```yaml
tests:
  crux.controller.network:
    platform_allow:
      - native_sim/native/64
    tags:
      - controller
      - network
    timeout: 60
```

## tests/controller_network_stack/testcase.yaml
```yaml
tests:
  crux.controller.network_stack:
    platform_allow:
      - native_sim/native/64
    tags:
      - controller
      - network
    timeout: 90
```
