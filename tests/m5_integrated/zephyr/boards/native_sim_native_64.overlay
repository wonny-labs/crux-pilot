/ {
    chosen { zephyr,log-uart = &m5_logging_uarts; };
    m5_logging_uarts: m5-logging-uarts {
        compatible = "zephyr,log-uart";
        uarts = <&m5_logging_uart>;
    };
    m5_logging_uart: m5-logging-uart {
        compatible = "zephyr,uart-emul";
        current-speed = <115200>;
        rx-fifo-size = <16>;
        tx-fifo-size = <1024>;
        status = "okay";
    };
};
