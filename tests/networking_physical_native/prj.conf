## CMakeLists.txt
```
cmake_minimum_required(VERSION 3.20.0)
find_package(Zephyr REQUIRED HINTS $ENV{ZEPHYR_BASE})
project(m5_fixture_native LANGUAGES C)
target_sources(app PRIVATE src/main.c ../networking_physical/fixture.c ../networking_physical/frame.c ../networking_physical/transaction.c)
target_include_directories(app PRIVATE ../networking_physical)
target_link_libraries(app PRIVATE crux::sockets crux::netif)
target_compile_definitions(app PRIVATE M5_PEER="127.0.0.1")
target_compile_options(app PRIVATE -Wall -Wextra -Werror)
```

## prj.conf
```kconfig
CONFIG_ZTEST=y
CONFIG_STD_C17=y
CONFIG_NETWORKING=y
CONFIG_NET_IPV4=y
CONFIG_NET_IPV6=n
CONFIG_NET_TCP=y
CONFIG_NET_UDP=y
CONFIG_NET_SOCKETS=y
CONFIG_NET_DRIVERS=y
CONFIG_NET_LOOPBACK=y
CONFIG_POSIX_SYSTEM_INTERFACES=y
CONFIG_POSIX_NETWORKING=y
CONFIG_POSIX_DEVICE_IO=y
CONFIG_POSIX_FD_MGMT=y
CONFIG_POSIX_TIMERS=y
CONFIG_POSIX_MONOTONIC_CLOCK=y
CONFIG_CRUX_SOCKETS=y
CONFIG_CRUX_NETIF=y
CONFIG_TEST_RANDOM_GENERATOR=y
CONFIG_NET_BUF_POOL_USAGE=y
CONFIG_MAIN_STACK_SIZE=4096
CONFIG_ZTEST_STACK_SIZE=4096
CONFIG_NET_MAX_CONTEXTS=4
CONFIG_NET_MAX_CONN=4
CONFIG_NET_PKT_RX_COUNT=16
CONFIG_NET_PKT_TX_COUNT=16
CONFIG_NET_BUF_RX_COUNT=32
CONFIG_NET_BUF_TX_COUNT=32
# Force an embedded libc: native libc would bypass Zephyr POSIX/socket providers.
CONFIG_PICOLIBC=y
CONFIG_INIT_STACKS=y
CONFIG_THREAD_STACK_INFO=y
CONFIG_PRINTK_SYNC=y
```

## src/main.c
```c
#include "fixture.h"
#include "frame.h"
#include <errno.h>
#include <netinet/in.h>
#include <sys/socket.h>
#include <unistd.h>
#include <zephyr/net/net_if.h>
#include <zephyr/ztest.h>
static struct k_thread peer;
K_THREAD_STACK_DEFINE(peer_stack, 2048);
K_SEM_DEFINE(ready, 0, 1);
static int kind, behavior;
static void serve(void *a, void *b, void *c)
{
    ARG_UNUSED(a);
    ARG_UNUSED(b);
    ARG_UNUSED(c);
    int fd = socket(AF_INET, kind, 0);
    zassert_true(fd >= 0);
    struct sockaddr_in local = {
        .sin_family = AF_INET, .sin_port = htons(42422), .sin_addr.s_addr = htonl(0x7f000001U)};
    zassert_equal(bind(fd, (struct sockaddr *)&local, sizeof(local)), 0);
    if (kind == SOCK_STREAM)
        zassert_equal(listen(fd, 1), 0);
    k_sem_give(&ready);
    int stream = kind == SOCK_STREAM ? accept(fd, NULL, NULL) : fd;
    zassert_true(stream >= 0);
    uint8_t frame[32];
    struct sockaddr_in source;
    socklen_t length = sizeof(source);
    if (kind == SOCK_STREAM) {
        size_t used = 0;
        while (used < sizeof(frame)) {
            ssize_t got = recv(stream, frame + used, sizeof(frame) - used, 0);
            zassert_true(got > 0);
            used += (size_t)got;
        }
    } else {
        zassert_equal(recvfrom(fd, frame, sizeof(frame), 0, (struct sockaddr *)&source, &length),
                      32);
    }
    if (behavior == 0) {
        if (kind == SOCK_STREAM) {
            for (size_t i = 0; i < sizeof(frame); ++i)
                zassert_equal(send(stream, frame + i, 1, 0), 1);
        } else {
            zassert_equal(sendto(fd, frame, sizeof(frame), 0, (struct sockaddr *)&source, length),
                          32);
        }
    } else if (behavior == 1) {
        k_sleep(K_MSEC(400));
    }
    if (stream != fd)
        zassert_equal(close(stream), 0);
    zassert_equal(close(fd), 0);
}
ZTEST(m5_fixture, test_actual_native_consumer_and_accounting)
{
    zassert_equal(m5_fixture_init(), 0);
    struct fixture_session session = {.token = 7};
    struct fixture_command idle = {.action = 'I', .sequence = 1};
    zassert_equal(m5_fixture_execute(&session, &idle), 0);
    const int modes[][3] = {{SOCK_STREAM, 0, 0},
                            {SOCK_DGRAM, 0, 0},
                            {SOCK_STREAM, 1, -ETIMEDOUT},
                            {SOCK_STREAM, 2, -ECONNRESET}};
    for (size_t i = 0; i < ARRAY_SIZE(modes); ++i) {
        kind = modes[i][0];
        behavior = modes[i][1];
        k_thread_create(&peer, peer_stack, K_THREAD_STACK_SIZEOF(peer_stack), serve, NULL, NULL,
                        NULL, 5, 0, K_NO_WAIT);
        zassert_equal(k_sem_take(&ready, K_SECONDS(2)), 0);
        uint8_t frame[32];
        struct m5_metrics metrics;
        m5_frame(frame, 7, 4, (uint32_t)i + 1, kind == SOCK_DGRAM);
        zassert_equal(m5_exchange("127.0.0.1", 42422, kind == SOCK_DGRAM, frame, 200, &metrics),
                      modes[i][2]);
        zassert_equal(metrics.close_error, 0);
        zassert_equal(metrics.owned_after, 0);
        zassert_true(metrics.entered_ms <= metrics.functional_ms &&
                     metrics.functional_ms <= metrics.returned_ms);
        zassert_equal(k_thread_join(&peer, K_SECONDS(2)), 0);
        zassert_equal(m5_fixture_execute(&session, &idle), 0);
    }
    struct net_if *iface = net_if_get_default();
    net_if_carrier_off(iface);
    k_sleep(K_MSEC(100));
    net_if_carrier_on(iface);
    k_sleep(K_MSEC(100));
    zassert_equal(m5_fixture_execute(&session, &idle), 0);
}
ZTEST_SUITE(m5_fixture, NULL, NULL, NULL, NULL, NULL);
```
