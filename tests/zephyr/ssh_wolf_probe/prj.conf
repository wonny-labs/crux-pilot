## CMakeLists.txt
```
# Compile and link check of the wolfSSH settings arrangement. Never flashed or run.
cmake_minimum_required(VERSION 3.20.0)
list(APPEND EXTRA_CONF_FILE
    "${CMAKE_CURRENT_LIST_DIR}/../../../components/ssh/ports/zephyr/wolf-ssh.conf")
find_package(Zephyr REQUIRED HINTS $ENV{ZEPHYR_BASE})
project(crux_ssh_wolf_probe)

include(../../../components/ssh/ports/zephyr/wolf_ssh_settings.cmake)
crux_ssh_wolf_settings()

# The access entry points call crux_access since #192. This image only has to link them.
target_sources(app PRIVATE src/main.c src/access_refused.c)
target_include_directories(app PRIVATE
    ../../../components/access/include ../../../components/access/adapter)
```

## prj.conf
```kconfig
CONFIG_MAIN_STACK_SIZE=32768
CONFIG_COMMON_LIBC_MALLOC_ARENA_SIZE=131072
CONFIG_POSIX_API=y
CONFIG_POSIX_TIMERS=y
CONFIG_POSIX_THREADS=y
CONFIG_NETWORKING=y
CONFIG_NET_IPV4=y
CONFIG_NET_IPV6=n
CONFIG_NET_TCP=y
CONFIG_NET_SOCKETS=y
# The socket backend needs the wolfSSL Zephyr patch, recorded in patches/zephyr/README.md.
CONFIG_NET_SOCKETS_SOCKOPT_TLS=y
CONFIG_NET_SOCKETS_TLS_MAX_CONTEXTS=6
CONFIG_TLS_CREDENTIALS=y
CONFIG_MBEDTLS=n
```

## native_sim.conf
```kconfig
# The SSH test image on native_sim: wolfSSH without the TLS socket backend, on an unpatched Zephyr.
# CONFIG_POSIX_API=y fails on sys/_timeval.h with the host C library, so only the interfaces it needs.
CONFIG_POSIX_API=n
CONFIG_POSIX_TIMERS=n
CONFIG_POSIX_THREADS=n
CONFIG_POSIX_SYSTEM_INTERFACES=y
CONFIG_NET_SOCKETS_SOCKOPT_TLS=n
CONFIG_TLS_CREDENTIALS=n
# OpenSSH on the host reaches the image through the native socket offload.
CONFIG_NET_DRIVERS=y
CONFIG_NET_SOCKETS_OFFLOAD=y
CONFIG_NET_NATIVE_OFFLOADED_SOCKETS=y
CONFIG_ETH_NATIVE_TAP=n
```

## native_sim_combined.conf
```kconfig
# wolfSSH and the TLS socket backend together on native_sim, on a Zephyr with the socket patch.
# CONFIG_POSIX_TIMERS alone fails on union sigval, because only CONFIG_POSIX_API selects what that needs.
CONFIG_POSIX_API=n
CONFIG_POSIX_TIMERS=y
CONFIG_POSIX_THREADS=y
CONFIG_POSIX_REALTIME_SIGNALS=y
CONFIG_POSIX_SYSTEM_INTERFACES=y
```

## src/main.c
```c
/*
 * Links the wolfSSH server, stream and SFTP paths, and one TLS socket when the image has the socket
 * backend, so that the settings arrangement is built as a real image would use it. It is never run.
 */
#include "crux_ssh_callbacks.h"
#include "crux_ssh_wolf_provider.h"
#include <wolfssh/internal.h>
#include <wolfssh/ssh.h>
#include <wolfssh/wolfsftp.h>
#include <zephyr/net/socket.h>

/* The design's algorithm table, enforced where wolfSSH decides what it can offer. */
#ifdef NO_FILESYSTEM
#error "wolfSSH must not see NO_FILESYSTEM"
#endif
#ifndef WOLFSSH_USER_FILESYSTEM
#error "SFTP must use the user file system port"
#endif
#ifdef WOLFSSH_SCP
#error "SCP stays disabled"
#endif
#if defined(WOLFSSH_NO_ED25519) || defined(WOLFSSH_NO_ECDSA_SHA2_NISTP256)
#error "Ed25519 and ECDSA P-256 keys are required"
#endif
#if defined(WOLFSSH_NO_CURVE25519_SHA256) || defined(WOLFSSH_NO_ECDH_SHA2_NISTP256)
#error "curve25519-sha256 and ecdh-sha2-nistp256 are required"
#endif
#if defined(WOLFSSH_NO_AES_GCM) || defined(WOLFSSH_NO_AES_CTR)
#error "AES-GCM and AES-CTR are required"
#endif
#ifdef WOLFSSH_NO_HMAC_SHA2_256
#error "hmac-sha2-256 is required"
#endif
#ifndef WOLFSSH_NO_RSA
#error "Owner decision: no RSA in SSH"
#endif
#if !defined(WOLFSSH_NO_HMAC_SHA1) || !defined(WOLFSSH_NO_AES_CBC)
#error "SHA-1 and CBC are not offered"
#endif

static int recv_cb(WOLFSSH *ssh, void *buf, word32 sz, void *ctx)
{
    (void)ctx;
    return zsock_recv(wolfSSH_get_fd(ssh), buf, sz, 0);
}

static int send_cb(WOLFSSH *ssh, void *buf, word32 sz, void *ctx)
{
    (void)ctx;
    return zsock_send(wolfSSH_get_fd(ssh), buf, sz, 0);
}

static int auth_cb(byte type, WS_UserAuthData *data, void *ctx)
{
    (void)type;
    (void)data;
    (void)ctx;
    return WOLFSSH_USERAUTH_INVALID_USER;
}

static int auth_result_cb(byte result, WS_UserAuthData *data, void *ctx)
{
    (void)result;
    (void)data;
    (void)ctx;
    return WS_FATAL_ERROR;
}

static int channel_cb(WOLFSSH_CHANNEL *channel, void *ctx)
{
    (void)channel;
    (void)ctx;
    return WS_FATAL_ERROR;
}

static int file_handle;

int main(void)
{
    byte buf[64];

#ifdef CONFIG_NET_SOCKETS_SOCKOPT_TLS
    int tls = zsock_socket(NET_AF_INET, NET_SOCK_STREAM, NET_IPPROTO_TLS_1_2);

    zsock_close(tls);
#endif

    if (crux_ssh_callback_table()->password == NULL) {
        return 1;
    }
    /* Keeps the provider in the image, so that its link is shown and not only its compile. */
    if (crux_ssh_wolf_provider()->start(NULL, NULL) != CRUX_ERR_INVALID_ARGUMENT) {
        return 1;
    }
    wolfSSH_Init();
    WOLFSSH_CTX *ctx = wolfSSH_CTX_new(WOLFSSH_ENDPOINT_SERVER, NULL);

    wolfSSH_SetIORecv(ctx, recv_cb);
    wolfSSH_SetIOSend(ctx, send_cb);
    wolfSSH_SetUserAuth(ctx, auth_cb);
    wolfSSH_SetUserAuthResult(ctx, auth_result_cb);
    wolfSSH_CTX_SetStrictKex(ctx, 1);
    wolfSSH_CTX_SetAlgoListKex(ctx, "curve25519-sha256,ecdh-sha2-nistp256");
    wolfSSH_CTX_SetAlgoListKey(ctx, "ssh-ed25519,ecdsa-sha2-nistp256");
    wolfSSH_CTX_SetAlgoListKeyAccepted(ctx, "ssh-ed25519,ecdsa-sha2-nistp256");
    wolfSSH_CTX_SetAlgoListCipher(ctx, "aes128-gcm@openssh.com,aes256-gcm@openssh.com,aes128-ctr");
    wolfSSH_CTX_SetAlgoListMac(ctx, "hmac-sha2-256");
    wolfSSH_CTX_SetChannelReqShellCb(ctx, channel_cb);
    wolfSSH_CTX_SetChannelReqExecCb(ctx, channel_cb);
    wolfSSH_CTX_SetChannelReqSubsysCb(ctx, channel_cb);

    WOLFSSH *ssh = wolfSSH_new(ctx);

    wolfSSH_set_fd(ssh, -1);
    wolfSSH_SetFilesystemHandle(ssh, &file_handle);
    wolfSSH_accept(ssh);
    wolfSSH_stream_read(ssh, buf, sizeof(buf));
    wolfSSH_stream_send(ssh, buf, sizeof(buf));
    wolfSSH_SFTP_read(ssh);
    wolfSSH_free(ssh);
    wolfSSH_CTX_free(ctx);
    wolfSSH_Cleanup();
    return 0;
}
```

## src/access_refused.c
```c
/*
 * The calls that the access entry points of #192 make into crux_access, each refusing. This image
 * is a compile and link check of the settings arrangement, is never run, and has no access core of
 * its own.
 */
#include <crux_access_adapter.h>

crux_access_result_t crux_access_login_password(const char *user, const char *password,
                                                size_t length, const crux_access_origin_t *origin,
                                                crux_access_session_t *session,
                                                uint32_t *retry_after_ms)
{
    (void)user;
    (void)password;
    (void)length;
    (void)origin;
    (void)session;
    (void)retry_after_ms;
    return CRUX_ACCESS_ERR_NOT_READY;
}

crux_access_result_t crux_access_key_is_authorised(const char *user, const uint8_t *key,
                                                   size_t key_length, bool signed_request,
                                                   const crux_access_origin_t *origin,
                                                   uint32_t *retry_after_ms)
{
    (void)user;
    (void)key;
    (void)key_length;
    (void)signed_request;
    (void)origin;
    (void)retry_after_ms;
    return CRUX_ACCESS_ERR_NOT_READY;
}

crux_access_result_t crux_access_login_verified(const char *user, const uint8_t *key,
                                                size_t key_length,
                                                const crux_access_origin_t *origin,
                                                crux_access_session_t *session)
{
    (void)user;
    (void)key;
    (void)key_length;
    (void)origin;
    (void)session;
    return CRUX_ACCESS_ERR_NOT_READY;
}

void crux_access_report_key_failure(const char *user, const crux_access_origin_t *origin)
{
    (void)user;
    (void)origin;
}

crux_access_result_t crux_access_session_user(crux_access_session_t session, char *name,
                                              size_t size)
{
    (void)session;
    (void)name;
    (void)size;
    return CRUX_ACCESS_ERR_NOT_READY;
}

void crux_access_logout(crux_access_session_t *session)
{
    (void)session;
}
```

## src/owned.c
```c
/* Compiled as Crux-owned code is, to show that a provider can include wolfSSH under that policy. */
#include <wolfssh/ssh.h>
#include <wolfssh/wolfsftp.h>

#ifndef WOLFSSH_USER_FILESYSTEM
#error "Crux code must see the same wolfSSH settings as wolfSSH"
#endif

int crux_ssh_probe_owned(WOLFSSH *ssh, void *handle);

int crux_ssh_probe_owned(WOLFSSH *ssh, void *handle)
{
    return wolfSSH_SetFilesystemHandle(ssh, handle);
}
```
