## CMakeLists.txt
```
# Compile and link check of the web adapter for a target on each TLS profile. Never flashed or run.
cmake_minimum_required(VERSION 3.20.0)
find_package(Zephyr REQUIRED HINTS $ENV{ZEPHYR_BASE})
project(crux_web_compile LANGUAGES C)
get_filename_component(CRUX_ROOT "${CMAKE_CURRENT_LIST_DIR}/../../.." ABSOLUTE)
include(${CRUX_ROOT}/cmake/CruxWebRoutes.cmake)
target_sources(app PRIVATE src/main.c src/routes.c)
target_link_libraries(app PRIVATE crux_web_adapter)
target_compile_options(app PRIVATE -Wall -Wextra -Werror)
crux_web_routes(app SOURCES src/routes.c ZEPHYR_RESOURCES REVIEWED reviewed-routes.txt)

# The session module of #186 and its PSA ports, compiled for the target and not linked: an image also
# needs the Access core and its store, which a product composition brings.
include(${CRUX_ROOT}/components/web/session/sources.cmake)
# The PSA ports need a PSA provider, which the Mbed TLS profile has.
add_library(crux_web_session_compile OBJECT ${CRUX_WEB_SESSION_SOURCES} ${CRUX_WEB_SESSION_ROUTES})
if(CONFIG_MBEDTLS)
  target_sources(crux_web_session_compile PRIVATE ${CRUX_WEB_SESSION_PSA_PORT})
endif()
target_include_directories(crux_web_session_compile PRIVATE ${CRUX_WEB_SESSION_DIR}
  ${CRUX_ROOT}/components/web/src ${CRUX_ROOT}/components/web/adapter ${CRUX_ROOT}/components/web/include
  ${CRUX_ROOT}/components/access/include ${CRUX_ROOT}/components/access/adapter
  ${CRUX_ROOT}/components/base/include ${CRUX_ROOT}/components/sync/include
  ${CRUX_ROOT}/components/thread/include ${CRUX_ROOT}/components/time/include)
target_compile_definitions(crux_web_session_compile PRIVATE
  CRUX_WEB_BODY_BUFFER=${CONFIG_CRUX_WEB_BODY_BUFFER}u)
target_link_libraries(crux_web_session_compile PRIVATE zephyr_interface crux_service_priority_placement)
target_compile_options(crux_web_session_compile PRIVATE -Wall -Wextra -Werror)
```

## prj.conf
```kconfig
# The adapter on a target's own network stack, for a compile and link check only.
CONFIG_NETWORKING=y
CONFIG_NET_IPV4=y
CONFIG_NET_IPV6=n
CONFIG_NET_TCP=y
CONFIG_NET_SOCKETS=y
CONFIG_ZVFS_OPEN_MAX=16
CONFIG_ZVFS_POLL_MAX=16
CONFIG_CRUX_WEB=y
CONFIG_NET_SOCKETS_SOCKOPT_TLS=y
CONFIG_NET_SOCKETS_TLS_MAX_CONTEXTS=6
CONFIG_TLS_CREDENTIALS=y
CONFIG_MAIN_STACK_SIZE=4096
CONFIG_ENTROPY_GENERATOR=y
```

## mbedtls.conf
```kconfig
# The Mbed TLS profile as docs/https-composition.md declares it: TLS 1.3 with TLS_AES_128_GCM_SHA256 on
# P-256, records of 16 KiB, which a browser may send, and a heap for the three clients. Compile only.
CONFIG_MBEDTLS=y
CONFIG_MBEDTLS_ENABLE_HEAP=y
CONFIG_MBEDTLS_HEAP_SIZE=120000
CONFIG_MBEDTLS_SSL_MAX_CONTENT_LEN=16384
CONFIG_MBEDTLS_SSL_PROTO_TLS1_2=y
CONFIG_MBEDTLS_SSL_PROTO_TLS1_3=y
CONFIG_MBEDTLS_SSL_TLS1_3_KEY_EXCHANGE_MODE_EPHEMERAL_ENABLED=y
CONFIG_MBEDTLS_KEY_EXCHANGE_ECDHE_ECDSA_ENABLED=y
CONFIG_MBEDTLS_CIPHERSUITE_TLS_ECDHE_ECDSA_WITH_AES_128_GCM_SHA256=y
CONFIG_MBEDTLS_CIPHERSUITE_TLS1_3_AES_128_GCM_SHA256=y
CONFIG_PSA_WANT_KEY_TYPE_ECC_KEY_PAIR_DERIVE=y
CONFIG_PSA_WANT_ALG_ECDH=y
CONFIG_PSA_WANT_ALG_HKDF=y
CONFIG_MBEDTLS_PK_WRITE_C=y
```

## wolfssl.conf
```kconfig
# The wolfSSL profile, on a Zephyr with the socket patch recorded in patches/zephyr/README.md.
CONFIG_MBEDTLS=n
CONFIG_WOLFSSL=y
CONFIG_POSIX_API=y
CONFIG_POSIX_TIMERS=y
CONFIG_POSIX_THREADS=y
CONFIG_COMMON_LIBC_MALLOC_ARENA_SIZE=131072
```

## src/main.c
```c
/* A stand-in for the Access core and session lookup: this image only has to link. */
#include "crux_web_adapter.h"

crux_access_result_t crux_access_check(crux_access_session_t session, const char *permission)
{
    (void)session;
    (void)permission;
    return CRUX_ACCESS_ERR_DENIED;
}

crux_access_result_t crux_access_permitted(crux_access_session_t session, const char *permission,
                                           bool *permitted)
{
    (void)session;
    (void)permission;
    *permitted = false;
    return CRUX_ACCESS_OK;
}

int main(void)
{
    static const crux_web_config_t config = {
        .request_deadline_ms = CONFIG_CRUX_WEB_REQUEST_DEADLINE_MS, .handler_limit_ms = 100u};

    return crux_web_start(&config) == CRUX_WEB_OK ? 0 : 1;
}
```

## src/routes.c
```c
/* One fixed route and one wildcard route, so that both kinds of resource link. */
#include <crux/web.h>

static crux_web_result_t on_route(crux_web_request_t *request, crux_access_session_t session,
                                  void *context)
{
    (void)session;
    (void)context;
    return crux_web_respond_error(request, 404, "not_found");
}

CRUX_WEB_ROUTE(fixed, "/api/v1/status", CRUX_WEB_GET, CRUX_WEB_SESSION, on_route, NULL);
CRUX_WEB_ROUTE(wildcard, "/api/v1/session/attempt/{id}", CRUX_WEB_GET, CRUX_WEB_PUBLIC, on_route,
               NULL);
```
