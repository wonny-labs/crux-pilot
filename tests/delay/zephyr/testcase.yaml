## tests/delay/zephyr/testcase.yaml
```yaml
tests:
  crux.delay.native_profile:
    harness: ztest
    platform_allow:
      - native_sim/native/64
    integration_platforms:
      - native_sim/native/64
    tags:
      - crux
      - delay
```

## tests/execution/testcase.yaml
```yaml
tests:
  crux.execution.native:
    harness: ztest
    timeout: 20
    platform_allow: [native_sim/native/64]
    tags: [crux, execution]
  crux.execution.posix:
    harness: ztest
    timeout: 20
    platform_allow: [native_sim/native/64]
    extra_args: [EXTRA_CONF_FILE=posix.conf]
    tags: [crux, execution, posix]
```

## tests/execution_runtime/zephyr/testcase.yaml
```yaml
tests:
  crux.execution.runtime_independent:
    tags:
      - execution
      - runtime
    platform_allow:
      - native_sim/native/64
    integration_platforms:
      - native_sim/native/64
    harness: ztest
    timeout: 60
```

## tests/gpio/zephyr/testcase.yaml
```yaml
tests:
  crux.gpio.zephyr:
    platform_allow:
      - native_sim/native/64
    tags:
      - gpio
      - crux
```

## tests/gpio/zephyr_failure/open_drain/testcase.yaml
```yaml
tests:
  crux.gpio.zephyr_failure.open_drain:
    platform_allow:
      - native_sim/native/64
    tags:
      - gpio
      - crux
```

## tests/gpio/zephyr_failure/pin_range/testcase.yaml
```yaml
tests:
  crux.gpio.zephyr_failure.pin_range:
    platform_allow:
      - native_sim/native/64
    tags:
      - gpio
      - crux
```

## tests/i2c_consumer_zephyr/dts/bindings/vnd,crux-tmp117-emulator.yaml
```yaml
description: Crux software model of a TMP117 temperature sensor
compatible: "vnd,crux-tmp117-emulator"
include: i2c-device.yaml
```

## tests/i2c_consumer_zephyr/testcase.yaml
```yaml
tests:
  crux.i2c.tmp117.native_sim:
    tags:
      - crux
      - i2c
    platform_allow:
      - native_sim
```

## tests/i2c_zephyr/testcase.yaml
```yaml
tests:
  crux.i2c.native_sim:
    tags:
      - crux
      - i2c
    platform_allow:
      - native_sim
```

## tests/logging/zephyr/testcase.yaml
```yaml
tests:
  crux.logging.uart:
    platform_allow:
      - native_sim/native/64
    tags:
      - logging
      - portable
  crux.logging.udp:
    platform_allow:
      - native_sim/native/64
    tags:
      - logging
      - portable
    extra_configs:
      - CONFIG_LOG_BACKEND_UART=n
      - CONFIG_NETWORKING=y
      - CONFIG_NET_IPV4=y
      - CONFIG_NET_IPV6=y
      - CONFIG_NET_DRIVERS=y
      - CONFIG_NET_LOOPBACK=y
      - CONFIG_NET_UDP=y
      - CONFIG_NET_SOCKETS=y
      - CONFIG_NET_TEST=y
      - CONFIG_NET_CONNECTION_MANAGER=y
      - CONFIG_LOG_BACKEND_NET=y
      - CONFIG_LOG_BACKEND_NET_AUTOSTART=y
      - CONFIG_LOG_BACKEND_NET_USE_CONNECTION_MANAGER=y
      - CONFIG_LOG_BACKEND_NET_SERVER="127.0.0.1:15141"
      - CONFIG_LOG_BACKEND_NET_MAX_BUF_SIZE=480
  crux.logging.dual:
    platform_allow:
      - native_sim/native/64
    tags:
      - logging
      - portable
    extra_configs:
      - CONFIG_NETWORKING=y
      - CONFIG_NET_IPV4=y
      - CONFIG_NET_IPV6=y
      - CONFIG_NET_DRIVERS=y
      - CONFIG_NET_LOOPBACK=y
      - CONFIG_NET_UDP=y
      - CONFIG_NET_SOCKETS=y
      - CONFIG_NET_TEST=y
      - CONFIG_NET_CONNECTION_MANAGER=y
      - CONFIG_LOG_BACKEND_NET=y
      - CONFIG_LOG_BACKEND_NET_AUTOSTART=y
      - CONFIG_LOG_BACKEND_NET_USE_CONNECTION_MANAGER=y
      - CONFIG_LOG_BACKEND_NET_SERVER="127.0.0.1:15141"
      - CONFIG_LOG_BACKEND_NET_MAX_BUF_SIZE=480
```

## tests/m5_integrated/zephyr/testcase.yaml
```yaml
tests:
  crux.m5.integrated_smoke:
    platform_allow:
      - native_sim/native/64
    tags:
      - m5
      - integration
      - portable
    harness: ztest
    timeout: 30
```

## tests/m6_combined/testcase.yaml
```yaml
tests:
  crux.m6.combined:
    platform_allow:
      - native_sim/native/64
    tags:
      - crux
      - gpio
      - i2c
      - spi
```

## tests/messaging_consumer/zephyr/testcase.yaml
```yaml
tests:
  crux.messaging.runtime_consumer:
    platform_allow: [native_sim/native/64]
    timeout: 20
    harness: console
    harness_config:
      type: one_line
      regex: ["MESSAGING_NATIVE_CONSUMER passed"]
    tags: [crux, messaging]
```

## tests/monotonic/zephyr/testcase.yaml
```yaml
tests:
  crux.monotonic.native:
    harness: ztest
    timeout: 20
    platform_allow: [native_sim/native/64]
    tags: [crux, monotonic]
```

## tests/native/bench_report/testcase.yaml
```yaml
common:
  platform_allow:
    - native_sim/native/64
  tags:
    - bench
  timeout: 60
  harness: console
tests:
  crux.native.bench_report:
    harness_config:
      type: multi_line
      ordered: true
      regex:
        - '^BENCH-REPORT v=1 begin seq=1 reason=boot uptime_ms=\d+ bursts=0$'
        # Zephyr lists the newest thread first, and the unnamed one is created after the HTTP one.
        - '^BENCH-STACK seq=1 thread=thread@[0-9a-f]+ size=\d+ used=\d+ unused=\d+ state=live$'
        - '^BENCH-STACK seq=1 thread=http_server_tid size=8192 used=\d+ unused=\d+ state=live$'
        - '^BENCH-HEAP seq=1 arena=65536 in_use=\d+ peak=\d+ free=\d+$'
        - '^BENCH-POOL seq=1 pool=rx_pkt size=192 used=3 peak=21$'
        - '^BENCH-POOL seq=1 pool=tx_pkt size=32 used=3 peak=7$'
        - '^BENCH-POOL seq=1 pool=rx_buf size=1024 used=3 peak=151$'
        - '^BENCH-POOL seq=1 pool=tx_buf size=768 used=3 peak=91$'
        - '^BENCH-NET seq=1 ip_drop=0 tcp_drop=0 tcp_seg_drop=0 tcp_rexmit=0 tcp_conndrop=0$'
        - '^BENCH-REPORT v=1 end seq=1 lines=\d+ missed=0$'
        - '^BENCH-REPORT v=1 begin seq=2 reason=quiet uptime_ms=\d+ bursts=1$'
        - '^BENCH-STACK seq=2 thread=main size=\d+ used=\d+ unused=\d+ state=ended$'
        - '^BENCH-STACK seq=2 thread=ssh_worker size=16384 used=\d+ unused=\d+ state=ended$'
        - '^BENCH-POOL seq=2 pool=rx_buf size=1024 used=3 peak=152$'
        - '^BENCH-NET seq=2 ip_drop=0 tcp_drop=0 tcp_seg_drop=0 tcp_rexmit=1 tcp_conndrop=0$'
        - '^BENCH-REPORT v=1 end seq=2 lines=\d+ missed=0$'
        - '^BENCH-REPORT v=1 begin seq=3 reason=idle uptime_ms=\d+ bursts=1$'
        - '^BENCH-REPORT v=1 end seq=3 lines=\d+ missed=0$'
        - '^BENCH-REPORT v=1 begin seq=4 reason=idle uptime_ms=\d+ bursts=1$'
        - '^BENCH-REPORT v=1 end seq=4 lines=\d+ missed=[1-9]\d*$'
        - '^BENCH_REPORT_TEST complete$'
```

## tests/native/configuration_settings_file/testcase.yaml
```yaml
tests:
  crux.configuration.settings_file:
    platform_allow: [native_sim/native/64]
    tags: [settings, filesystem, crux]
    timeout: 120
```

## tests/native/deferred_output/testcase.yaml
```yaml
common:
  platform_allow:
    - native_sim/native/64
  tags:
    - logging
  timeout: 10
  harness: console
  harness_config:
    type: multi_line
    ordered: true
tests:
  crux.native.deferred_output:
    harness_config:
      type: multi_line
      ordered: true
      regex:
        - '^DEFERRED_BEGIN$'
        - '^DEFERRED_RECORD signed=-9223372036854775807 unsigned=18446744073709551615 payload=abcdefghijklmnopqrstuvwxyz0123456789abcdefghijklmnopqrstuvwxyz0123456789abcdefghijklmnopqrstuvwxyz0123456789abcdefghijklmnopqrstuvwxyz0123456789abcdefghijklmnopqrstuvwxyz0123456789abcdefghijklmnopqrstuvwxyz0123456789$'
        - '^DEFERRED_COMPLETE$'
  crux.native.deferred_overflow:
    extra_args:
      - CRUX_TEST_OVERFLOW=ON
    extra_configs:
      - CONFIG_LOG_BUFFER_SIZE=256
      - CONFIG_LOG_PROCESS_THREAD_STARTUP_DELAY_MS=200
    harness_config:
      type: multi_line
      ordered: true
      regex:
        - 'messages dropped ---'
        - '^OVERFLOW_COMPLETE$'
```

## tests/native/emmc_stack/Kconfig
```kconfig
# SPDX-License-Identifier: Apache-2.0
rsource "../../support/emmc_sim/Kconfig"
source "Kconfig.zephyr"
```

## tests/native/emmc_stack/testcase.yaml
```yaml
common:
  platform_allow: [native_sim/native, native_sim/native/64]
  tags: [storage, crux]
  timeout: 180
tests:
  crux.emmc.stack.cached: {}
  crux.emmc.stack.nocache:
    extra_configs:
      - CONFIG_CRUX_EMMC_SIM_CACHE_KB=0
  crux.emmc.stack.flush.cached:
    extra_configs:
      - CONFIG_CRUX_MMC_CACHE_FLUSH=y
  crux.emmc.stack.flush.nocache:
    extra_configs:
      - CONFIG_CRUX_MMC_CACHE_FLUSH=y
      - CONFIG_CRUX_EMMC_SIM_CACHE_KB=0
```

## tests/native/file_fatfs_persist/testcase.yaml
```yaml
tests:
  crux.file.fatfs_persist_build:
    build_only: true
    platform_allow: [native_sim/native/64]
    tags: [filesystem, crux]
```
