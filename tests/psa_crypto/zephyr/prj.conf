## CMakeLists.txt
```
cmake_minimum_required(VERSION 3.20.0)
# The composition selects the provider, through tf-psa-crypto.conf or wolfpsa.conf. Both are projects
# of the crux-secure-management west group. The cases need no Crux component.
find_package(Zephyr REQUIRED HINTS $ENV{ZEPHYR_BASE})
project(crux_psa_conformance C)
target_sources(app PRIVATE src/main.c ../cases/psa_cases.c)
target_include_directories(app PRIVATE ../cases)
target_compile_options(app PRIVATE -Wall -Wextra -Werror)

include("${CMAKE_CURRENT_LIST_DIR}/../provider_declarations.cmake")
if(CONFIG_WOLFPSA)
    set(_crux_psa_declared "${CRUX_PSA_UNSUPPORTED_WOLFPSA}")
    set(_crux_psa_deviations "${CRUX_PSA_DEVIATIONS_WOLFPSA}")
    # The same wolfCrypt settings as components/ssh/ports/zephyr/wolf_ssh_settings.cmake, because a
    # management image shares one wolfCrypt between wolfPSA, TLS and wolfSSH, and the TLS socket
    # backend rejects CONFIG_WOLFSSL_SETTINGS_FILE.
    target_compile_definitions(wolfSSL INTERFACE
        WOLFSSL_WOLFSSH WOLFSSL_AES_COUNTER WOLFSSL_KEY_GEN WOLFSSL_ED25519_STREAMING_VERIFY
        ${CRUX_PSA_WOLFCRYPT_DEFINITIONS})
elseif(CONFIG_PSA_CRYPTO_PROVIDER_MBEDTLS)
    set(_crux_psa_declared "${CRUX_PSA_UNSUPPORTED_TF_PSA_CRYPTO}")
    set(_crux_psa_deviations "${CRUX_PSA_DEVIATIONS_TF_PSA_CRYPTO}")
    # Where the PSA source is the legacy RNG over an entropy driver, as on RT1060-EVKB, a failed read
    # must fail PSA. native_sim uses the external RNG, which has no such fallback unless it is told to.
    if(CONFIG_MBEDTLS_PSA_DRIVER_GET_ENTROPY)
        include("${CMAKE_CURRENT_LIST_DIR}/../../../cmake/CruxMbedtlsEntropy.cmake")
        crux_mbedtls_fail_closed_entropy()
    endif()
else()
    message(FATAL_ERROR "Select a PSA Crypto provider: EXTRA_CONF_FILE=tf-psa-crypto.conf or wolfpsa.conf")
endif()
target_compile_definitions(app PRIVATE
    "PSA_CASES_DECLARED_UNSUPPORTED=\"${_crux_psa_declared}\""
    "PSA_CASES_DECLARED_DEVIATIONS=\"${_crux_psa_deviations}\"")
```

## prj.conf
```kconfig
CONFIG_ZTEST=y
CONFIG_MAIN_STACK_SIZE=16384
CONFIG_ZTEST_STACK_SIZE=16384

# The provider comes from tf-psa-crypto.conf or wolfpsa.conf.
CONFIG_PSA_CRYPTO=y

# Only what the declared subset needs, so unused algorithms stay out of the image.
CONFIG_PSA_WANT_ALG_SHA_256=y
CONFIG_PSA_WANT_ALG_HMAC=y
CONFIG_PSA_WANT_KEY_TYPE_HMAC=y
CONFIG_PSA_WANT_ALG_PBKDF2_HMAC=y
CONFIG_PSA_WANT_ALG_GCM=y
CONFIG_PSA_WANT_KEY_TYPE_AES=y
CONFIG_PSA_WANT_ALG_ECDSA=y
CONFIG_PSA_WANT_KEY_TYPE_ECC_PUBLIC_KEY=y
CONFIG_PSA_WANT_KEY_TYPE_ECC_KEY_PAIR_IMPORT=y
CONFIG_PSA_WANT_KEY_TYPE_ECC_KEY_PAIR_EXPORT=y
CONFIG_PSA_WANT_KEY_TYPE_ECC_KEY_PAIR_GENERATE=y
CONFIG_PSA_WANT_ECC_SECP_R1_256=y
```

## tf-psa-crypto.conf
```kconfig
# TF-PSA-Crypto through Zephyr's Mbed TLS module.
CONFIG_PSA_CRYPTO_PROVIDER_MBEDTLS=y
```

## wolfpsa-with-tls.conf
```kconfig
# Added after wolfpsa.conf. The wolfSSL TLS layer stays in the image, as in a management image, so the
# conformance cases also run against a wolfCrypt configured for TLS. The cases do not use TLS, and this
# has no TLS socket backend.
CONFIG_WOLFSSL_CRYPTO_ONLY=n
CONFIG_NETWORKING=y
CONFIG_NET_SOCKETS=y
CONFIG_NET_TCP=y
CONFIG_NET_IPV4=y
```

## wolfpsa.conf
```kconfig
# wolfPSA on the wolfSSL module's Kconfig-driven settings. A management image cannot use
# CONFIG_WOLFSSL_SETTINGS_FILE, so this tests the same route. The wolfSSL TLS layer stays out of this
# image, because the conformance cases do not use it.
CONFIG_PSA_CRYPTO_PROVIDER_CUSTOM=y
CONFIG_WOLFSSL=y
CONFIG_WOLFSSL_CRYPTO_ONLY=y
CONFIG_WOLFSSL_CURVE25519=y
CONFIG_ENTROPY_GENERATOR=y
```

## src/main.c
```c
/*
 * Zephyr native_sim harness for the provider-neutral PSA Crypto conformance cases.
 * The provider comes from the modules given to the build, never from here.
 */
#include <zephyr/ztest.h>

#include "psa_cases.h"

#define PSA_ZTEST(name)                                                                            \
    ZTEST(psa_conformance, test_##name)                                                            \
    {                                                                                              \
        const char *text = NULL;                                                                   \
        const psa_outcome_t outcome = psa_case_outcome(#name, psa_case_##name(), &text);           \
        const char *note = psa_case_note();                                                        \
                                                                                                   \
        if (note != NULL) {                                                                        \
            TC_PRINT("note: %s\n", note);                                                          \
        }                                                                                          \
        if (outcome == PSA_OUTCOME_DECLARED_UNSUPPORTED) {                                         \
            TC_PRINT("UNSUPPORTED %s (declared)\n", #name);                                        \
            ztest_test_skip();                                                                     \
        }                                                                                          \
        if (outcome == PSA_OUTCOME_DECLARED_DEVIATION) {                                           \
            TC_PRINT("DEVIATION %s (declared): %s\n", #name, text);                                \
            ztest_test_skip();                                                                     \
        }                                                                                          \
        zassert_equal(outcome, PSA_OUTCOME_PASS, "%s", text);                                      \
    }

PSA_CASE_LIST(PSA_ZTEST)

ZTEST(psa_conformance, test_case_list_is_complete)
{
    zassert_equal(PSA_CASE_COUNT, PSA_CASE_EXPECTED_COUNT, "case list changed");
}

static void *suite_setup(void)
{
    psa_case_print_random_probe();
    return NULL;
}

ZTEST_SUITE(psa_conformance, NULL, suite_setup, NULL, NULL, NULL);
```
