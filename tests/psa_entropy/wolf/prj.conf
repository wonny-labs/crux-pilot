## CMakeLists.txt
```
# SPDX-License-Identifier: Apache-2.0
# A native_sim application on the Wolf profile (wolfSSL's wolfCrypt under wolfPSA) whose entropy device can be made
# to fail, to show what the Crux PSA ports and the boot check of tests/zephyr/entropy_boot do with a failed read.
# It is the counterpart of tests/psa_entropy/zephyr, which does the same for the Mbed profile. wolfSSL is GPL,
# so this test stays out of default CI, as scripts/check-ssh-boundaries.py requires: scripts/test-wolf-entropy.sh
# builds and runs it. See docs/rt1060-wolf-entropy.md.
#
# CRUX_WOLF_ENTROPY_VARIANT (a -D at configuration):
#   runtime     the device is the chosen entropy source and can be made to fail at any moment (the default)
#   init-fails  the same, and the device does not initialise, so it is not ready
#   fallback    CONTROL: no entropy driver and a test generator. wolfCrypt then reads sys_rand_get().
#   guard       CONTROL: the same, with the boot check compiled in. It must NOT compile.
cmake_minimum_required(VERSION 3.20.0)
get_filename_component(CRUX_ROOT "${CMAKE_CURRENT_LIST_DIR}/../../.." ABSOLUTE)
if(NOT CRUX_WOLF_ENTROPY_VARIANT)
    set(CRUX_WOLF_ENTROPY_VARIANT runtime)
endif()
set(EXTRA_CONF_FILE "${CRUX_ROOT}/tests/psa_crypto/zephyr/wolfpsa.conf")
if(CRUX_WOLF_ENTROPY_VARIANT STREQUAL runtime)
    set(DTC_OVERLAY_FILE "${CMAKE_CURRENT_LIST_DIR}/overlays/failing-device.overlay")
elseif(CRUX_WOLF_ENTROPY_VARIANT STREQUAL init-fails)
    set(DTC_OVERLAY_FILE "${CMAKE_CURRENT_LIST_DIR}/overlays/failing-device.overlay")
    list(APPEND EXTRA_CONF_FILE "${CMAKE_CURRENT_LIST_DIR}/init-fails.conf")
elseif(CRUX_WOLF_ENTROPY_VARIANT STREQUAL fallback OR CRUX_WOLF_ENTROPY_VARIANT STREQUAL guard)
    set(DTC_OVERLAY_FILE "${CMAKE_CURRENT_LIST_DIR}/overlays/no-chosen-entropy.overlay")
    list(APPEND EXTRA_CONF_FILE "${CMAKE_CURRENT_LIST_DIR}/control-fallback.conf")
else()
    message(FATAL_ERROR "CRUX_WOLF_ENTROPY_VARIANT is runtime, init-fails, fallback or guard")
endif()
find_package(Zephyr REQUIRED HINTS $ENV{ZEPHYR_BASE})
project(crux_wolf_entropy LANGUAGES C)
if(NOT CONFIG_BOARD_NATIVE_SIM OR NOT CONFIG_WOLFPSA)
    message(FATAL_ERROR "native_sim and wolfPSA only: this is a test of the Wolf profile that never runs on a board")
endif()
include("${CRUX_ROOT}/tests/psa_crypto/provider_declarations.cmake")
set(component "${CRUX_ROOT}/components")
target_sources(app PRIVATE src/main.c src/test_entropy.c
    "${CRUX_ROOT}/tests/psa_ports/device_id_double.c"
    "${component}/access/ports/psa/access_psa.c"
    "${component}/credential/ports/psa/credential_psa.c"
    "${component}/tls_certificate/ports/psa/tls_certificate_psa.c"
    "${component}/web/ports/psa/web_session_psa.c")
if(NOT CRUX_WOLF_ENTROPY_VARIANT STREQUAL fallback)
    target_sources(app PRIVATE "${CRUX_ROOT}/tests/zephyr/entropy_boot/entropy_boot.c")
endif()
target_include_directories(app PRIVATE
    "${CRUX_ROOT}/tests/psa_ports" "${CRUX_ROOT}/tests/zephyr/entropy_boot"
    "${component}/base/include"
    "${component}/access/include" "${component}/access/adapter" "${component}/access/src"
    "${component}/credential/include" "${component}/credential/adapter" "${component}/credential/src"
    "${component}/credential/ports/psa" "${component}/file/include"
    "${component}/tls_certificate/include" "${component}/tls_certificate/adapter"
    "${component}/tls_certificate/src"
    "${component}/web/session" "${component}/web/adapter" "${component}/web/src")
target_compile_options(app PRIVATE -Wall -Wextra -Werror)
target_compile_definitions(app PRIVATE CRUX_WOLF_ENTROPY_VARIANT_NAME="${CRUX_WOLF_ENTROPY_VARIANT}")
if(CRUX_WOLF_ENTROPY_VARIANT STREQUAL fallback)
    target_compile_definitions(app PRIVATE CRUX_WOLF_ENTROPY_CONTROL=1)
endif()
# The same wolfCrypt settings as a management image: see tests/psa_ports/zephyr/CMakeLists.txt.
target_compile_definitions(wolfSSL INTERFACE
    WOLFSSL_WOLFSSH WOLFSSL_AES_COUNTER WOLFSSL_KEY_GEN WOLFSSL_ED25519_STREAMING_VERIFY
    ${CRUX_PSA_WOLFCRYPT_DEFINITIONS})
```

## Kconfig
```
mainmenu "Wolf profile entropy failure test"

source "Kconfig.zephyr"

config CRUX_TEST_ENTROPY
	bool "Entropy device for tests, whose reads can be made to fail"
	default y
	depends on DT_HAS_CRUX_TEST_ENTROPY_ENABLED
	select ENTROPY_HAS_DRIVER
	# As the RT1060 TRNG driver does, so that Zephyr's own generator is seeded from this device too.
	select ENTROPY_NEEDS_PRNG
	help
	  A test-only driver. It is not a source of entropy.

config CRUX_TEST_ENTROPY_INIT_FAILS
	bool "The device fails to initialise, so it is not ready (as a TRNG that does not start)"
	depends on CRUX_TEST_ENTROPY
```

## prj.conf
```kconfig
CONFIG_ZTEST=y
CONFIG_MAIN_STACK_SIZE=16384
CONFIG_ZTEST_STACK_SIZE=16384

# As the RT1060-EVKB image: the TRNG driver sets ENTROPY_HAS_DRIVER and ENTROPY_NEEDS_PRNG, Zephyr's own generator
# is the xoshiro one that the device seeds, and nothing selects a test generator.
CONFIG_ENTROPY_GENERATOR=y
CONFIG_XOSHIRO_RANDOM_GENERATOR=y

# Only what the declared subset needs, as tests/psa_ports/zephyr and the management images do.
CONFIG_PSA_CRYPTO=y
CONFIG_PSA_WANT_ALG_SHA_256=y
CONFIG_PSA_WANT_ALG_HMAC=y
CONFIG_PSA_WANT_KEY_TYPE_HMAC=y
CONFIG_PSA_WANT_ALG_PBKDF2_HMAC=y
CONFIG_PSA_WANT_ALG_GCM=y
CONFIG_PSA_WANT_KEY_TYPE_AES=y
CONFIG_PSA_WANT_ALG_ECDSA=y
CONFIG_PSA_WANT_KEY_TYPE_ECC_PUBLIC_KEY=y
CONFIG_PSA_WANT_KEY_TYPE_ECC_KEY_PAIR_IMPORT=y
CONFIG_PSA_WANT_KEY_TYPE_ECC_KEY_PAIR_EXPORT=y
CONFIG_PSA_WANT_KEY_TYPE_ECC_KEY_PAIR_GENERATE=y
CONFIG_PSA_WANT_ECC_SECP_R1_256=y
```

## control-fallback.conf
```kconfig
# CONTROL: no entropy driver at all, and a test random generator. Zephyr's own random subsystem does not compile
# with ENTROPY_GENERATOR on and no chosen entropy device, and ENTROPY_HAS_DRIVER depends on ENTROPY_GENERATOR, so
# this is the state in which wolfCrypt's Zephyr seed function does not read a driver: it calls sys_rand_get().
# This is what a mis-composed image would be.
CONFIG_ENTROPY_GENERATOR=n
CONFIG_XOSHIRO_RANDOM_GENERATOR=n
CONFIG_TEST_RANDOM_GENERATOR=y
```

## init-fails.conf
```kconfig
CONFIG_CRUX_TEST_ENTROPY_INIT_FAILS=y
```

## src/main.c
```c
/* SPDX-License-Identifier: Apache-2.0 */
/* What the Wolf profile does when the entropy device fails, on native_sim.
 *
 * Crux requires a failed random read to produce nothing: no key, no certificate serial, no salt, no
 * session identifier, and a boot line that says so (docs/rt1060-wolf-entropy.md). wolfCrypt's
 * Hash-DRBG is seeded from the chosen zephyr,entropy device by wc_GenerateSeed(), each time a
 * generator is made, and a failed read is RNG_FAILURE_E. These cases run the real Crux PSA ports
 * over wolfPSA with a device that fails. One image per variant (CRUX_WOLF_ENTROPY_VARIANT):
 *
 *   runtime     a healthy start, a failed first read, and a read that fails after a
 *               successful start;
 *   init-fails  a device that does not start, so it is not ready;
 *   fallback    CONTROL: with no entropy driver wolfCrypt calls sys_rand_get() and succeeds,
 *               whatever the hardware would do. The boot check refuses to compile in that
 *               composition (variant guard).
 *
 * Every case requires that the device was read where it is read at all, so a pass cannot come from
 * another source.
 */
#include <zephyr/ztest.h>

#include <psa/crypto.h>

#include <stdio.h>
#include <stdlib.h>
#include <string.h>

#include "access_port.h"
#include "credential_port.h"
#include "entropy_boot.h"
#include "test_entropy.h"
#include "tls_certificate_port.h"
#include "web_session_port.h"

#define EXPECTED_OK_LINE                                                                           \
    "CRUX-ENTROPY first-read=ok source=crux-test-entropy compatible=crux,test-entropy bytes=32 "   \
    "status=0 "                                                                                    \
    "device-ready=1"

static bool all_zero(const uint8_t *bytes, size_t length)
{
    for (size_t i = 0; i < length; i++) {
        if (bytes[i] != 0u) {
            return false;
        }
    }
    return true;
}

/* Every place in the Crux code that asks for random bytes or a key, and what each does. 'works'
 * says which outcome is required. A failure must leave the caller's buffers untouched or wiped,
 * which is zero here. */
static void consumers(bool works)
{
    uint8_t bytes[32] = {0};

    zassert_equal(psa_crypto_init(), PSA_SUCCESS, "wolfPSA did not initialise");
    zassert_equal(psa_generate_random(bytes, sizeof(bytes)) == PSA_SUCCESS, works,
                  "psa_generate_random: works=%d", (int)works);
    zassert_equal(all_zero(bytes, sizeof(bytes)), !works,
                  "psa_generate_random wrote bytes on failure");

    memset(bytes, 0, sizeof(bytes));
    zassert_equal(crux_access_port_random(bytes, sizeof(bytes)), works, "access salt");
    zassert_equal(all_zero(bytes, sizeof(bytes)), !works, "access salt bytes");
    memset(bytes, 0, sizeof(bytes));
    zassert_equal(crux_tls_certificate_port_random(bytes, sizeof(bytes)), works,
                  "certificate serial");
    zassert_equal(all_zero(bytes, sizeof(bytes)), !works, "certificate serial bytes");
    memset(bytes, 0, sizeof(bytes));
    zassert_equal(crux_web_session_port_random(bytes, sizeof(bytes)), works, "session identifier");
    zassert_equal(all_zero(bytes, sizeof(bytes)), !works, "session identifier bytes");
    memset(bytes, 0, sizeof(bytes));
    zassert_equal(crux_credential_port_random(bytes, sizeof(bytes)),
                  works ? CRUX_CREDENTIAL_OK : CRUX_CREDENTIAL_ERR_ENTROPY, "nonce");
    zassert_equal(all_zero(bytes, sizeof(bytes)), !works, "nonce bytes");

    /* The TLS key (the certificate's) and the SSH host key. */
    static const crux_credential_key_type_t types[] = {CRUX_CREDENTIAL_KEY_ECDSA_P256,
                                                       CRUX_CREDENTIAL_KEY_ED25519};
    for (size_t i = 0; i < ARRAY_SIZE(types); i++) {
        uint8_t public_key[80] = {0};
        uint8_t private_key[80] = {0};
        size_t lengths[2] = {0, 0};
        crux_credential_result_t result = crux_credential_port_generate_key(
            types[i], public_key, sizeof(public_key), private_key, sizeof(private_key), lengths);
        zassert_equal(result, works ? CRUX_CREDENTIAL_OK : CRUX_CREDENTIAL_ERR_ENTROPY,
                      "key type %d", (int)types[i]);
        zassert_equal(all_zero(public_key, sizeof(public_key)), !works, "public key bytes");
        zassert_equal(all_zero(private_key, sizeof(private_key)), !works, "private key bytes");
        zassert_equal(lengths[0] != 0u, works, "key lengths");
    }
}

static void before(void *fixture)
{
    ARG_UNUSED(fixture);
    crux_test_entropy_set_failing(false);
}

#if defined(CRUX_WOLF_ENTROPY_CONTROL)

ZTEST(wolf_entropy, test_without_an_entropy_driver_wolfcrypt_falls_back_to_sys_rand_get)
{
    unsigned int before_reads = crux_test_entropy_reads();

    crux_test_entropy_set_failing(true);
    consumers(true);
    zassert_equal(crux_test_entropy_reads(), before_reads,
                  "a device was read although the image has no entropy driver");
}

#elif defined(CONFIG_CRUX_TEST_ENTROPY_INIT_FAILS)

/* The consumers, with no boot check involved: what the Wolf profile does by itself. */
ZTEST(wolf_entropy, test_consumers_produce_nothing_when_the_device_is_not_ready)
{
    unsigned int before_reads = crux_test_entropy_reads();

    consumers(false);
    zassert_equal(crux_test_entropy_reads(), before_reads,
                  "a device that is not ready was read: wolfCrypt must check it first");
}

ZTEST(wolf_entropy, test_boot_check_refuses_when_the_device_is_not_ready)
{
    zassert_false(crux_entropy_boot_check(),
                  "the boot check passed with a device that is not ready");
    const char *line = crux_entropy_boot_last_line();
    zassert_true(strncmp(line, "CRUX-ENTROPY first-read=failed source=crux-test-entropy ", 55) == 0,
                 "%s", line);
    zassert_not_null(strstr(line, " compatible=crux,test-entropy bytes=32 status="), "%s", line);
    zassert_not_null(strstr(line, " device-ready=0"), "%s", line);
}

#else

/* The consumers, with no boot check involved: what the Wolf profile does by itself. */
ZTEST(wolf_entropy, test_consumers_work_with_a_healthy_device)
{
    unsigned int before_reads = crux_test_entropy_reads();

    consumers(true);
    zassert_true(crux_test_entropy_reads() > before_reads,
                 "the consumers never reached the device");
}

ZTEST(wolf_entropy, test_consumers_produce_nothing_when_every_read_fails)
{
    unsigned int before_reads = crux_test_entropy_reads();

    crux_test_entropy_set_failing(true);
    consumers(false);
    zassert_true(crux_test_entropy_reads() > before_reads,
                 "the failed reads never reached the device");
}

/* Each psa_generate_random seeds a new Hash-DRBG from the device, so a read that fails after a
 * successful start reaches the same function as the first one. This is not wolfCrypt's reseed
 * inside one generator, which a million requests later is not exercised here. */
ZTEST(wolf_entropy, test_consumers_fail_when_a_read_fails_after_a_successful_start)
{
    consumers(true);
    crux_test_entropy_set_failing(true);
    consumers(false);
    crux_test_entropy_set_failing(false);
    consumers(true);
}

ZTEST(wolf_entropy, test_boot_check_healthy_prints_the_ok_line)
{
    unsigned int before_reads = crux_test_entropy_reads();

    zassert_true(crux_entropy_boot_check(), "the boot check failed with a healthy device");
    zassert_str_equal(crux_entropy_boot_last_line(), EXPECTED_OK_LINE);
    zassert_true(crux_test_entropy_reads() > before_reads,
                 "the boot read never reached the device");
}

ZTEST(wolf_entropy, test_boot_check_refuses_when_the_first_read_fails)
{
    unsigned int before_reads = crux_test_entropy_reads();

    crux_test_entropy_set_failing(true);
    zassert_false(crux_entropy_boot_check(), "the boot check passed although every read fails");
    const char *line = crux_entropy_boot_last_line();
    zassert_true(strncmp(line, "CRUX-ENTROPY first-read=failed source=crux-test-entropy ", 55) == 0,
                 "%s", line);
    zassert_not_null(strstr(line, " compatible=crux,test-entropy bytes=32 status="), "%s", line);
    zassert_not_null(strstr(line, " device-ready=1"), "%s", line);
    const char *status = strstr(line, "status=");
    zassert_not_null(status);
    zassert_not_equal(atoi(status + 7), 0, "a failed read reports status 0: %s", line);
    zassert_true(crux_test_entropy_reads() > before_reads,
                 "the failed read never reached the device");
}

#endif

ZTEST_SUITE(wolf_entropy, NULL, NULL, before, NULL, NULL);
```

## src/test_entropy.c
```c
/* SPDX-License-Identifier: Apache-2.0 */
/* An entropy device for tests. It is not a source of entropy: the bytes are a fixed function of
 * their position. Reads can be made to fail the way a TRNG read can (-EIO), at any moment, and with
 * CONFIG_CRUX_TEST_ENTROPY_INIT_FAILS the device does not initialise, so it is not ready. It counts
 * the reads, so a test can show that the code under test went through it.
 */
#define DT_DRV_COMPAT crux_test_entropy

#include <errno.h>
#include <stdatomic.h>

#include <zephyr/device.h>
#include <zephyr/drivers/entropy.h>

#include "test_entropy.h"

static atomic_uint reads;
static atomic_bool failing;

unsigned int crux_test_entropy_reads(void)
{
    return atomic_load(&reads);
}

void crux_test_entropy_set_failing(bool value)
{
    atomic_store(&failing, value);
}

#if DT_HAS_COMPAT_STATUS_OKAY(DT_DRV_COMPAT)

static int test_entropy_get(const struct device *dev, uint8_t *buffer, uint16_t length)
{
    ARG_UNUSED(dev);
    atomic_fetch_add(&reads, 1U);
    if (atomic_load(&failing)) {
        return -EIO;
    }
    for (uint16_t index = 0; index < length; ++index) {
        buffer[index] = (uint8_t)(0xA5U ^ (index * 37U));
    }
    return 0;
}

static int test_entropy_get_isr(const struct device *dev, uint8_t *buffer, uint16_t length,
                                uint32_t flags)
{
    ARG_UNUSED(flags);
    return test_entropy_get(dev, buffer, length) == 0 ? (int)length : -EIO;
}

static int test_entropy_init(const struct device *dev)
{
    ARG_UNUSED(dev);
    return IS_ENABLED(CONFIG_CRUX_TEST_ENTROPY_INIT_FAILS) ? -EIO : 0;
}

static DEVICE_API(entropy, test_entropy_api) = {
    .get_entropy = test_entropy_get,
    .get_entropy_isr = test_entropy_get_isr,
};

DEVICE_DT_INST_DEFINE(0, test_entropy_init, NULL, NULL, NULL, PRE_KERNEL_1,
                      CONFIG_ENTROPY_INIT_PRIORITY, &test_entropy_api);

#endif
```

## src/test_entropy.h
```c
/* SPDX-License-Identifier: Apache-2.0 */
#ifndef CRUX_WOLF_ENTROPY_TEST_ENTROPY_H
#define CRUX_WOLF_ENTROPY_TEST_ENTROPY_H

#include <stdbool.h>

/* How many reads of the test device were asked for, whether or not they were served. */
unsigned int crux_test_entropy_reads(void);
/* Every read from now on fails with -EIO, or is served again. */
void crux_test_entropy_set_failing(bool failing);

#endif
```
