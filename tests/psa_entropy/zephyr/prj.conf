## CMakeLists.txt
```
cmake_minimum_required(VERSION 3.20.0)
# A native_sim application whose entropy device can be made to fail, to show what the Mbed TLS glue
# does with a failed read. The provider is TF-PSA-Crypto through Zephyr's Mbed TLS module, a project
# of the crux-secure-management west group. See docs/psa-crypto-qualification.md, finding 3.
find_package(Zephyr REQUIRED HINTS $ENV{ZEPHYR_BASE})
project(crux_psa_entropy C)
target_sources(app PRIVATE src/main.c src/test_entropy.c)
target_compile_options(app PRIVATE -Wall -Wextra -Werror)

if(CONFIG_CRUX_FAIL_CLOSED_ENTROPY)
    include("${CMAKE_CURRENT_LIST_DIR}/../../../cmake/CruxMbedtlsEntropy.cmake")
    crux_mbedtls_fail_closed_entropy()
endif()
```

## Kconfig
```
mainmenu "PSA entropy failure test"

source "Kconfig.zephyr"

config CRUX_TEST_ENTROPY
	bool "Entropy device for tests, whose reads can be made to fail"
	default y
	depends on DT_HAS_CRUX_TEST_ENTROPY_ENABLED
	select ENTROPY_HAS_DRIVER
	# As the RT1060 TRNG driver does, so that the PSA source is the legacy RNG over this device.
	select ENTROPY_NEEDS_PRNG
	help
	  A test-only driver. It is not a source of entropy.

config CRUX_TEST_ENTROPY_FAILS
	bool "Every read of the entropy device fails with -EIO"
	depends on CRUX_TEST_ENTROPY

config CRUX_FAIL_CLOSED_ENTROPY
	bool "Apply Crux's correction of Zephyr's Mbed TLS entropy glue"
	help
	  Replaces modules/mbedtls/zephyr_entropy.c with a build-local copy that does not fall back to
	  sys_rand_get(). See cmake/CruxMbedtlsEntropy.cmake.
```

## prj.conf
```kconfig
CONFIG_ZTEST=y
CONFIG_MAIN_STACK_SIZE=16384
CONFIG_ZTEST_STACK_SIZE=16384

CONFIG_ENTROPY_GENERATOR=y
CONFIG_XOSHIRO_RANDOM_GENERATOR=y

# Mbed TLS seeds an HMAC_DRBG from the entropy device, as on RT1060-EVKB.
CONFIG_MBEDTLS=y
CONFIG_MBEDTLS_PSA_CRYPTO_C=y
CONFIG_PSA_CRYPTO=y
CONFIG_PSA_CRYPTO_PROVIDER_MBEDTLS=y
CONFIG_MBEDTLS_PSA_CRYPTO_LEGACY_RNG=y
CONFIG_MBEDTLS_PSA_DRIVER_GET_ENTROPY=y
# The boot-time initialisation runs before the entropy device is ready. The test initialises PSA itself.
CONFIG_MBEDTLS_INIT=n
CONFIG_MBEDTLS_ENABLE_HEAP=y
CONFIG_MBEDTLS_HEAP_SIZE=60000

CONFIG_PSA_WANT_ALG_SHA_256=y
CONFIG_PSA_WANT_ALG_HMAC=y
```

## boards/native_sim_native_64.overlay
```dts
/* Replace native_sim's test generator with a device whose reads can fail. */
/ {
	chosen {
		zephyr,entropy = &crux_test_entropy;
	};

	crux_test_entropy: crux-test-entropy {
		compatible = "crux,test-entropy";
	};
};

&rng {
	status = "disabled";
};
```

## dts/bindings/crux,test-entropy.yaml
```yaml
description: Entropy device for tests, whose reads can be made to fail. Not a source of entropy.

compatible: "crux,test-entropy"

include: base.yaml
```

## src/main.c
```c
/* SPDX-License-Identifier: Apache-2.0 */
/* What Zephyr's Mbed TLS glue does when the entropy device fails.
 *
 * Mbed TLS seeds the PSA random generator from the entropy device. Zephyr's glue, unchanged,
 * answers a failed read with sys_rand_get() and reports full entropy, and on RT1060-EVKB
 * sys_rand_get() is not cryptographically secure. Crux requires a failed read to fail PSA
 * instead (owner decision of 6 November 2026, docs/psa-crypto-qualification.md, finding 3).
 * The three Twister configurations in testcase.yaml state the three outcomes:
 *   - a healthy device, with the correction: PSA works;
 *   - a failing device, with the correction: PSA does not initialise;
 *   - a failing device, without it: PSA initialises. This control records that the upstream
 *     behaviour exists. If it fails, upstream changed and the correction can be reconsidered.
 * Every outcome also requires that the device was read, so a pass cannot come from another
 * source.
 */
#include <zephyr/ztest.h>

#include <psa/crypto.h>

#include "test_entropy.h"

ZTEST(psa_entropy, test_initialisation_follows_the_entropy_read)
{
    psa_status_t status = psa_crypto_init();

    TC_PRINT("psa_crypto_init: %d, entropy reads: %u\n", (int)status, crux_test_entropy_reads());
    zassert_true(crux_test_entropy_reads() > 0U, "PSA never read the test entropy device");

    if (IS_ENABLED(CONFIG_CRUX_TEST_ENTROPY_FAILS) && IS_ENABLED(CONFIG_CRUX_FAIL_CLOSED_ENTROPY)) {
        zassert_not_equal(status, PSA_SUCCESS,
                          "PSA initialised although every entropy read failed");
        return;
    }

    zassert_equal(status, PSA_SUCCESS, "PSA did not initialise: %d", (int)status);
    uint8_t bytes[32] = {0};
    zassert_equal(psa_generate_random(bytes, sizeof(bytes)), PSA_SUCCESS, "no random bytes");
}

ZTEST_SUITE(psa_entropy, NULL, NULL, NULL, NULL, NULL);
```

## src/test_entropy.c
```c
/* SPDX-License-Identifier: Apache-2.0 */
/* An entropy device for tests. It is not a source of entropy: the bytes repeat, and with
 * CONFIG_CRUX_TEST_ENTROPY_FAILS every read fails the way a TRNG read can. It counts the reads,
 * so a test can show that the code under test went through it.
 */
#define DT_DRV_COMPAT crux_test_entropy

#include <errno.h>
#include <stdatomic.h>
#include <string.h>

#include <zephyr/device.h>
#include <zephyr/drivers/entropy.h>

#include "test_entropy.h"

static atomic_uint reads;

unsigned int crux_test_entropy_reads(void)
{
    return atomic_load(&reads);
}

static int test_entropy_get(const struct device *dev, uint8_t *buffer, uint16_t length)
{
    ARG_UNUSED(dev);
    atomic_fetch_add(&reads, 1U);
    if (IS_ENABLED(CONFIG_CRUX_TEST_ENTROPY_FAILS)) {
        return -EIO;
    }
    for (uint16_t index = 0; index < length; ++index) {
        buffer[index] = (uint8_t)(0xA5U ^ (index * 37U));
    }
    return 0;
}

static int test_entropy_get_isr(const struct device *dev, uint8_t *buffer, uint16_t length,
                                uint32_t flags)
{
    ARG_UNUSED(flags);
    return test_entropy_get(dev, buffer, length) == 0 ? (int)length : -EIO;
}

static int test_entropy_init(const struct device *dev)
{
    ARG_UNUSED(dev);
    return 0;
}

static DEVICE_API(entropy, test_entropy_api) = {
    .get_entropy = test_entropy_get,
    .get_entropy_isr = test_entropy_get_isr,
};

DEVICE_DT_INST_DEFINE(0, test_entropy_init, NULL, NULL, NULL, POST_KERNEL,
                      CONFIG_ENTROPY_INIT_PRIORITY, &test_entropy_api);
```

## src/test_entropy.h
```c
/* SPDX-License-Identifier: Apache-2.0 */
#ifndef CRUX_PSA_ENTROPY_TEST_ENTROPY_H
#define CRUX_PSA_ENTROPY_TEST_ENTROPY_H

/* How many times a read of the test entropy device was asked for. */
unsigned int crux_test_entropy_reads(void);

#endif
```
