## CMakeLists.txt
```
# Application image for the functional level. Crux arrives only as EXTRA_ZEPHYR_MODULES.
cmake_minimum_required(VERSION 3.20.0)
find_package(Zephyr REQUIRED HINTS $ENV{ZEPHYR_BASE})
project(consumer_poc_app LANGUAGES C)
target_sources(app PRIVATE src/main.c ../src/app_run.c ../src/periodic.c)
target_include_directories(app PRIVATE ../include)
target_link_libraries(app PRIVATE crux::time crux::thread)
target_compile_options(app PRIVATE -Wall -Wextra -Werror)
if(CONSUMER_DEFECT_REBASE)
    target_compile_definitions(app PRIVATE CONSUMER_DEFECT_REBASE)
endif()
```

## prj.conf
```kconfig
CONFIG_STD_C17=y
CONFIG_CRUX_TIME=y
CONFIG_CRUX_THREAD=y
CONFIG_RTC=n
CONFIG_PRINTK=y
CONFIG_LOG=n
CONFIG_SYS_CLOCK_TICKS_PER_SEC=1000
CONFIG_MAIN_STACK_SIZE=4096
```

## src/main.c
```c
/* Console lines are this application's own contract with its functional oracle. */
#include "app_run.h"

#include <zephyr/sys/printk.h>

static void print_cycle(void *context, int cycle, uint64_t skipped)
{
    (void)context;
    printk("APP cycle=%d skipped=%llu\n", cycle, (unsigned long long)skipped);
}

int main(void)
{
    printk("APP ready\n");
    int result = app_run(print_cycle, NULL);
    printk("APP done result=%d\n", result);
    return 0;
}
```
