/*
 * The line asks for open drain, which an input-only line cannot use. The GPIO emulator reports
 * -ENOTSUP for it, so the provider's mapping of a native "unsupported" result is exercised.
 */
/ {
	aliases { crux-gpio0 = &crux_gpio0; };
	crux_gpio_keys {
		compatible = "gpio-keys";
		crux_gpio0: input_0 {
			gpios = <&gpio0 0 (GPIO_ACTIVE_LOW | GPIO_OPEN_DRAIN)>;
		};
	};
};
