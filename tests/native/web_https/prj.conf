## CMakeLists.txt
```
# SPDX-License-Identifier: Apache-2.0
# The web adapter over HTTPS on native_sim, on the management composition (Issue #185). One image per
# provider profile, chosen with -DCRUX_WEB_PROFILE=mbed or wolf. The wolf profile needs a ZEPHYR_BASE with
# the socket patch: scripts/prepare-wolf-tls-zephyr.sh. It operates no hardware.
cmake_minimum_required(VERSION 3.20.0)
get_filename_component(CRUX_ROOT "${CMAKE_CURRENT_LIST_DIR}/../../.." ABSOLUTE)
set(composition_dir "${CRUX_ROOT}/tests/native/management_composition")
set(CRUX_WEB_PROFILE mbed CACHE STRING "Provider profile: mbed or wolf")
set(profile_files "${CRUX_ROOT}/tests/native/tls_offload_probe/${CRUX_WEB_PROFILE}.conf"
  "${composition_dir}/profile-psa.conf")
if(CRUX_WEB_PROFILE STREQUAL "mbed")
  list(APPEND profile_files "${composition_dir}/mbed-threading.conf")
elseif(NOT CRUX_WEB_PROFILE STREQUAL "wolf")
  message(FATAL_ERROR "CRUX_WEB_PROFILE must be mbed or wolf")
endif()
list(APPEND profile_files "${CMAKE_CURRENT_LIST_DIR}/${CRUX_WEB_PROFILE}.conf")
set(EXTRA_CONF_FILE "${profile_files}")
set(DTC_OVERLAY_FILE "${composition_dir}/app.overlay")
list(APPEND ZEPHYR_EXTRA_MODULES "${CRUX_ROOT}")
find_package(Zephyr REQUIRED HINTS $ENV{ZEPHYR_BASE})
project(crux_web_https_native LANGUAGES C)
if(NOT CONFIG_BOARD_NATIVE_SIM)
  message(FATAL_ERROR "This suite is restricted to native_sim, and it operates no hardware")
endif()
include("${composition_dir}/composition/composition.cmake")
crux_native_management_compose()
include(${CRUX_ROOT}/cmake/CruxConsumerBoundary.cmake)
include(${CRUX_ROOT}/cmake/CruxWebRoutes.cmake)
include(${CMAKE_CURRENT_LIST_DIR}/nsos_rdhup.cmake)

# The plain HTTP suite's application, with the real Access core in place of its double.
set(web_http "${CRUX_ROOT}/tests/native/web_http")
add_library(web_project_routes STATIC ${web_http}/src/project_routes.c)
target_link_libraries(web_project_routes PRIVATE crux::web)
target_compile_options(web_project_routes PRIVATE -Wall -Wextra -Werror)
crux_assert_portable_consumer(web_project_routes)

target_sources(app PRIVATE src/main.c src/tls_probe.c ${web_http}/src/probe_routes.c
  ${web_http}/src/upload_probe.c ${web_http}/src/socket_shim.c)
target_include_directories(app PRIVATE ${web_http}/src)
target_sources(native_simulator INTERFACE ${web_http}/src/host_socket.c)
target_link_options(app PUBLIC -Wl,--wrap=z_impl_zsock_shutdown -Wl,--wrap=z_impl_zsock_sendto)
target_link_libraries(app PRIVATE crux_web_adapter web_project_routes)
crux_web_routes(app SOURCES ${web_http}/src/probe_routes.c ${web_http}/src/project_routes.c
  src/tls_probe.c ZEPHYR_RESOURCES REVIEWED reviewed-routes.txt)
```

## prj.conf
```kconfig
# The web adapter over HTTPS on the management composition, over the native socket offload. The TLS stack
# and the PSA provider come from the profile files that CMakeLists.txt names. Test only: the entropy is
# test-only and the certificate's key is public. See docs/https-composition.md.
CONFIG_MAIN_STACK_SIZE=32768
CONFIG_HEAP_MEM_POOL_SIZE=32768
CONFIG_STD_C17=y
# The host's TCP stack keeps real time, so the simulated clock must too. #242 found a handshake timing out
# without this.
CONFIG_NATIVE_SIM_SLOWDOWN_TO_REAL_TIME=y
# The server's wildcard pass needs Zephyr's fnmatch, not the host's. See docs/web-contract.md.
CONFIG_MINIMAL_LIBC=y

CONFIG_CRUX_WEB=y
CONFIG_CRUX_WEB_PORT=18443
# Shortened as in tests/native/web_http, so that the same cases and bounds apply.
CONFIG_HTTP_SERVER_CLIENT_INACTIVITY_TIMEOUT=3
CONFIG_CRUX_WEB_REQUEST_DEADLINE_MS=2000
CONFIG_CRUX_WEB_SEND_TIMEOUT_MS=500
CONFIG_CRUX_WEB_RESPONSE_DEADLINE_MS=1500

CONFIG_NETWORKING=y
CONFIG_NET_IPV4=y
CONFIG_NET_SOCKETS=y
CONFIG_NET_SOCKETS_OFFLOAD=y
CONFIG_NET_DRIVERS=y
CONFIG_NET_NATIVE_OFFLOADED_SOCKETS=y
CONFIG_ETH_NATIVE_TAP=n
CONFIG_NET_SOCKETS_SOCKOPT_TLS=y
CONFIG_TLS_CREDENTIALS=y
CONFIG_TLS_MAX_CREDENTIALS_NUMBER=4
CONFIG_NET_SOCKETS_TLS_MAX_CONTEXTS=6
CONFIG_ZVFS_OPEN_MAX=24
CONFIG_ZVFS_POLL_MAX=16
CONFIG_ZVFS_EVENTFD=y

# Test-only on native_sim. See docs/psa-crypto-design.md.
CONFIG_ENTROPY_GENERATOR=y
CONFIG_HWINFO=y

CONFIG_CRUX_TIME=y
CONFIG_CRUX_THREAD=y
CONFIG_CRUX_THREAD_STACK_BYTES=8192
CONFIG_CRUX_SYNC=y
CONFIG_CRUX_SYNC_MUTEX_COUNT=16
CONFIG_CRUX_NETIF=y
CONFIG_CRUX_SYSTEM=y
CONFIG_WATCHDOG=y
CONFIG_REBOOT=y

CONFIG_FILE_SYSTEM=y
CONFIG_FILE_SYSTEM_MKFS=y
CONFIG_FAT_FILESYSTEM_ELM=y
CONFIG_FS_FATFS_LFN=y
CONFIG_FS_FATFS_LFN_MODE_STACK=y
CONFIG_FS_FATFS_MAX_LFN=127
CONFIG_FS_FATFS_MOUNT_MKFS=n
CONFIG_FS_FATFS_REENTRANT=y
CONFIG_FS_FATFS_NUM_FILES=6
CONFIG_DISK_DRIVERS=y
CONFIG_DISK_DRIVER_FLASH=y
CONFIG_CRUX_FILE_FATFS_SIMULATOR=y

# The Crux Logging provider, on the emulated UART it accepts on native_sim.
CONFIG_CRUX_LOGGING=y
CONFIG_SERIAL=y
CONFIG_EMUL=y
CONFIG_UART_EMUL=y
CONFIG_LOG=y
CONFIG_LOG_MODE_DEFERRED=y
CONFIG_LOG_MODE_OVERFLOW=n
CONFIG_LOG_BLOCK_IN_THREAD=n
CONFIG_LOG_PROCESS_THREAD=y
CONFIG_LOG_PROCESS_THREAD_STACK_SIZE=2048
CONFIG_LOG_PROCESS_THREAD_CUSTOM_PRIORITY=y
CONFIG_LOG_PROCESS_THREAD_PRIORITY=14
CONFIG_LOG_BUFFER_SIZE=4096
CONFIG_LOG_MAX_LEVEL=4
CONFIG_LOG_RUNTIME_FILTERING=n
CONFIG_LOG_BACKEND_UART=y
CONFIG_LOG_BACKEND_NATIVE_POSIX=n
CONFIG_LOG_BACKEND_UART_ASYNC=n
CONFIG_LOG_PRINTK=n
CONFIG_THREAD_MONITOR=y
CONFIG_THREAD_NAME=y
CONFIG_SHELL_LOG_BACKEND=n

# Test image only: the probe reads each heap's current and largest use.
CONFIG_SYS_HEAP_RUNTIME_STATS=y
CONFIG_SYS_HEAP_ARRAY_SIZE=8
```

## mbed.conf
```kconfig
# The Mbed profile's additions for this image. The heap holds the declared connections: sized in
# docs/https-composition.md from what this image measures.
CONFIG_MBEDTLS_HEAP_SIZE=120000
# Test image only: the probe reads the heap's current and largest use.
CONFIG_MBEDTLS_MEMORY_DEBUG=y
```

## wolf.conf
```kconfig
# The Wolf profile's additions for this image. wolfSSL allocates from the C library's arena, which the
# minimal C library bounds as a target's does: sized in docs/https-composition.md.
CONFIG_COMMON_LIBC_MALLOC_ARENA_SIZE=262144
```

## src/main.c
```c
/*
 * The web adapter over HTTPS, on the management composition of Issue #242 and its declared test
 * certificate. tests/native/web_https/https_driver.py is the client, and runs the plain HTTP suite
 * of tests/native/web_http over TLS. Test only: entropy is test-only and the certificate's key is
 * public.
 *
 * The real Access core enforces each route's class. The session lookup and the CSRF rule are
 * stand-ins for Issue #186: a cookie names one of two real sessions that start logs in.
 */
#include "crux_native_management.h"
#include "web_probe.h"

#include <crux_access_adapter.h>

#include <stdbool.h>
#include <string.h>
#include <zephyr/kernel.h>

#include "cmdline.h"
#include "soc.h"

#define VIEWER_USER "viewer1"
#define VIEWER_FIRST_PASSWORD "first password of an account"
#define VIEWER_PASSWORD "a password changed at first login"

void crux_nsos_set_rdhup(int on);

static bool no_tls_credential;
static bool no_rdhup;
static crux_access_session_t admin_session;
static crux_access_session_t viewer_session;

static void https_options(void)
{
    static struct args_struct_t options[] = {
        {.option = "no-tls-credential",
         .is_switch = true,
         .type = 'b',
         .dest = &no_tls_credential,
         .descript = "Start with no certificate under the service's tag, for a negative case"},
        {.option = "no-rdhup",
         .is_switch = true,
         .type = 'b',
         .dest = &no_rdhup,
         .descript = "Report a peer's FIN as the unmodified offload does, as a control"},
        ARG_TABLE_ENDMARKER};

    native_add_command_line_opts(options);
}
NATIVE_TASK(https_options, PRE_BOOT_1, 1);

static crux_web_auth_t https_authenticate(const crux_web_request_head_t *head,
                                          crux_access_session_t *session, void *context)
{
    const char *cookie = head->cookie;

    (void)context;
    if (cookie == NULL) {
        return CRUX_WEB_AUTH_NO_SESSION;
    }
    if (strstr(cookie, "crux_session=admin") != NULL) {
        *session = admin_session;
    } else if (strstr(cookie, "crux_session=viewer") != NULL) {
        *session = viewer_session;
    } else {
        return CRUX_WEB_AUTH_NO_SESSION;
    }
    if (head->method != CRUX_WEB_GET && head->xsrf_token == NULL) {
        return CRUX_WEB_AUTH_CSRF_REJECTED;
    }
    return CRUX_WEB_AUTH_OK;
}

static bool sessions_ready(void)
{
    uint32_t retry_after_ms = 0;

    return crux_native_management_provision_test_account() == CRUX_ACCESS_OK &&
           crux_native_management_login(CRUX_NATIVE_MANAGEMENT_TEST_USER,
                                        CRUX_NATIVE_MANAGEMENT_TEST_PASSWORD,
                                        &admin_session) == CRUX_ACCESS_OK &&
           crux_access_account_create(admin_session, VIEWER_USER,
                                      CRUX_NATIVE_MANAGEMENT_ROLE_VIEWER, VIEWER_FIRST_PASSWORD,
                                      strlen(VIEWER_FIRST_PASSWORD)) == CRUX_ACCESS_OK &&
           crux_native_management_login(VIEWER_USER, VIEWER_FIRST_PASSWORD, &viewer_session) ==
               CRUX_ACCESS_OK &&
           crux_access_account_change_password(
               viewer_session, VIEWER_FIRST_PASSWORD, strlen(VIEWER_FIRST_PASSWORD),
               VIEWER_PASSWORD, strlen(VIEWER_PASSWORD), &retry_after_ms) == CRUX_ACCESS_OK;
}

int main(void)
{
    static const crux_web_config_t config = {
        .authenticate = https_authenticate,
        .request_deadline_ms = CONFIG_CRUX_WEB_REQUEST_DEADLINE_MS,
        .handler_limit_ms = 100u,
    };

    crux_nsos_set_rdhup(no_rdhup ? 0 : 1);
    if (crux_native_management_start() != CRUX_NATIVE_MANAGEMENT_STARTED || !sessions_ready()) {
        printk("CRUX_WEB_START_FAILED composition\n");
        return 1;
    }
    if (!no_tls_credential &&
        crux_native_management_tls_test_credentials(CONFIG_CRUX_WEB_TLS_SEC_TAG) != 0) {
        printk("CRUX_WEB_START_FAILED credential\n");
        return 1;
    }
    web_probe_fill_large_body();
    if (crux_web_start(&config) != CRUX_WEB_OK) {
        printk("CRUX_WEB_START_FAILED web\n");
        return 1;
    }
    printk("CRUX_WEB_READY %d tls %s rdhup %s\n", CONFIG_CRUX_WEB_PORT,
           no_tls_credential ? "none" : "test-certificate", no_rdhup ? "off" : "on");
    return 0;
}
```

## src/tls_probe.c
```c
/*
 * Probes for the HTTPS measurements of Issue #185. Not for a product.
 *
 * - /probe/tls/stats: sends the server made and the TLS layer made beneath them, and the TLS
 * library's heap: Mbed TLS's own buffer, or the C library's arena that wolfSSL allocates from.
 * - /probe/tls/hold/{bytes}: takes that much from the TLS library's allocator and keeps it, so that
 * the next accept meets a full heap. 0 gives it all back.
 * - /probe/raw/split and /probe/raw/joined: one small response, with its five headers passed one by
 * one or in one value. They bypass the adapter, so the server's own writes are what is measured.
 * - /probe/raw/nodelay: sets TCP_NODELAY on this connection, then answers as split does.
 */
#include "web_probe.h"

#include <crux/web.h>

#include <stdio.h>
#include <stdlib.h>
#include <zephyr/kernel.h>
#include <zephyr/net/http/server.h>
#include <zephyr/net/http/service.h>
#include <zephyr/net/socket.h>
#include <zephyr/sys/sys_heap.h>
#include <zephyr/sys/util.h>

#if defined(CONFIG_MBEDTLS_MEMORY_DEBUG)
#include <mbedtls/memory_buffer_alloc.h>
#include <mbedtls/platform.h>
#define TLS_ALLOC(bytes) mbedtls_calloc(1, (bytes))
#define TLS_FREE(pointer) mbedtls_free(pointer)
#define TLS_HEAP_SIZE CONFIG_MBEDTLS_HEAP_SIZE
#else
#define TLS_HEAP_SIZE 0
#define TLS_ALLOC(bytes) malloc(bytes)
#define TLS_FREE(pointer) free(pointer)
#endif

#define HELD_MAX 96

static void *held[HELD_MAX];
static size_t held_bytes;

static crux_web_result_t on_tls_stats(crux_web_request_t *request, crux_access_session_t session,
                                      void *context)
{
    char body[512];
    size_t used = 0u;
    size_t current = 0u;
    size_t largest = 0u;
    size_t blocks = 0u;
    struct sys_heap **heaps;
    int count = sys_heap_array_get(&heaps);

    (void)session;
    (void)context;
#if defined(CONFIG_MBEDTLS_MEMORY_DEBUG)
    mbedtls_memory_buffer_alloc_cur_get(&current, &blocks);
    mbedtls_memory_buffer_alloc_max_get(&largest, &blocks);
#else
    (void)blocks;
#endif
    used += (size_t)snprintf(
        body, sizeof(body),
        "{\"outer_sends\":%u,\"inner_sends\":%u,\"real_eagain\":%u,\"mbed_heap\":%zu,"
        "\"mbed_heap_max\":%zu,\"mbed_heap_size\":%d,\"held\":%zu,\"heaps\":[",
        web_probe_outer_sends(), web_probe_inner_sends(), web_probe_real_eagain(), current, largest,
        TLS_HEAP_SIZE, held_bytes);
    for (int index = 0; index < count && used < sizeof(body); ++index) {
        struct sys_memory_stats stats;

        if (sys_heap_runtime_stats_get(heaps[index], &stats) != 0) {
            continue;
        }
        used += (size_t)snprintf(body + used, sizeof(body) - used,
                                 "%s{\"bytes\":%zu,\"used\":%zu,\"max\":%zu}", index ? "," : "",
                                 heaps[index]->init_bytes, stats.allocated_bytes,
                                 stats.max_allocated_bytes);
    }
    if (used + 3u > sizeof(body)) {
        return crux_web_respond_error(request, 503, "not_ready");
    }
    used += (size_t)snprintf(body + used, sizeof(body) - used, "]}");
    return crux_web_respond(request, 200, NULL, body, used);
}

static crux_web_result_t on_tls_hold(crux_web_request_t *request, crux_access_session_t session,
                                     void *context)
{
    char text[16];
    char body[64];
    unsigned long bytes;
    int length;

    (void)session;
    (void)context;
    if (crux_web_path_param(request, 0u, text, sizeof(text)) != CRUX_WEB_OK) {
        return crux_web_respond_error(request, 404, "not_found");
    }
    bytes = strtoul(text, NULL, 10);
    if (bytes == 0u) {
        for (size_t index = 0; index < HELD_MAX; ++index) {
            TLS_FREE(held[index]);
            held[index] = NULL;
        }
        held_bytes = 0u;
    } else {
        for (size_t index = 0; index < HELD_MAX; ++index) {
            if (held[index] == NULL) {
                held[index] = TLS_ALLOC(bytes);
                held_bytes += held[index] != NULL ? bytes : 0u;
                break;
            }
        }
    }
    length = snprintf(body, sizeof(body), "{\"held\":%zu}", held_bytes);
    return crux_web_respond(request, 200, NULL, body, (size_t)length);
}

static crux_web_result_t on_tls_reset_max(crux_web_request_t *request,
                                          crux_access_session_t session, void *context)
{
    struct sys_heap **heaps;
    int count = sys_heap_array_get(&heaps);

    (void)session;
    (void)context;
#if defined(CONFIG_MBEDTLS_MEMORY_DEBUG)
    mbedtls_memory_buffer_alloc_max_reset();
#endif
    for (int index = 0; index < count; ++index) {
        (void)sys_heap_runtime_stats_reset_max(heaps[index]);
    }
    return crux_web_respond(request, 200, NULL, "{}", 2u);
}

CRUX_WEB_ROUTE(tls_stats, "/probe/tls/stats", CRUX_WEB_GET, CRUX_WEB_PUBLIC, on_tls_stats, NULL);
CRUX_WEB_ROUTE(tls_hold, "/probe/tls/hold/{bytes}", CRUX_WEB_GET, CRUX_WEB_PUBLIC, on_tls_hold,
               NULL);
CRUX_WEB_ROUTE(tls_reset_max, "/probe/tls/reset-max", CRUX_WEB_GET, CRUX_WEB_PUBLIC,
               on_tls_reset_max, NULL);

/* The same five headers that the adapter sends with a JSON response. */
static const struct http_header split_headers[] = {
    {"Content-Type", "application/json"},
    {"Content-Security-Policy", "default-src 'self'; frame-ancestors 'none'"},
    {"X-Content-Type-Options", "nosniff"},
    {"Referrer-Policy", "no-referrer"},
    {"Cache-Control", "no-store"},
};
/* The server writes a name, ": ", the value and a line end, so a value can carry the other lines.
 */
static const struct http_header joined_headers[] = {
    {"Content-Type", "application/json\r\n"
                     "Content-Security-Policy: default-src 'self'; frame-ancestors 'none'\r\n"
                     "X-Content-Type-Options: nosniff\r\n"
                     "Referrer-Policy: no-referrer\r\n"
                     "Cache-Control: no-store"},
};
static const char raw_body[] = "{\"ok\":true}";

static int answer(struct http_response_ctx *response, const struct http_header *headers,
                  size_t count)
{
    response->status = HTTP_200_OK;
    response->headers = headers;
    response->header_count = count;
    response->body = (const uint8_t *)raw_body;
    response->body_len = sizeof(raw_body) - 1u;
    response->final_chunk = true;
    return 0;
}

static int raw_callback(struct http_client_ctx *client, enum http_transaction_status status,
                        const struct http_request_ctx *request, struct http_response_ctx *response,
                        void *user_data)
{
    ARG_UNUSED(request);
    if (status != HTTP_SERVER_REQUEST_DATA_FINAL) {
        return 0;
    }
    if (user_data == joined_headers) {
        return answer(response, joined_headers, ARRAY_SIZE(joined_headers));
    }
    if (user_data == NULL) {
        int one = 1;

        (void)zsock_setsockopt(client->fd, NET_IPPROTO_TCP, ZSOCK_TCP_NODELAY, &one, sizeof(one));
    }
    return answer(response, split_headers, ARRAY_SIZE(split_headers));
}

static struct http_resource_detail_dynamic raw_split_detail = {
    .common = {.bitmask_of_supported_http_methods = BIT(HTTP_GET),
               .type = HTTP_RESOURCE_TYPE_DYNAMIC},
    .cb = raw_callback,
    .user_data = (void *)split_headers,
};
static struct http_resource_detail_dynamic raw_joined_detail = {
    .common = {.bitmask_of_supported_http_methods = BIT(HTTP_GET),
               .type = HTTP_RESOURCE_TYPE_DYNAMIC},
    .cb = raw_callback,
    .user_data = (void *)joined_headers,
};
static struct http_resource_detail_dynamic raw_nodelay_detail = {
    .common = {.bitmask_of_supported_http_methods = BIT(HTTP_GET),
               .type = HTTP_RESOURCE_TYPE_DYNAMIC},
    .cb = raw_callback,
    .user_data = NULL,
};

HTTP_RESOURCE_DEFINE(probe_raw_split, crux_web_service, "/probe/raw/split", &raw_split_detail);
HTTP_RESOURCE_DEFINE(probe_raw_joined, crux_web_service, "/probe/raw/joined", &raw_joined_detail);
HTTP_RESOURCE_DEFINE(probe_raw_nodelay, crux_web_service, "/probe/raw/nodelay",
                     &raw_nodelay_detail);
```
