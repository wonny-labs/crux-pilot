## CMakeLists.txt
```
# SPDX-License-Identifier: Apache-2.0
cmake_minimum_required(VERSION 3.20.0)
find_package(Zephyr REQUIRED HINTS $ENV{ZEPHYR_BASE})
project(crux_web_http_native LANGUAGES C)
if(NOT CONFIG_BOARD_NATIVE_SIM)
  message(FATAL_ERROR "This suite is restricted to native_sim, and it operates no hardware")
endif()
get_filename_component(CRUX_ROOT "${CMAKE_CURRENT_LIST_DIR}/../../.." ABSOLUTE)
include(${CRUX_ROOT}/cmake/CruxConsumerBoundary.cmake)
include(${CRUX_ROOT}/cmake/CruxWebRoutes.cmake)

# A project's route: it compiles against crux::web alone, with no Zephyr requirement.
add_library(web_project_routes STATIC src/project_routes.c)
target_link_libraries(web_project_routes PRIVATE crux::web)
target_compile_options(web_project_routes PRIVATE -Wall -Wextra -Werror)
crux_assert_portable_consumer(web_project_routes)

target_sources(app PRIVATE src/main.c src/probe_routes.c src/access_double.c src/upload_probe.c
  src/socket_shim.c)
target_sources(native_simulator INTERFACE ${CMAKE_CURRENT_LIST_DIR}/src/host_socket.c)
target_link_options(app PUBLIC -Wl,--wrap=z_impl_zsock_shutdown -Wl,--wrap=z_impl_zsock_sendto)
target_link_libraries(app PRIVATE crux_web_adapter web_project_routes)
target_compile_options(app PRIVATE -Wall -Wextra -Werror)
crux_web_routes(app SOURCES src/probe_routes.c src/project_routes.c ZEPHYR_RESOURCES
  REVIEWED reviewed-routes.txt)
```

## prj.conf
```kconfig
# The adapter over the real server, on the native socket offload and plain HTTP. TLS is Issue #185.
CONFIG_NETWORKING=y
CONFIG_NET_IPV4=y
CONFIG_NET_IPV6=n
CONFIG_NET_TCP=y
CONFIG_NET_SOCKETS=y
CONFIG_NET_DRIVERS=y
CONFIG_NET_SOCKETS_OFFLOAD=y
CONFIG_NET_NATIVE_OFFLOADED_SOCKETS=y
CONFIG_ETH_NATIVE_TAP=n
# The host's C library takes Zephyr's fnmatch flags with other meanings, so the server's wildcard pass
# would not behave as on a target. This selects Zephyr's own fnmatch.
CONFIG_MINIMAL_LIBC=y
CONFIG_ZVFS_OPEN_MAX=16
CONFIG_ZVFS_POLL_MAX=16

CONFIG_CRUX_WEB=y
CONFIG_CRUX_WEB_PLAIN_HTTP_FOR_TESTS=y
CONFIG_CRUX_WEB_PORT=18184
# Shortened so that the measurements finish quickly. The results scale with these.
CONFIG_HTTP_SERVER_CLIENT_INACTIVITY_TIMEOUT=3
CONFIG_CRUX_WEB_REQUEST_DEADLINE_MS=2000
CONFIG_CRUX_WEB_SEND_TIMEOUT_MS=500
CONFIG_CRUX_WEB_RESPONSE_DEADLINE_MS=1500

CONFIG_NATIVE_SIM_SLOWDOWN_TO_REAL_TIME=y
CONFIG_HEAP_MEM_POOL_SIZE=16384
CONFIG_MAIN_STACK_SIZE=4096
CONFIG_LOG=n
```

## src/main.c
```c
/* Starts the adapter on plain HTTP over the native socket offload. test_driver.py is the client. */
#include "web_probe.h"

#include <zephyr/kernel.h>

int main(void)
{
    static const crux_web_config_t config = {
        .authenticate = web_probe_authenticate,
        .request_deadline_ms = CONFIG_CRUX_WEB_REQUEST_DEADLINE_MS,
        .handler_limit_ms = 100u,
    };

    web_probe_fill_large_body();
    if (crux_web_start(&config) != CRUX_WEB_OK) {
        printk("CRUX_WEB_START_FAILED\n");
        return 1;
    }
    printk("CRUX_WEB_READY %d\n", CONFIG_CRUX_WEB_PORT);
    return 0;
}
```

## src/access_double.c
```c
/* A stand-in for the Access core and the session lookup of Issue #186. Access has no Zephyr
 * composition until Issue #242, and the Host suites run enforcement on the real core. The cookie
 * names a session. */
#include "crux_web_adapter.h"
#include "web_probe.h"

#include <string.h>

#define SESSION_ADMIN 1u
#define SESSION_VIEWER 2u

crux_access_result_t crux_access_check(crux_access_session_t session, const char *permission)
{
    if (session.value == SESSION_ADMIN) {
        return CRUX_ACCESS_OK;
    }
    if (session.value == SESSION_VIEWER) {
        return strcmp(permission, "network.read") == 0 || strcmp(permission, "app.pump.read") == 0
                   ? CRUX_ACCESS_OK
                   : CRUX_ACCESS_ERR_DENIED;
    }
    return CRUX_ACCESS_ERR_SESSION_INVALID;
}

crux_access_result_t crux_access_permitted(crux_access_session_t session, const char *permission,
                                           bool *permitted)
{
    crux_access_result_t result = crux_access_check(session, permission);

    if (result == CRUX_ACCESS_ERR_SESSION_INVALID) {
        return result;
    }
    *permitted = result == CRUX_ACCESS_OK;
    return CRUX_ACCESS_OK;
}

crux_web_auth_t web_probe_authenticate(const crux_web_request_head_t *head,
                                       crux_access_session_t *session, void *context)
{
    const char *cookie = head->cookie;

    (void)context;
    if (cookie == NULL) {
        return CRUX_WEB_AUTH_NO_SESSION;
    }
    if (strstr(cookie, "crux_session=admin") != NULL) {
        session->value = SESSION_ADMIN;
    } else if (strstr(cookie, "crux_session=viewer") != NULL) {
        session->value = SESSION_VIEWER;
    } else {
        return CRUX_WEB_AUTH_NO_SESSION;
    }
    /* Enough of #186's rule to show the header reaches this port on a state-changing request. */
    if (head->method != CRUX_WEB_GET && head->xsrf_token == NULL) {
        return CRUX_WEB_AUTH_CSRF_REJECTED;
    }
    return CRUX_WEB_AUTH_OK;
}
```

## src/host_shutdown.c
```c
/* Runs on the host side of native_sim. See shutdown_shim.c. */
#include <sys/socket.h>

int web_host_shutdown(int host_fd, int how);

int web_host_shutdown(int host_fd, int how)
{
    return shutdown(host_fd, how);
}
```

## src/host_socket.c
```c
/* Runs on the host side of native_sim. See socket_shim.c. */
#include <sys/socket.h>

int web_host_shutdown(int host_fd, int how);
int web_host_set_send_buffer(int host_fd, int size);

int web_host_shutdown(int host_fd, int how)
{
    return shutdown(host_fd, how);
}

int web_host_set_send_buffer(int host_fd, int size)
{
    return setsockopt(host_fd, SOL_SOCKET, SO_SNDBUF, &size, sizeof(size));
}
```

## src/probe_routes.c
```c
/* The API's shape for the driver, plus probes that measure the server thread. Not for a product. */
#include "web_probe.h"

#include <crux/web.h>
#include <stdio.h>
#include <stdlib.h>
#include <string.h>
#include <zephyr/kernel.h>

#define LARGE_BODY_SIZE (8u * 1024u * 1024u)
static uint8_t large_body[LARGE_BODY_SIZE];

void web_probe_fill_large_body(void)
{
    for (size_t index = 0; index < sizeof(large_body); ++index) {
        large_body[index] = (uint8_t)('a' + index % 26u);
    }
}

static crux_web_result_t respond_json(crux_web_request_t *request, const char *route)
{
    char body[96];
    int length = snprintf(body, sizeof(body), "{\"route\":\"%s\",\"body\":%zu}", route,
                          crux_web_body_length(request));

    return crux_web_respond(request, 200, NULL, body, (size_t)length);
}

static crux_web_result_t on_named(crux_web_request_t *request, crux_access_session_t session,
                                  void *context)
{
    (void)session;
    return respond_json(request, (const char *)context);
}

static crux_web_result_t on_attempt(crux_web_request_t *request, crux_access_session_t session,
                                    void *context)
{
    char id[64];
    char query[64];
    char body[192];
    int length;

    (void)session;
    (void)context;
    if (crux_web_path_param(request, 0u, id, sizeof(id)) != CRUX_WEB_OK ||
        crux_web_query(request, query, sizeof(query)) != CRUX_WEB_OK) {
        return crux_web_respond_error(request, 404, "not_found");
    }
    length = snprintf(body, sizeof(body), "{\"route\":\"attempt\",\"id\":\"%s\",\"query\":\"%s\"}",
                      id, query);
    return crux_web_respond(request, 200, NULL, body, (size_t)length);
}

/* The lengths of what the capture held, so the driver can size it without any value coming back. */
static crux_web_result_t on_echo(crux_web_request_t *request, crux_access_session_t session,
                                 void *context)
{
    const crux_web_request_head_t *head = crux_web_request_head(request);
    char body[256];
    int length;

#define LENGTH_OF(field) (head->field != NULL ? (int)strlen(head->field) : -1)
    (void)session;
    (void)context;
    length = snprintf(body, sizeof(body),
                      "{\"cookie\":%d,\"origin\":%d,\"host\":%d,\"xsrf\":%d,\"request\":%d,"
                      "\"type\":%d,\"length\":%d,\"body\":%zu}",
                      LENGTH_OF(cookie), LENGTH_OF(origin), LENGTH_OF(host), LENGTH_OF(xsrf_token),
                      LENGTH_OF(crux_request), LENGTH_OF(content_type), LENGTH_OF(content_length),
                      crux_web_body_length(request));
#undef LENGTH_OF
    return crux_web_respond(request, 200, NULL, body, (size_t)length);
}

/* Sets cookies of the size that #186 will: 256 bits in base64url, for the real-browser run. */
static crux_web_result_t on_browser_cookies(crux_web_request_t *request,
                                            crux_access_session_t session, void *context)
{
    (void)session;
    (void)context;
    if (crux_web_add_header(request, "Set-Cookie",
                            "crux_session=admin000000000000000000000000000000000000000; Secure; "
                            "HttpOnly; SameSite=Strict; Path=/") != CRUX_WEB_OK ||
        crux_web_add_header(request, "Set-Cookie",
                            "XSRF-TOKEN=0000000000000000000000000000000000000000000; Secure; "
                            "SameSite=Strict; Path=/") != CRUX_WEB_OK) {
        return CRUX_WEB_ERR_FAILED;
    }
    return crux_web_respond(request, 200, NULL, "{}", 2u);
}

static crux_web_result_t on_slow(crux_web_request_t *request, crux_access_session_t session,
                                 void *context)
{
    char text[12];

    (void)session;
    (void)context;
    if (crux_web_path_param(request, 0u, text, sizeof(text)) != CRUX_WEB_OK) {
        return crux_web_respond_error(request, 404, "not_found");
    }
    k_msleep(atoi(text));
    return respond_json(request, "slow");
}

/* Bodies of a chosen size, sent in pieces by the adapter. The security headers are the caller's. */
static crux_web_result_t on_static(crux_web_request_t *request, crux_access_session_t session,
                                   void *context)
{
    static const crux_web_header_t headers[] = {
        {"Content-Type", "application/octet-stream"},
        {"X-Content-Type-Options", "nosniff"},
    };
    char text[12];

    (void)session;
    (void)context;
    if (crux_web_path_param(request, 0u, text, sizeof(text)) != CRUX_WEB_OK) {
        return crux_web_respond_error(request, 404, "not_found");
    }
    return crux_web_respond_static(request, 200, headers, 2u, large_body,
                                   MIN((size_t)atoi(text), sizeof(large_body)));
}

/* A page for a real browser, whose script makes the requests a client makes, as the page itself. */
static crux_web_result_t on_page(crux_web_request_t *request, crux_access_session_t session,
                                 void *context)
{
    static const char page[] = "<!doctype html><title>probe</title><pre id=out></pre>"
                               "<script src=/probe/page.js></script>";

    (void)session;
    (void)context;
    return crux_web_respond(request, 200, "text/html", page, sizeof(page) - 1u);
}

static crux_web_result_t on_page_script(crux_web_request_t *request, crux_access_session_t session,
                                        void *context)
{
    static const char script[] =
        "(async () => {\n"
        "  const out = document.getElementById('out');\n"
        "  try {\n"
        "    const token = document.cookie.split('; ').find(c => c.startsWith('XSRF-TOKEN='));\n"
        "    const post = await fetch('/probe/echo', {method: 'POST', headers: {\n"
        "      'Content-Type': 'application/json', 'X-XSRF-TOKEN': token.split('=')[1],\n"
        "      'X-Crux-Request': '1'}, body: '{}'});\n"
        "    const postBody = await post.json();\n"
        "    const get = await fetch('/probe/echo', {headers: {'X-Crux-Request': '1'}});\n"
        "    const getBody = await get.json();\n"
        "    const parallel = await Promise.all(Array.from({length: 8}, (_, i) =>\n"
        "      fetch('/probe/stats?' + i).then(r => r.status)));\n"
        "    out.textContent = JSON.stringify({userAgent: navigator.userAgent,\n"
        "      postStatus: post.status, post: postBody, get: getBody, parallel});\n"
        "  } catch (e) {\n"
        "    out.textContent = JSON.stringify({error: String(e)});\n"
        "  }\n"
        "})();\n";

    (void)session;
    (void)context;
    return crux_web_respond(request, 200, "text/javascript", script, sizeof(script) - 1u);
}

/* A response in pieces, whose chosen send returns -EAGAIN as a stalled reader's would. */
static crux_web_result_t on_fail(crux_web_request_t *request, crux_access_session_t session,
                                 void *context)
{
    static uint8_t body[4096];
    char text[12];

    (void)session;
    (void)context;
    if (crux_web_path_param(request, 0u, text, sizeof(text)) != CRUX_WEB_OK) {
        return crux_web_respond_error(request, 404, "not_found");
    }
    memset(body, 'A', sizeof(body));
    web_probe_fail_send_after((unsigned)atoi(text));
    return crux_web_respond(request, 200, "text/plain", body, sizeof(body));
}

/* Another client's response, through the one shared buffer. */
static crux_web_result_t on_other(crux_web_request_t *request, crux_access_session_t session,
                                  void *context)
{
    static uint8_t body[4096];

    (void)session;
    (void)context;
    memset(body, 'B', sizeof(body));
    return crux_web_respond(request, 200, "text/plain", body, sizeof(body));
}

static crux_web_result_t on_send_buffer(crux_web_request_t *request, crux_access_session_t session,
                                        void *context)
{
    char text[12];

    (void)session;
    (void)context;
    if (crux_web_path_param(request, 0u, text, sizeof(text)) != CRUX_WEB_OK) {
        return crux_web_respond_error(request, 404, "not_found");
    }
    web_probe_set_next_send_buffer(atoi(text));
    return crux_web_respond(request, 200, NULL, "{}", 2u);
}

static crux_web_result_t on_stats(crux_web_request_t *request, crux_access_session_t session,
                                  void *context)
{
    crux_web_stats_t stats;
    char body[256];
    int length;

    (void)session;
    (void)context;
    crux_web_stats_get(&stats);
    length = snprintf(body, sizeof(body),
                      "{\"requests\":%u,\"rejected\":%u,\"handlers\":%u,\"deadlines\":%u,"
                      "\"response_deadlines\":%u,"
                      "\"aborted\":%u,\"overruns\":%u,\"handler_max_ms\":%u,\"send_eagain\":%u}",
                      stats.requests, stats.rejected, stats.handlers, stats.deadlines,
                      stats.response_deadlines, stats.aborted, stats.handler_overruns,
                      stats.handler_max_ms, web_probe_eagain_count());
    return crux_web_respond(request, 200, NULL, body, (size_t)length);
}

CRUX_WEB_ROUTE(login, "/api/v1/session", CRUX_WEB_POST, CRUX_WEB_PUBLIC, on_named, "login");
CRUX_WEB_ROUTE(logout, "/api/v1/session", CRUX_WEB_DELETE, CRUX_WEB_SESSION, on_named, "logout");
CRUX_WEB_ROUTE(attempt, "/api/v1/session/attempt/{id}", CRUX_WEB_GET, CRUX_WEB_PUBLIC, on_attempt,
               NULL);
CRUX_WEB_ROUTE(me, "/api/v1/session/me", CRUX_WEB_GET, CRUX_WEB_SESSION, on_named, "me");
CRUX_WEB_ROUTE(status, "/api/v1/status", CRUX_WEB_GET, CRUX_WEB_SESSION, on_named, "status");
CRUX_WEB_ROUTE(network_read, "/api/v1/network", CRUX_WEB_GET, "network.read", on_named,
               "network_read");
CRUX_WEB_ROUTE(network_write, "/api/v1/network", CRUX_WEB_PUT, "network.write", on_named,
               "network_write");
CRUX_WEB_ROUTE(file_list, "/api/v1/files/{area}", CRUX_WEB_GET, CRUX_WEB_SESSION, on_named,
               "file_list");
CRUX_WEB_ROUTE(file_item, "/api/v1/files/{area}/{name}", CRUX_WEB_GET, CRUX_WEB_SESSION, on_named,
               "file_item");
CRUX_WEB_ROUTE(echo_get, "/probe/echo", CRUX_WEB_GET, CRUX_WEB_PUBLIC, on_echo, NULL);
CRUX_WEB_ROUTE(echo_post, "/probe/echo", CRUX_WEB_POST, CRUX_WEB_PUBLIC, on_echo, NULL);
CRUX_WEB_ROUTE(browser_cookies, "/probe/cookies", CRUX_WEB_GET, CRUX_WEB_PUBLIC, on_browser_cookies,
               NULL);
CRUX_WEB_ROUTE(slow, "/probe/slow/{ms}", CRUX_WEB_GET, CRUX_WEB_PUBLIC, on_slow, NULL);
CRUX_WEB_ROUTE(static_body, "/probe/static/{size}", CRUX_WEB_GET, CRUX_WEB_PUBLIC, on_static, NULL);
CRUX_WEB_ROUTE(page, "/probe/page", CRUX_WEB_GET, CRUX_WEB_PUBLIC, on_page, NULL);
CRUX_WEB_ROUTE(page_script, "/probe/page.js", CRUX_WEB_GET, CRUX_WEB_PUBLIC, on_page_script, NULL);
CRUX_WEB_ROUTE(fail, "/probe/fail/{skip}", CRUX_WEB_GET, CRUX_WEB_PUBLIC, on_fail, NULL);
CRUX_WEB_ROUTE(other, "/probe/other", CRUX_WEB_GET, CRUX_WEB_PUBLIC, on_other, NULL);
CRUX_WEB_ROUTE(send_buffer, "/probe/send-buffer/{bytes}", CRUX_WEB_GET, CRUX_WEB_PUBLIC,
               on_send_buffer, NULL);
CRUX_WEB_ROUTE(stats, "/probe/stats", CRUX_WEB_GET, CRUX_WEB_PUBLIC, on_stats, NULL);
```

## src/project_routes.c
```c
/* What a project writes: a route and a handler, through the public header alone. */
#include <crux/web.h>

static const char pump_body[] = "{\"speed\":42}";

static crux_web_result_t on_pump_status(crux_web_request_t *request, crux_access_session_t session,
                                        void *context)
{
    (void)session;
    (void)context;
    return crux_web_respond(request, 200, NULL, pump_body, sizeof(pump_body) - 1u);
}

static crux_web_result_t on_pump_item(crux_web_request_t *request, crux_access_session_t session,
                                      void *context)
{
    char item[16];
    crux_web_result_t result = crux_web_path_param(request, 0u, item, sizeof(item));

    (void)session;
    (void)context;
    if (result != CRUX_WEB_OK) {
        return crux_web_respond_error(request, 404, "not_found");
    }
    return crux_web_respond(request, 200, "text/plain", item, sizeof(item) - 1u);
}

CRUX_WEB_ROUTE(pump_status, "/api/v1/app/pump", CRUX_WEB_GET, "app.pump.read", on_pump_status,
               NULL);
CRUX_WEB_ROUTE(pump_item, "/api/v1/app/pump/{id}", CRUX_WEB_GET, CRUX_WEB_SESSION, on_pump_item,
               NULL);
```

## src/shutdown_shim.c
```c
/* The server's inactivity timer closes a client with zsock_shutdown(), and the native socket
 * offload at v4.4.2 has no shutdown operation, so there the call fails and the timer does nothing.
 * This test image gives the timer the effect it has on Zephyr's own TCP stack, so that the
 * measurements mean something. It is here and not in the adapter because a product does not use the
 * offload. */
#include <errno.h>
#include <zephyr/kernel.h>
#include <zephyr/sys/fdtable.h>

int web_host_shutdown(int host_fd, int how);
int __wrap_z_impl_zsock_shutdown(int sock, int how);

/* The start of the driver's private struct nsos_socket at v4.4.2, up to the host descriptor. A
 * wrong layout makes the host call fail, and the driver's inactivity cases then fail. */
struct nsos_socket_start {
    int fd;
    k_timeout_t recv_timeout;
    k_timeout_t send_timeout;
    struct {
        int fd;
        short events;
        short revents;
        void (*cb)(void *pollfd_mid);
    } poll_mid;
};

int __wrap_z_impl_zsock_shutdown(int sock, int how)
{
    const struct nsos_socket_start *socket = zvfs_get_fd_obj(sock, NULL, EBADF);

    if (socket == NULL) {
        return -1;
    }
    return web_host_shutdown(socket->poll_mid.fd, how);
}
```

## src/socket_shim.c
```c
/* Two things this test image does at the socket call that the server makes.
 *
 * The server's inactivity timer closes a client with zsock_shutdown(), and the native socket
 * offload at v4.4.2 has no shutdown operation, so there the call fails and the timer does nothing.
 * This gives the timer the effect it has on Zephyr's own TCP stack, so that the measurements mean
 * something.
 *
 * The offload's send waits out a timeout and then sends anyway, so the server rarely sees -EAGAIN,
 * which it swallows and which leaves a client held. A probe route can make one chosen send return
 * it, and can shrink a socket's send buffer, as on a small target.
 *
 * Over TLS the server's descriptor is a TLS socket, which holds the offloaded one, and the TLS
 * layer calls these again for it. A shutdown goes on to that socket, a send counts and fails only
 * at the outermost call, which is the server's, and a send buffer applies to the offloaded socket.
 *
 * It is here and not in the adapter because a product does not use the offload.
 */
#include "web_probe.h"

#include <errno.h>
#include <zephyr/kernel.h>
#include <zephyr/net/socket.h>
#include <zephyr/sys/fdtable.h>

#if defined(CONFIG_NET_SOCKETS_SOCKOPT_TLS)
bool net_socket_is_tls(void *obj);
#else
#define net_socket_is_tls(obj) false
#endif

int web_host_shutdown(int host_fd, int how);
int web_host_set_send_buffer(int host_fd, int size);
int __real_z_impl_zsock_shutdown(int sock, int how);
int __wrap_z_impl_zsock_shutdown(int sock, int how);
ssize_t __real_z_impl_zsock_sendto(int sock, const void *buf, size_t len, int flags,
                                   const struct net_sockaddr *dest_addr, net_socklen_t addrlen);
ssize_t __wrap_z_impl_zsock_sendto(int sock, const void *buf, size_t len, int flags,
                                   const struct net_sockaddr *dest_addr, net_socklen_t addrlen);

/* The start of the driver's private struct nsos_socket at v4.4.2, up to the host descriptor. A
 * wrong layout makes the host call fail, and the driver's inactivity cases then fail. */
struct nsos_socket_start {
    int fd;
    k_timeout_t recv_timeout;
    k_timeout_t send_timeout;
    struct {
        int fd;
        short events;
        short revents;
        void (*cb)(void *pollfd_mid);
    } poll_mid;
};

static bool fail_armed;
static unsigned fail_skip;
static int shrink_size;
static unsigned eagain_count;
static unsigned send_depth;
static unsigned outer_sends;
static unsigned inner_sends;
static unsigned real_eagain;

int __wrap_z_impl_zsock_shutdown(int sock, int how)
{
    const struct nsos_socket_start *socket = zvfs_get_fd_obj(sock, NULL, EBADF);

    if (socket == NULL) {
        return -1;
    }
    if (net_socket_is_tls((void *)socket)) {
        return __real_z_impl_zsock_shutdown(sock, how);
    }
    return web_host_shutdown(socket->poll_mid.fd, how);
}

ssize_t __wrap_z_impl_zsock_sendto(int sock, const void *buf, size_t len, int flags,
                                   const struct net_sockaddr *dest_addr, net_socklen_t addrlen)
{
    const struct nsos_socket_start *socket = zvfs_get_fd_obj(sock, NULL, EBADF);
    ssize_t sent;

    if (shrink_size != 0 && socket != NULL && !net_socket_is_tls((void *)socket)) {
        (void)web_host_set_send_buffer(socket->poll_mid.fd, shrink_size);
        shrink_size = 0;
    }
    if (send_depth == 0u) {
        ++outer_sends;
        if (fail_armed) {
            if (fail_skip == 0u) {
                fail_armed = false;
                ++eagain_count;
                errno = EAGAIN;
                return -1;
            }
            --fail_skip;
        }
    } else {
        ++inner_sends;
    }
    ++send_depth;
    sent = __real_z_impl_zsock_sendto(sock, buf, len, flags, dest_addr, addrlen);
    --send_depth;
    if (send_depth == 0u && sent < 0 && errno == EAGAIN) {
        ++real_eagain;
    }
    return sent;
}

void web_probe_fail_send_after(unsigned skip)
{
    fail_skip = skip;
    fail_armed = true;
}

void web_probe_set_next_send_buffer(int size)
{
    shrink_size = size;
}

unsigned web_probe_eagain_count(void)
{
    return eagain_count;
}

unsigned web_probe_outer_sends(void)
{
    return outer_sends;
}

unsigned web_probe_inner_sends(void)
{
    return inner_sends;
}

unsigned web_probe_real_eagain(void)
{
    return real_eagain;
}
```

## src/upload_probe.c
```c
/* The flow control probe of Issue #184: can the single server thread hold back a large upload?
 *
 * The server reads whenever a socket is readable and calls back with what it read, and it offers no
 * way to pause one client. So the only back-pressure a callback has is to wait for room in a
 * bounded queue to a worker, and every other client waits with it. This is a bare resource on the
 * same service, because the public contract has no streaming route until Issue #188 chooses one.
 * The worker simulates storage: a chunk takes a little time, and every sixteenth a sector write's
 * stall.
 */
#include <stdio.h>
#include <string.h>
#include <zephyr/kernel.h>
#include <zephyr/net/http/server.h>
#include <zephyr/net/http/service.h>

#define CHUNK_BYTES 256u
#define QUEUE_CHUNKS 8u
#define CHUNK_MS 5
#define STALL_EVERY_CHUNKS 16u
#define STALL_MS 200
#define PUT_LIMIT_MS 2000

struct chunk {
    size_t length;
    uint8_t data[CHUNK_BYTES];
};

K_MSGQ_DEFINE(upload_queue, sizeof(struct chunk), QUEUE_CHUNKS, 4);

static struct k_thread worker_thread;
static K_THREAD_STACK_DEFINE(worker_stack, 2048);
static bool worker_started;
static volatile size_t worker_bytes;

static void upload_worker(void *first, void *second, void *third)
{
    struct chunk chunk;
    unsigned count = 0u;

    ARG_UNUSED(first);
    ARG_UNUSED(second);
    ARG_UNUSED(third);
    while (true) {
        k_msgq_get(&upload_queue, &chunk, K_FOREVER);
        worker_bytes = worker_bytes + chunk.length;
        k_msleep(++count % STALL_EVERY_CHUNKS == 0u ? STALL_MS : CHUNK_MS);
    }
}

static struct {
    size_t received;
    int64_t blocked_total_ms;
    int64_t blocked_max_ms;
    bool overflow;
} upload_state;

static char upload_reply[160];
static const struct http_header upload_headers[] = {{"Content-Type", "application/json"}};

static void offer(const uint8_t *data, size_t length)
{
    while (length != 0u) {
        static struct chunk chunk;
        size_t piece = MIN(length, sizeof(chunk.data));
        int64_t started = k_uptime_get();
        int64_t blocked;

        chunk.length = piece;
        memcpy(chunk.data, data, piece);
        if (k_msgq_put(&upload_queue, &chunk, K_MSEC(PUT_LIMIT_MS)) != 0) {
            upload_state.overflow = true;
        }
        blocked = k_uptime_get() - started;
        upload_state.blocked_total_ms += blocked;
        upload_state.blocked_max_ms = MAX(upload_state.blocked_max_ms, blocked);
        data += piece;
        length -= piece;
    }
}

static int upload_callback(struct http_client_ctx *client, enum http_transaction_status status,
                           const struct http_request_ctx *request,
                           struct http_response_ctx *response, void *user_data)
{
    ARG_UNUSED(client);
    ARG_UNUSED(user_data);
    if (status == HTTP_SERVER_TRANSACTION_ABORTED || status == HTTP_SERVER_TRANSACTION_COMPLETE) {
        memset(&upload_state, 0, sizeof(upload_state));
        return 0;
    }
    if (!worker_started) {
        worker_started = true;
        k_thread_create(&worker_thread, worker_stack, K_THREAD_STACK_SIZEOF(worker_stack),
                        upload_worker, NULL, NULL, NULL, K_PRIO_PREEMPT(8), 0, K_NO_WAIT);
    }
    upload_state.received += request->data_len;
    offer(request->data, request->data_len);
    if (status == HTTP_SERVER_REQUEST_DATA_FINAL) {
        int length = snprintf(upload_reply, sizeof(upload_reply),
                              "{\"received\":%zu,\"blocked_total_ms\":%lld,\"blocked_max_ms\":%lld,"
                              "\"overflow\":%s}",
                              upload_state.received, (long long)upload_state.blocked_total_ms,
                              (long long)upload_state.blocked_max_ms,
                              upload_state.overflow ? "true" : "false");

        response->status = HTTP_200_OK;
        response->headers = upload_headers;
        response->header_count = ARRAY_SIZE(upload_headers);
        response->body = (const uint8_t *)upload_reply;
        response->body_len = (size_t)length;
        response->final_chunk = true;
    }
    return 0;
}

static struct http_resource_detail_dynamic upload_detail = {
    .common = {.bitmask_of_supported_http_methods = BIT(HTTP_POST),
               .type = HTTP_RESOURCE_TYPE_DYNAMIC},
    .cb = upload_callback,
};

HTTP_RESOURCE_DEFINE(probe_upload_resource, crux_web_service, "/probe/upload", &upload_detail);
```

## src/web_probe.h
```c
/* Shared by the native_sim application's files. */
#ifndef WEB_PROBE_H
#define WEB_PROBE_H

#include "crux_web_adapter.h"

crux_web_auth_t web_probe_authenticate(const crux_web_request_head_t *head,
                                       crux_access_session_t *session, void *context);
void web_probe_fill_large_body(void);
/* The socket shim, on the server thread. After @p skip more sends, one send returns -EAGAIN. */
void web_probe_fail_send_after(unsigned skip);
void web_probe_set_next_send_buffer(int size);
unsigned web_probe_eagain_count(void);
/* Sends the server made, and over TLS, those the TLS layer made beneath them. */
unsigned web_probe_outer_sends(void);
unsigned web_probe_inner_sends(void);
/* Sends of the server's that returned -EAGAIN of themselves, not injected. */
unsigned web_probe_real_eagain(void);

#endif /* WEB_PROBE_H */
```
