## CMakeLists.txt
```
# SPDX-License-Identifier: Apache-2.0
# Login and sessions (Issue #186) on native_sim: the session module and the web adapter over plain HTTP
# on loopback, on the management composition of #242 with the real Access core and its real PSA ports.
# The profile comes from EXTRA_CONF_FILE, as for the composition:
#   ../tls_offload_probe/mbed.conf;../management_composition/profile-psa.conf;
#   ../management_composition/mbed-threading.conf
# scripts/test-web-session.sh builds and runs it. TLS is Issue #185, and this image has none in use.
cmake_minimum_required(VERSION 3.20.0)
get_filename_component(CRUX_ROOT "${CMAKE_CURRENT_LIST_DIR}/../../.." ABSOLUTE)
# The composition's file-backed disk.
set(DTC_OVERLAY_FILE "${CMAKE_CURRENT_LIST_DIR}/../management_composition/app.overlay")
find_package(Zephyr REQUIRED HINTS $ENV{ZEPHYR_BASE})
project(crux_web_session_native LANGUAGES C)
if(NOT CONFIG_BOARD_NATIVE_SIM)
  message(FATAL_ERROR "This image is restricted to native_sim: its entropy is test-only")
endif()
include(${CRUX_ROOT}/cmake/CruxWebRoutes.cmake)
include(${CRUX_ROOT}/components/web/session/sources.cmake)
include(${CRUX_ROOT}/tests/native/management_composition/composition/composition.cmake)
crux_native_management_compose()
target_sources(app PRIVATE src/main.c src/test_routes.c ${CRUX_WEB_SESSION_SOURCES}
  ${CRUX_WEB_SESSION_ROUTES} ${CRUX_WEB_SESSION_PSA_PORT})
target_include_directories(app PRIVATE ${CRUX_WEB_SESSION_DIR} ${CRUX_ROOT}/components/web/src)
target_link_libraries(app PRIVATE crux_web_adapter crux_service_priority_placement)
if(CONFIG_CRUX_WEB_PLAIN_HTTP_FOR_TESTS)
  target_compile_definitions(app PRIVATE CRUX_WEB_SESSION_PLAIN_HTTP_FOR_TESTS=1)
endif()
crux_web_routes(app SOURCES ${CRUX_WEB_SESSION_ROUTES} src/test_routes.c ZEPHYR_RESOURCES
  REVIEWED reviewed-routes.txt)
```

## prj.conf
```kconfig
# Login and sessions on the management composition, over the native socket offload and plain HTTP.
# The composition's settings are those of tests/native/management_composition/prj.conf, without Ztest.
CONFIG_MAIN_STACK_SIZE=32768
CONFIG_HEAP_MEM_POOL_SIZE=32768
CONFIG_STD_C17=y
# The host's TCP stack keeps real time, and so must the simulated clock.
CONFIG_NATIVE_SIM_SLOWDOWN_TO_REAL_TIME=y
# The host's C library takes Zephyr's fnmatch flags with other meanings. See docs/web-contract.md.
CONFIG_MINIMAL_LIBC=y

CONFIG_NETWORKING=y
CONFIG_NET_IPV4=y
CONFIG_NET_IPV6=n
CONFIG_NET_TCP=y
CONFIG_NET_SOCKETS=y
CONFIG_NET_SOCKETS_OFFLOAD=y
CONFIG_NET_DRIVERS=y
CONFIG_NET_NATIVE_OFFLOADED_SOCKETS=y
CONFIG_ETH_NATIVE_TAP=n
CONFIG_NET_SOCKETS_SOCKOPT_TLS=y
CONFIG_TLS_CREDENTIALS=y
CONFIG_TLS_MAX_CREDENTIALS_NUMBER=4
CONFIG_NET_SOCKETS_TLS_MAX_CONTEXTS=6
CONFIG_ZVFS_OPEN_MAX=24
CONFIG_ZVFS_POLL_MAX=16
CONFIG_ZVFS_EVENTFD=y

# Test-only on native_sim, so no token strength is shown here. See docs/psa-crypto-design.md.
CONFIG_ENTROPY_GENERATOR=y
CONFIG_HWINFO=y

CONFIG_CRUX_TIME=y
CONFIG_CRUX_THREAD=y
CONFIG_CRUX_THREAD_STACK_BYTES=8192
CONFIG_CRUX_SYNC=y
CONFIG_CRUX_SYNC_MUTEX_COUNT=16
CONFIG_CRUX_NETIF=y
CONFIG_CRUX_SYSTEM=y
CONFIG_WATCHDOG=y
CONFIG_REBOOT=y

CONFIG_FILE_SYSTEM=y
CONFIG_FILE_SYSTEM_MKFS=y
CONFIG_FAT_FILESYSTEM_ELM=y
CONFIG_FS_FATFS_LFN=y
CONFIG_FS_FATFS_LFN_MODE_STACK=y
CONFIG_FS_FATFS_MAX_LFN=127
CONFIG_FS_FATFS_MOUNT_MKFS=n
CONFIG_FS_FATFS_REENTRANT=y
CONFIG_FS_FATFS_NUM_FILES=6
CONFIG_DISK_DRIVERS=y
CONFIG_DISK_DRIVER_FLASH=y
CONFIG_CRUX_FILE_FATFS_SIMULATOR=y

CONFIG_CRUX_LOGGING=y
CONFIG_SERIAL=y
CONFIG_EMUL=y
CONFIG_UART_EMUL=y
CONFIG_LOG=y
CONFIG_LOG_MODE_DEFERRED=y
CONFIG_LOG_MODE_OVERFLOW=n
CONFIG_LOG_BLOCK_IN_THREAD=n
CONFIG_LOG_PROCESS_THREAD=y
CONFIG_LOG_PROCESS_THREAD_STACK_SIZE=2048
CONFIG_LOG_PROCESS_THREAD_CUSTOM_PRIORITY=y
CONFIG_LOG_PROCESS_THREAD_PRIORITY=14
CONFIG_LOG_BUFFER_SIZE=4096
CONFIG_LOG_MAX_LEVEL=4
CONFIG_LOG_RUNTIME_FILTERING=n
CONFIG_LOG_BACKEND_UART=y
CONFIG_LOG_BACKEND_NATIVE_POSIX=n
CONFIG_LOG_BACKEND_UART_ASYNC=n
CONFIG_LOG_PRINTK=n
CONFIG_THREAD_MONITOR=y
CONFIG_THREAD_NAME=y
CONFIG_SHELL_LOG_BACKEND=n

# The web adapter, on plain HTTP for this test only. The settings are tests/native/web_http's.
CONFIG_CRUX_WEB=y
CONFIG_CRUX_WEB_PLAIN_HTTP_FOR_TESTS=y
CONFIG_CRUX_WEB_PORT=18186
CONFIG_HTTP_SERVER_CLIENT_INACTIVITY_TIMEOUT=3
CONFIG_CRUX_WEB_REQUEST_DEADLINE_MS=2000
CONFIG_CRUX_WEB_SEND_TIMEOUT_MS=500
CONFIG_CRUX_WEB_RESPONSE_DEADLINE_MS=1500
```

## src/main.c
```c
/*
 * Login and sessions on native_sim: the management composition with the real Access core on its
 * real PSA ports, the session module, and the web adapter on plain HTTP over the native socket
 * offload. test_driver.py is the client. Test only: the entropy is test-only, so no token strength
 * is shown, and the first account is the composition's declared test step.
 */
#include "crux_native_management.h"
#include "crux_web_session.h"

#include <crux_access_adapter.h>

#include <string.h>
#include <zephyr/kernel.h>
#include <zephyr/sys/printk.h>

/* A second account, for the wrong-role cases. Its password is a declared test value. */
#define VIEWER_USER "viewer"
#define VIEWER_PASSWORD "session test viewer password"

static bool accounts_ready(void)
{
    crux_access_session_t admin = {0};
    crux_access_result_t result;

    if (crux_native_management_store_state_at_start() == CRUX_CREDENTIAL_STATE_EMPTY &&
        crux_native_management_provision_test_account() != CRUX_ACCESS_OK) {
        return false;
    }
    if (crux_native_management_login(CRUX_NATIVE_MANAGEMENT_TEST_USER,
                                     CRUX_NATIVE_MANAGEMENT_TEST_PASSWORD,
                                     &admin) != CRUX_ACCESS_OK) {
        return false;
    }
    result = crux_access_account_create(admin, VIEWER_USER, CRUX_NATIVE_MANAGEMENT_ROLE_VIEWER,
                                        VIEWER_PASSWORD, strlen(VIEWER_PASSWORD));
    crux_access_logout(&admin);
    return result == CRUX_ACCESS_OK || result == CRUX_ACCESS_ERR_ALREADY_EXISTS;
}

int main(void)
{
    /* The plain HTTP test image says so, and a product composition passes "https". */
    static const crux_web_session_config_t session_config = {"http", NULL, 0u};
    static const crux_web_config_t config = {
        .authenticate = crux_web_session_authenticate,
        .request_deadline_ms = CONFIG_CRUX_WEB_REQUEST_DEADLINE_MS,
        .handler_limit_ms = 100u,
    };
    crux_native_management_start_t started = crux_native_management_start();

    if (started != CRUX_NATIVE_MANAGEMENT_STARTED || !accounts_ready()) {
        printk("CRUX_SESSION_START_FAILED %d\n", (int)started);
        return 1;
    }
    if (crux_web_session_init(&session_config) != CRUX_WEB_OK ||
        crux_web_session_start_worker() != CRUX_WEB_OK || crux_web_start(&config) != CRUX_WEB_OK) {
        printk("CRUX_SESSION_START_FAILED web\n");
        return 1;
    }
    printk("CRUX_SESSION_READY %d\n", CONFIG_CRUX_WEB_PORT);
    return 0;
}
```

## src/test_routes.c
```c
/* Routes of the test image only: one that needs a permission, a session-only one for the forgery
 * rules, and the counters that the driver reads for its measurement. */
#include "crux_web_session.h"

#include <stdio.h>
#include <string.h>

static crux_web_result_t on_ok(crux_web_request_t *request, crux_access_session_t session,
                               void *context)
{
    static const char body[] = "{\"ok\":true}";

    (void)session;
    (void)context;
    return crux_web_respond(request, 200, NULL, body, strlen(body));
}

static crux_web_result_t on_stats(crux_web_request_t *request, crux_access_session_t session,
                                  void *context)
{
    crux_web_session_stats_t sessions;
    crux_web_stats_t web;
    char body[320];
    int length;

    (void)session;
    (void)context;
    crux_web_session_stats_get(&sessions);
    crux_web_stats_get(&web);
    length = snprintf(body, sizeof(body),
                      "{\"attempts\":%u,\"busy\":%u,\"verified\":%u,\"expired\":%u,"
                      "\"sessions\":%u,\"worker_max_ms\":%u,\"handler_max_ms\":%u,"
                      "\"handler_overruns\":%u}",
                      (unsigned)sessions.attempts, (unsigned)sessions.busy,
                      (unsigned)sessions.verified, (unsigned)sessions.expired,
                      (unsigned)sessions.sessions, (unsigned)sessions.worker_max_ms,
                      (unsigned)web.handler_max_ms, (unsigned)web.handler_overruns);
    return crux_web_respond(request, 200, NULL, body, (size_t)length);
}

CRUX_WEB_ROUTE(test_admin, "/api/v1/test/admin", CRUX_WEB_GET | CRUX_WEB_POST, "access.manage",
               on_ok, NULL);
CRUX_WEB_ROUTE(test_session, "/api/v1/test/session", CRUX_WEB_GET | CRUX_WEB_POST, CRUX_WEB_SESSION,
               on_ok, NULL);
CRUX_WEB_ROUTE(probe_stats, "/probe/session-stats", CRUX_WEB_GET, CRUX_WEB_PUBLIC, on_stats, NULL);
```
