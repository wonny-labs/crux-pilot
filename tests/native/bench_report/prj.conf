## CMakeLists.txt
```
# SPDX-License-Identifier: Apache-2.0
# The kernel side of the RT1060-EVKB bench report (row C2), built on native_sim: the thread table, the heap line, the
# thread that watches an activity counter, and the lines it prints through the same deferred log path as the bench
# image. The numbers a thread's stack gives on native_sim mean nothing (a thread runs on a host stack), so this
# test checks the shape, the bounds and the timing of the report, and the bench image's numbers come from a board.
cmake_minimum_required(VERSION 3.20.0)
find_package(Zephyr REQUIRED HINTS $ENV{ZEPHYR_BASE})
project(crux_native_bench_report LANGUAGES C)
get_filename_component(report_dir "${CMAKE_CURRENT_LIST_DIR}/../../zephyr/management_rt1060_compile/report" ABSOLUTE)
target_sources(app PRIVATE src/main.c ${report_dir}/bench_report_core.c ${report_dir}/bench_report_format.c
    ${report_dir}/bench_report_policy.c)
target_include_directories(app PRIVATE ${report_dir})
target_compile_options(app PRIVATE -Wall -Wextra -Werror)
```

## prj.conf
```kconfig
CONFIG_STD_C17=y
CONFIG_MINIMAL_LIBC=y
CONFIG_COMMON_LIBC_MALLOC_ARENA_SIZE=65536
CONFIG_SYS_HEAP_RUNTIME_STATS=y
CONFIG_INIT_STACKS=y
CONFIG_THREAD_STACK_INFO=y
CONFIG_THREAD_NAME=y
CONFIG_THREAD_MONITOR=y
CONFIG_MAIN_STACK_SIZE=4096
# Not paced to wall time: the scenario holds a minute of kernel time.
CONFIG_NATIVE_SIM_SLOWDOWN_TO_REAL_TIME=n
# The same output path as the bench image (target.conf): printk through Crux-style deferred logging, a 4 KiB buffer
# that drops on overflow, so that a report that the pacing did not protect would show "messages dropped".
CONFIG_SERIAL=y
CONFIG_UART_CONSOLE=y
CONFIG_UART_NATIVE_PTY_0_ON_STDINOUT=y
CONFIG_PRINTK=y
CONFIG_LOG=y
CONFIG_LOG_PRINTK=y
CONFIG_LOG_MODE_DEFERRED=y
CONFIG_LOG_MODE_OVERFLOW=n
CONFIG_LOG_BLOCK_IN_THREAD=n
CONFIG_LOG_PROCESS_THREAD=y
CONFIG_LOG_PROCESS_THREAD_STACK_SIZE=2048
CONFIG_LOG_PROCESS_THREAD_CUSTOM_PRIORITY=y
CONFIG_LOG_PROCESS_THREAD_PRIORITY=14
CONFIG_LOG_BUFFER_SIZE=4096
CONFIG_LOG_MAX_LEVEL=4
CONFIG_LOG_DEFAULT_LEVEL=0
CONFIG_LOG_RUNTIME_FILTERING=n
CONFIG_LOG_BACKEND_UART=y
CONFIG_LOG_BACKEND_UART_ASYNC=n
CONFIG_LOG_BACKEND_SHOW_LEVEL=y
CONFIG_STDOUT_CONSOLE=n
CONFIG_CONSOLE_HANDLER=n
CONFIG_CONSOLE_SUBSYS=n
CONFIG_EARLY_CONSOLE=n
CONFIG_BOOT_BANNER=n
# native_sim adds a second log backend that prints to stdout, which would print every line twice.
CONFIG_LOG_BACKEND_NATIVE_POSIX=n
```

## src/main.c
```c
/*
 * Scenario for the bench report's kernel side (report/bench_report_core.c) on native_sim.
 *
 *   t = 0        the report starts: a boot report with the fixture threads
 *   t = 10 s     a "client": the activity counter moves for half a second
 *   t = 12.5 s   a quiet report, with the ended rows (main, ssh_worker) that the fixture noted
 *   t = 40.5 s   one idle report
 *   t = 46 s     a table overflow on purpose: 60 more threads, so the report must say missed=N and
 * stop at the table's size and not print past it
 *
 * The network lines (row C6) come from a fake read of made-up pools and counters; its third read
 * fails.
 *
 * The output is the bench image's own lines. tests/build/test_management_bench_report.py documents
 * how the capture is fed to check_bench_uart.py. The stack numbers are native_sim's and mean
 * nothing.
 */
#include "bench_report_core.h"

#include <zephyr/kernel.h>
#include <zephyr/sys/printk.h>

#define HTTP_STACK_BYTES 8192
#define EXTRA_THREADS 60u

static volatile uint32_t activity;
static K_THREAD_STACK_DEFINE(http_stack, HTTP_STACK_BYTES);
static struct k_thread http_thread;
static K_THREAD_STACK_DEFINE(anonymous_stack, 1024);
static struct k_thread anonymous_thread;
static K_THREAD_STACK_ARRAY_DEFINE(extra_stacks, EXTRA_THREADS, 512);
static struct k_thread extra_threads[EXTRA_THREADS];

static uint32_t read_activity(void)
{
    return activity;
}

/* The network side of the report (row C6) with made-up figures: the image's own callback reads the
 * network stack, which native_sim does not have in this test. The third snapshot's read fails on
 * purpose, so that the report must leave the pool and counter lines out and say so in its line
 * count. */
static bool fake_net(bench_report_net_t *out)
{
    static unsigned calls;
    static const struct {
        const char *name;
        uint32_t size;
        uint32_t peak;
    } pools[BENCH_REPORT_POOLS_MAX] = {
        {"rx_pkt", 192u, 20u}, {"tx_pkt", 32u, 6u}, {"rx_buf", 1024u, 150u}, {"tx_buf", 768u, 90u}};

    calls++;
    if (calls == 3u) {
        return false;
    }
    for (uint32_t i = 0; i < BENCH_REPORT_POOLS_MAX; i++) {
        out->pools[i] = (bench_report_pool_t){.name = pools[i].name,
                                              .size = pools[i].size,
                                              .used = 3u,
                                              .peak = pools[i].peak + calls};
    }
    out->pool_count = BENCH_REPORT_POOLS_MAX;
    out->tcp_rexmit = calls - 1u;
    return true;
}

static void note_worker(void)
{
    /* What the provider keeps for the workers that ended, here a made-up figure. */
    (void)bench_report_core_note_ended("ssh_worker", 16384u, 6000u, false);
}

static void sleeper(void *first, void *second, void *third)
{
    ARG_UNUSED(first);
    ARG_UNUSED(second);
    ARG_UNUSED(third);
    for (;;) {
        k_sleep(K_FOREVER);
    }
}

int main(void)
{
    static const bench_report_core_config_t config = {
        .activity = read_activity,
        .refresh = note_worker,
        .arena_bytes = CONFIG_COMMON_LIBC_MALLOC_ARENA_SIZE,
        .net = fake_net,
    };

    (void)k_thread_create(&http_thread, http_stack, K_THREAD_STACK_SIZEOF(http_stack), sleeper,
                          NULL, NULL, NULL, 5, 0, K_NO_WAIT);
    (void)k_thread_name_set(&http_thread, "http_server_tid");
    /* No name: the report must print thread@<address>. */
    (void)k_thread_create(&anonymous_thread, anonymous_stack,
                          K_THREAD_STACK_SIZEOF(anonymous_stack), sleeper, NULL, NULL, NULL, 5, 0,
                          K_NO_WAIT);
    if (!bench_report_core_start(&config) || bench_report_core_start(&config)) {
        printk("BENCH_REPORT_TEST start did not behave: once, and not twice\n");
        return 1;
    }
    /* The main thread's figure is noted for the ended row. */
    {
        size_t unused = 0;
        k_tid_t self = k_current_get();

        if (k_thread_stack_space_get(self, &unused) == 0) {
            (void)bench_report_core_note_ended("main", (uint32_t)self->stack_info.size,
                                               (uint32_t)unused, true);
        }
    }
    k_msleep(10000);
    for (int i = 0; i < 5; i++) {
        activity += 3u;
        k_msleep(100);
    }
    k_msleep(46000 - 10500);
    for (uint32_t i = 0; i < EXTRA_THREADS; i++) {
        (void)k_thread_create(&extra_threads[i], extra_stacks[i], 512, sleeper, NULL, NULL, NULL, 5,
                              0, K_NO_WAIT);
    }
    k_msleep(100);
    /* Not through the policy: the policy would wait for the minimum gap, and this one is a bound.
     */
    bench_report_core_snapshot(BENCH_REPORT_IDLE);
    k_msleep(1000);
    printk("BENCH_REPORT_TEST complete\n");
    return 0;
}
```
