## CMakeLists.txt
```
cmake_minimum_required(VERSION 3.20.0)
find_package(Zephyr REQUIRED HINTS $ENV{ZEPHYR_BASE})
project(crux_native_deferred_output LANGUAGES C)
target_sources(app PRIVATE src/main.c)
target_compile_options(app PRIVATE -Wall -Wextra -Werror)
if(CRUX_TEST_OVERFLOW)
    target_compile_definitions(app PRIVATE CRUX_TEST_OVERFLOW=1)
endif()
```

## prj.conf
```kconfig
CONFIG_STD_C17=y
CONFIG_SERIAL=y
CONFIG_UART_CONSOLE=y
CONFIG_UART_NATIVE_PTY_0_ON_STDINOUT=y
CONFIG_PRINTK=y
CONFIG_PRINTK_SYNC=n
CONFIG_LOG=y
CONFIG_LOG_PRINTK=y
CONFIG_LOG_MODE_DEFERRED=y
CONFIG_LOG_PROCESS_THREAD=y
CONFIG_LOG_PROCESS_THREAD_STACK_SIZE=2048
CONFIG_LOG_PROCESS_THREAD_CUSTOM_PRIORITY=y
CONFIG_LOG_PROCESS_THREAD_PRIORITY=14
CONFIG_LOG_PROCESS_THREAD_STARTUP_DELAY_MS=0
CONFIG_LOG_PROCESS_THREAD_SLEEP_MS=10
CONFIG_LOG_PROCESS_TRIGGER_THRESHOLD=1
CONFIG_LOG_BUFFER_SIZE=4096
CONFIG_LOG_MODE_OVERFLOW=n
CONFIG_LOG_BLOCK_IN_THREAD=n
CONFIG_LOG_DEFAULT_LEVEL=0
CONFIG_LOG_MAX_LEVEL=0
CONFIG_LOG_OVERRIDE_LEVEL=0
CONFIG_LOG_BACKEND_UART=y
CONFIG_LOG_BACKEND_UART_AUTOSTART=y
CONFIG_LOG_BACKEND_UART_ASYNC=n
CONFIG_MAIN_STACK_SIZE=2048
CONFIG_LOG_BACKEND_UART_OUTPUT_TEXT=y
CONFIG_LOG_BACKEND_SHOW_TIMESTAMP=n
CONFIG_LOG_BACKEND_SHOW_LEVEL=n
CONFIG_LOG_BACKEND_SHOW_COLOR=n
CONFIG_LOG_BACKEND_FORMAT_TIMESTAMP=n
# native_sim otherwise enables a second stdout logging backend by default.
CONFIG_LOG_BACKEND_NATIVE_POSIX=n
```

## src/main.c
```c
#include <stdint.h>
#include <zephyr/kernel.h>
#include <zephyr/logging/log_ctrl.h>

static bool drain(void)
{
    int64_t deadline = k_uptime_get() + 1000;
    while (log_buffered_cnt() != 0 && k_uptime_get() < deadline) {
        k_sleep(K_MSEC(10));
    }
    /* A dequeued message can still be in the backend. Preserve a bounded flush gap. */
    k_sleep(K_MSEC(20));
    return log_buffered_cnt() == 0;
}

int main(void)
{
#ifdef CRUX_TEST_OVERFLOW
    /* The actual native process thread is delayed; a finite burst fills its buffer. */
    for (unsigned int i = 0; i < 100; ++i) {
        printk("OVERFLOW sequence=%u payload=abcdefghijklmnopqrstuvwxyz0123456789"
               "abcdefghijklmnopqrstuvwxyz0123456789abcdefghijklmnopqrstuvwxyz0123456789\n",
               i);
    }
#else
    printk("DEFERRED_BEGIN\n");
    printk("DEFERRED_RECORD signed=%lld unsigned=%llu "
           "payload=abcdefghijklmnopqrstuvwxyz0123456789abcdefghijklmnopqrstuvwxyz0123456789"
           "abcdefghijklmnopqrstuvwxyz0123456789abcdefghijklmnopqrstuvwxyz0123456789"
           "abcdefghijklmnopqrstuvwxyz0123456789abcdefghijklmnopqrstuvwxyz0123456789\n",
           (long long)INT64_C(-9223372036854775807), (unsigned long long)UINT64_MAX);
#endif
    if (!drain()) {
        printk("DEFERRED_DRAIN_FAILED\n");
        return 1;
    }
#ifdef CRUX_TEST_OVERFLOW
    printk("OVERFLOW_COMPLETE\n");
#else
    printk("DEFERRED_COMPLETE\n");
#endif
    return drain() ? 0 : 1;
}
```
