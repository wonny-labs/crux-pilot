## CMakeLists.txt
```
# SPDX-License-Identifier: Apache-2.0
cmake_minimum_required(VERSION 3.20.0)
find_package(Zephyr REQUIRED HINTS $ENV{ZEPHYR_BASE})
project(crux_web_assets_native LANGUAGES C)
if(NOT CONFIG_BOARD_NATIVE_SIM)
  message(FATAL_ERROR "This suite is restricted to native_sim, and it operates no hardware")
endif()
get_filename_component(CRUX_ROOT "${CMAKE_CURRENT_LIST_DIR}/../../.." ABSOLUTE)
include(${CRUX_ROOT}/cmake/CruxWebAssets.cmake)
include(${CRUX_ROOT}/cmake/CruxWebRoutes.cmake)

# The built folder, which a product's frontend tool would make. Here a script does, with a file that
# fits the response deadline, one that does not compress, and a large one that nearly fills it.
set(WEB_FOLDER ${CMAKE_CURRENT_BINARY_DIR}/site)
find_package(Python3 REQUIRED COMPONENTS Interpreter)
execute_process(COMMAND ${Python3_EXECUTABLE} ${CMAKE_CURRENT_LIST_DIR}/make_site.py ${WEB_FOLDER}
  RESULT_VARIABLE site_result)
if(NOT site_result EQUAL 0)
  message(FATAL_ERROR "make_site.py failed")
endif()

# The sources of tests/native/web_http that this image shares: the Access double, and the socket shim
# that gives the server's inactivity timer its effect on the native socket offload.
set(WEB_HTTP_SRC ${CMAKE_CURRENT_LIST_DIR}/../web_http/src)
target_sources(app PRIVATE src/main.c src/api_route.c src/probe_route.c ${WEB_HTTP_SRC}/access_double.c
  ${WEB_HTTP_SRC}/socket_shim.c)
target_sources(native_simulator INTERFACE ${WEB_HTTP_SRC}/host_socket.c)
target_include_directories(app PRIVATE ${WEB_HTTP_SRC})
target_link_options(app PUBLIC -Wl,--wrap=z_impl_zsock_shutdown -Wl,--wrap=z_impl_zsock_sendto)
target_link_libraries(app PRIVATE crux_web_adapter)
target_compile_options(app PRIVATE -Wall -Wextra -Werror)

# All a project writes for its interface: the folder, and a content policy if it needs one. main.c holds
# no asset code. The deadline comes from CONFIG_CRUX_WEB_RESPONSE_DEADLINE_MS.
crux_web_assets(app FOLDER ${WEB_FOLDER} STYLE strict)
crux_web_routes(app SOURCES src/api_route.c src/probe_route.c ZEPHYR_RESOURCES REVIEWED reviewed-routes.txt)
```

## prj.conf
```kconfig
# The packaged assets on the real server, on the native socket offload and plain HTTP: the TLS composition
# is the same adapter, and #185's image already runs it. Settings are the web_http image's.
CONFIG_NETWORKING=y
CONFIG_NET_IPV4=y
CONFIG_NET_IPV6=n
CONFIG_NET_TCP=y
CONFIG_NET_SOCKETS=y
CONFIG_NET_DRIVERS=y
CONFIG_NET_SOCKETS_OFFLOAD=y
CONFIG_NET_NATIVE_OFFLOADED_SOCKETS=y
CONFIG_ETH_NATIVE_TAP=n
# Zephyr's own fnmatch, as on a target: see tests/native/web_http/prj.conf.
CONFIG_MINIMAL_LIBC=y
CONFIG_ZVFS_OPEN_MAX=16
CONFIG_ZVFS_POLL_MAX=16

CONFIG_CRUX_WEB=y
CONFIG_CRUX_WEB_PLAIN_HTTP_FOR_TESTS=y
CONFIG_CRUX_WEB_PORT=18189
# Shortened so that the measurements finish quickly. The largest asset that fits is this deadline times
# the declared client rate, 32768 bytes a second: 49,152 bytes, which the packager checks at build.
CONFIG_HTTP_SERVER_CLIENT_INACTIVITY_TIMEOUT=3
CONFIG_CRUX_WEB_REQUEST_DEADLINE_MS=2000
CONFIG_CRUX_WEB_SEND_TIMEOUT_MS=500
CONFIG_CRUX_WEB_RESPONSE_DEADLINE_MS=1500

CONFIG_NATIVE_SIM_SLOWDOWN_TO_REAL_TIME=y
CONFIG_HEAP_MEM_POOL_SIZE=16384
CONFIG_MAIN_STACK_SIZE=4096
CONFIG_LOG=n
```

## src/main.c
```c
/* Starts the adapter on plain HTTP over the native socket offload. There is no asset code here: the
 * folder named in CMakeLists.txt is all that this image says about its interface. test_driver.py is
 * the client. */
#include "crux_web_adapter.h"

#include <zephyr/kernel.h>

int main(void)
{
    static const crux_web_config_t config = {
        .authenticate = NULL,
        .request_deadline_ms = CONFIG_CRUX_WEB_REQUEST_DEADLINE_MS,
        .handler_limit_ms = 100u,
    };

    if (crux_web_start(&config) != CRUX_WEB_OK) {
        printk("CRUX_WEB_START_FAILED\n");
        return 1;
    }
    printk("CRUX_WEB_READY %d\n", CONFIG_CRUX_WEB_PORT);
    return 0;
}
```

## src/probe_route.c
```c
/* One probe, so that a test can make the server block part-way through a large asset: it shrinks
 * the send buffer of the connection that asks, as on a small target. Not for a product. */
#include "web_probe.h"

#include <crux/web.h>
#include <stdlib.h>

static crux_web_result_t on_send_buffer(crux_web_request_t *request, crux_access_session_t session,
                                        void *context)
{
    char value[16];

    (void)session;
    (void)context;
    if (crux_web_path_param(request, 0u, value, sizeof(value)) != CRUX_WEB_OK) {
        return crux_web_respond_error(request, 404, "not_found");
    }
    web_probe_set_next_send_buffer(atoi(value));
    return crux_web_respond(request, 200, NULL, "{}", 2u);
}

CRUX_WEB_ROUTE(send_buffer, "/probe/send-buffer/{bytes}", CRUX_WEB_GET, CRUX_WEB_PUBLIC,
               on_send_buffer, NULL);
```
