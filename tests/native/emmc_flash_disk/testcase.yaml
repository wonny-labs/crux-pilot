## tests/native/emmc_flash_disk/testcase.yaml
```yaml
common:
  platform_allow: [native_sim/native, native_sim/native/64]
  tags: [storage, crux]
  timeout: 180
tests:
  crux.emmc.flash_disk.cached: {}
  crux.emmc.flash_disk.nocache:
    extra_configs:
      - CONFIG_CRUX_EMMC_SIM_CACHE_KB=0
  crux.emmc.flash_disk.read_only:
    extra_configs:
      - CONFIG_CRUX_FLASH_DISK_READ_ONLY=y
  crux.emmc.flash_disk.flush_control:
    extra_configs:
      - CONFIG_CRUX_FLASH_DISK_FLUSH_CONTROL=y
```

## tests/native/emmc_flash_disk_init/testcase.yaml
```yaml
common:
  platform_allow: [native_sim/native, native_sim/native/64]
  tags: [storage, crux]
  timeout: 120
tests:
  crux.emmc.flash_disk.init_partition_beyond_disk: {}
```

## zephyr/boot/Kconfig
```kconfig
config CRUX_BOOT_FLEXSPI_CONFIG_IN_RAM
	bool "Move the FlexSPI configuration object to the XIP memory (candidate, #165)"
	depends on CRUX_PILOT_MODULE && MEMC_MCUX_FLEXSPI
	default n
	help
	  Candidate for issue #165. Not built, Not verified, not for merge. Experimental.

	  Zephyr's FlexSPI MEMC driver keeps the register and AHB base addresses in a const
	  object (memc_flexspi_config_<n>) that lives in the NOR Flash. The NOR driver's busy
	  poll reads it through the device record while the NOR may be busy, which is the
	  data-closure failure that docs/flash-xip-evidence.md records for the application and
	  docs/evidence/boot-update/stage6-layout-and-write-analysis.md records for MCUboot.

	  This symbol asks for that one object to be placed in the memory that already holds
	  the driver's code (CONFIG_FLASH_MCUX_FLEXSPI_XIP_MEM, ITCM on the RT1060-EVK), with
	  Zephyr's own code relocation. It is meant for the MCUboot image only, through
	  zephyr/boot/mcuboot-flexspi-config-in-ram.conf. It is meant to remove that one edge and
	  nothing else in the matrix (see docs/plans/mcuboot-flexspi-write-path-closure.md,
	  proposed in PR #491, not yet on main).

	  Kconfig hides the symbol without MEMC_MCUX_FLEXSPI, and the build refuses it without
	  CONFIG_FLASH, CONFIG_FLASH_MCUX_FLEXSPI_XIP and CONFIG_CODE_DATA_RELOCATION.
```

## zephyr/drivers/flash/Kconfig
```kconfig
# SPDX-License-Identifier: Apache-2.0

config CRUX_FLASH_DISK
	bool "Flash-API device over an MMC disk (prototype)"
	default n
	depends on CRUX_PILOT_MODULE && DT_HAS_CRUX_FLASH_DISK_ENABLED && DISK_ACCESS && DISK_DRIVER_MMC
	select FLASH_HAS_DRIVER_ENABLED
	select FLASH_HAS_PAGE_LAYOUT
	select FLASH_HAS_EXPLICIT_ERASE
	help
	  Expose a disk_access disk as flash_read, flash_write and flash_erase, so that MCUboot's
	  port can read and write image slots in the eMMC user area through the flash map. Off by
	  default. A prototype: see docs/boot-emmc-backend-prototype.md. It needs the MMC disk driver,
	  because the flush that makes a returned write durable is known to work only there, with
	  CONFIG_CRUX_MMC_CACHE_FLUSH=y (nothing checks that disk-name names the MMC disk): without it a disk sync does not flush the eMMC cache and the
	  order of the trailer writes is not kept.

if CRUX_FLASH_DISK

config CRUX_FLASH_DISK_READ_ONLY
	bool "Refuse write and erase"
	help
	  The device reads and refuses flash_write and flash_erase with -ENOTSUP, and needs no cache
	  flush. MCUboot's RAM load without revert is not read only at the pinned revision: it
	  scrambles a slot with an invalid image through erases whose result it ignores, so on this
	  device such a slot stays and is validated again on every boot.

config CRUX_FLASH_DISK_FLUSH_CONTROL
	bool "Test fixtures only: do not flush after write and erase"
	depends on BOARD_NATIVE_SIM && !CRUX_FLASH_DISK_READ_ONLY
	help
	  A deliberate defect for a control: a returned write or erase may still be held in the
	  device cache, which is what the flush prevents. It is a native_sim setting and cannot be
	  selected on a board.

config CRUX_FLASH_DISK_BUFFER_SECTORS
	int "Sectors in the bounce buffer"
	default 8
	range 1 128
	help
	  RAM used for transfers whose address or offset is not aligned for the disk layer, in
	  sectors of 512 bytes. Writes and erases move this many sectors in one command at most.

config CRUX_FLASH_DISK_DIRECT_SECTORS
	int "Sectors in one direct read"
	default 128
	range 1 4096
	help
	  A read whose offset and destination are aligned goes straight into the destination, in
	  commands of at most this many sectors, so that loading a whole image is not a copy
	  through the bounce buffer.

config CRUX_FLASH_DISK_INIT_PRIORITY
	int "Init priority"
	default 95
	help
	  After the disk driver (CONFIG_SD_INIT_PRIORITY), because init initialises the disk.

endif # CRUX_FLASH_DISK
```

## zephyr/dts/bindings/flash/crux,flash-disk.yaml
```yaml
# SPDX-License-Identifier: Apache-2.0

description: |
  A Zephyr flash-API device over a disk_access disk, such as the MMC disk of an eMMC, so that a
  flash map and MCUboot can read and write image slots in the user area. Give it a
  fixed-partitions child that holds the slots. It turns flash_read, flash_write and flash_erase
  into 512-byte sector transfers on the disk and flushes the device cache before a write or
  erase returns. A write block is one sector, and erase is emulated by writing 0xFF, so the
  device reports an erase value of 0xFF whatever an erased medium reads.

  This is a prototype. The slots must lie outside any file system on the same disk.

compatible: "crux,flash-disk"

include: base.yaml

properties:
  disk-name:
    type: string
    required: true
    description: |
      The disk_access name of the disk, for example the disk-name of the zephyr,mmc-disk node.

  write-block-size:
    type: int
    default: 512
    enum:
      - 512
    description: |
      Write alignment and size in bytes. Only one sector is supported: a smaller block would be a
      read-modify-write of a sector, which is not atomic and puts neighbouring data at risk.

  erase-block-size:
    type: int
    default: 4096
    description: |
      Page size in bytes: the alignment and size of an erase, and the page of the layout that the
      flash map reports. A multiple of the write block. A page of the size of a native sector of
      the device keeps every erase aligned to it. Every partition must start and end on a page.
```
