## tests/native/file_littlefs/testcase.yaml
```yaml
tests:
  crux.file.littlefs:
    platform_allow: [native_sim/native, native_sim/native/64]
    tags: [filesystem, crux]
    timeout: 180
```

## tests/native/file_sd_composition/testcase.yaml
```yaml
tests:
  crux.file.sd_composition:
    platform_allow: [native_sim/native, native_sim/native/64]
    tags: [filesystem, crux]
    timeout: 180
```

## tests/native/file_sd_settings_recover/testcase.yaml
```yaml
tests:
  crux.file.sd_settings_recover:
    platform_allow: [native_sim/native, native_sim/native/64]
    tags: [settings, filesystem, crux]
    timeout: 120
```

## tests/native/integrated_output/testcase.yaml
```yaml
common:
  platform_allow:
    - native_sim/native/64
  tags:
    - logging
  timeout: 20
  harness: console
  harness_config:
    type: one_line
    regex:
      - '^INTEGRATED_FIXTURE_COMPLETE emitted=[0-9]+ expected_loss=[01]$'
tests:
  crux.native.integrated_output: {}
  crux.native.integrated_output_loss:
    extra_args:
      - CRUX_TEST_LOSS=ON
```

## tests/native/logger_phase/testcase.yaml
```yaml
common:
  platform_allow:
    - native_sim/native/64
  tags:
    - logging
  timeout: 20
  harness: console
  harness_config:
    type: one_line
    regex:
      - '^PHASE_COMPLETE cycles=4 unshifted=[01]$'
tests:
  crux.native.logger_phase: {}
  crux.native.logger_phase_unshifted:
    extra_args:
      - CRUX_TEST_UNSHIFTED=ON
```

## tests/native/maintenance_storage/testcase.yaml
```yaml
tests:
  crux.storage.maintenance:
    platform_allow:
      - native_sim/native/64
    tags:
      - file
      - configuration
      - settings
      - nvs
    integration_platforms:
      - native_sim/native/64
```

## tests/native/mgmt_services/testcase.yaml
```yaml
tests:
  crux.mgmt_services:
    timeout: 60
    platform_allow:
      - native_sim/native/64
    integration_platforms:
      - native_sim/native/64
    tags:
      - configuration
      - system
```

## tests/native/network_output_burst/testcase.yaml
```yaml
common:
  platform_allow:
    - native_sim/native/64
  tags:
    - logging
  timeout: 10
  harness: console
  harness_config:
    type: one_line
    regex:
      - '^NETWORK_BURST_COMPLETE emitted=130 capacity=[0-9]+ queued_bytes=[0-9]+ usage_status=0$'
tests:
  crux.native.network_burst: {}
  crux.native.network_paced:
    extra_args:
      - CRUX_TEST_PACED=ON
  crux.native.network_burst_8k:
    extra_configs:
      - CONFIG_LOG_BUFFER_SIZE=8192
  crux.native.network_burst_16k:
    extra_configs:
      - CONFIG_LOG_BUFFER_SIZE=16384
```

## tests/native/nvs_capacity/testcase.yaml
```yaml
common:
  tags: [settings, nvs, experimental]
  platform_allow: [native_sim]
  timeout: 600
tests:
  crux.nvs_capacity.crc_off:
    extra_args: CONFIG_NVS_DATA_CRC=n
  crux.nvs_capacity.crc_on:
    extra_args: CONFIG_NVS_DATA_CRC=y
```

## tests/native/nvs_startup/testcase.yaml
```yaml
common:
  tags: [nvs, experimental]
  platform_allow: [native_sim]
tests:
  crux.nvs_startup.no_reinitialization:
    extra_args: CONFIG_NVS_INIT_BAD_MEMORY_REGION=n
  crux.nvs_startup.reinitialization:
    extra_args: CONFIG_NVS_INIT_BAD_MEMORY_REGION=y
```

## tests/native/rt1060_storage_integration/testcase.yaml
```yaml
tests:
  crux.storage.rt1060_integration:
    platform_allow: native_sim/native/64
    tags: storage
    integration_platforms:
      - native_sim/native/64
```

## tests/native/settings_readiness_gate/testcase.yaml
```yaml
tests:
  crux.configuration.settings_readiness_gate:
    platform_allow:
      - native_sim/native/64
    tags:
      - configuration
      - settings
      - nvs
    integration_platforms:
      - native_sim/native/64
```

## tests/native/settings_target_candidate/provider/testcase.yaml
```yaml
common:
  tags: [configuration, settings, nvs, experimental]
  platform_allow: [native_sim]
tests:
  crux.settings_target.provider: {}
```

## tests/native/settings_target_candidate/startup/testcase.yaml
```yaml
common:
  tags: [nvs, experimental]
  platform_allow: [native_sim]
tests:
  crux.settings_target.startup:
    extra_args: CONFIG_NVS_INIT_BAD_MEMORY_REGION=n
```

## tests/portable_execution/zephyr/testcase.yaml
```yaml
tests:
  crux.portable_execution:
    harness: ztest
    timeout: 30
    platform_allow: [native_sim/native/64]
    tags: [crux, execution, conformance]
```

## tests/psa_crypto/zephyr/testcase.yaml
```yaml
common:
  platform_allow: [native_sim/native/64]
  timeout: 300
tests:
  crux.psa_crypto.conformance.tf_psa_crypto:
    tags: [crypto, crux, psa-all, psa-tf-psa-crypto]
    extra_args: EXTRA_CONF_FILE=tf-psa-crypto.conf
  crux.psa_crypto.conformance.wolfpsa:
    tags: [crypto, crux, psa-all]
    extra_args: EXTRA_CONF_FILE=wolfpsa.conf
  crux.psa_crypto.conformance.wolfpsa_with_tls:
    tags: [crypto, crux, psa-all]
    extra_args: EXTRA_CONF_FILE="wolfpsa.conf;wolfpsa-with-tls.conf"
```

## tests/psa_entropy/zephyr/testcase.yaml
```yaml
common:
  platform_allow: [native_sim/native/64]
  timeout: 120
  tags: [crypto, crux, psa-entropy]
tests:
  crux.psa_entropy.fail_closed.healthy_read:
    extra_configs:
      - CONFIG_CRUX_FAIL_CLOSED_ENTROPY=y
  crux.psa_entropy.fail_closed.failing_read:
    extra_configs:
      - CONFIG_CRUX_FAIL_CLOSED_ENTROPY=y
      - CONFIG_CRUX_TEST_ENTROPY_FAILS=y
  crux.psa_entropy.upstream_fallback.failing_read:
    extra_configs:
      - CONFIG_CRUX_TEST_ENTROPY_FAILS=y
```

## tests/psa_ports/zephyr/testcase.yaml
```yaml
common:
  platform_allow: [native_sim/native/64]
  timeout: 300
tests:
  crux.psa_ports.tf_psa_crypto:
    tags: [crypto, crux, psa-ports, psa-ports-tf-psa-crypto]
    extra_args: EXTRA_CONF_FILE=../../psa_crypto/zephyr/tf-psa-crypto.conf
  crux.psa_ports.wolfpsa:
    tags: [crypto, crux, psa-ports, psa-ports-wolfpsa]
    extra_args: EXTRA_CONF_FILE=../../psa_crypto/zephyr/wolfpsa.conf
```

## tests/queue/zephyr/testcase.yaml
```yaml
tests:
  crux.queue:
    platform_allow:
      - native_sim/native/64
    tags:
      - queue
      - portable
```

## tests/serial/zephyr/testcase.yaml
```yaml
tests:
  crux.serial:
    platform_allow:
      - native_sim/native/64
    tags:
      - serial
      - portable
```

## tests/serial/zephyr_ownership/testcase.yaml
```yaml
tests:
  crux.serial_ownership:
    platform_allow:
      - native_sim/native/64
    tags:
      - serial
      - portable
```

## tests/service_priority/zephyr/testcase.yaml
```yaml
tests:
  crux.service_priority.defaults:
    platform_allow:
      - native_sim/native/64
    integration_platforms:
      - native_sim/native/64
    tags:
      - thread
    harness: ztest
  crux.service_priority.placed:
    platform_allow:
      - native_sim/native/64
    integration_platforms:
      - native_sim/native/64
    tags:
      - thread
    harness: ztest
    extra_args:
      - EXTRA_CONF_FILE=placed.conf
      - CRUX_TEST_PLACED=ON
```
