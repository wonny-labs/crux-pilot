/* SPDX-License-Identifier: Apache-2.0 */
/* The eMMC simulator, with the unmodified MMC stack on top, as a disk named like the composition's
 * default. The name must equal the default of SAMPLE_EMMC_DISK_NAME in the Kconfig of this test and
 * of samples/storage_emmc; a devicetree overlay cannot read a Kconfig value. */
/ {
    emmc_sim0: emmc_sim {
        compatible = "crux,emmc-sim";
        status = "okay";

        mmc {
            compatible = "zephyr,mmc-disk";
            disk-name = "MMC";
            bus-width = <4>;
            status = "okay";
        };
    };
};
