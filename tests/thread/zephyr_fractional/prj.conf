## CMakeLists.txt
```
cmake_minimum_required(VERSION 3.20.0)
find_package(Zephyr REQUIRED HINTS $ENV{ZEPHYR_BASE})
project(crux_typed_fractional_sleep_tests LANGUAGES C)
target_sources(app PRIVATE src/main.c)
target_link_libraries(app PRIVATE crux::time crux::thread)
target_compile_options(app PRIVATE -Wall -Wextra -Werror)
include(../../../cmake/CruxConsumerBoundary.cmake)
crux_assert_portable_usage(crux::time crux::thread)
```

## prj.conf
```kconfig
CONFIG_STD_C17=y
CONFIG_ZTEST=y
CONFIG_TEST_EXTRA_STACK_SIZE=2048
CONFIG_MAIN_STACK_SIZE=4096
CONFIG_TIMEOUT_64BIT=y
CONFIG_SYS_CLOCK_TICKS_PER_SEC=128
CONFIG_LOG=n
CONFIG_CRUX_THREAD=y
CONFIG_RTC=n
CONFIG_IRQ_OFFLOAD=y
```

## src/main.c
```c
#include <crux/thread.h>
#include <crux/time.h>
#include <zephyr/irq_offload.h>
#include <zephyr/kernel.h>
#include <zephyr/ztest.h>

ZTEST(typed_fractional_sleep, test_observations_and_validation)
{
    crux_monotonic_time_t now = {0}, later = {0};
    zassert_equal(crux_monotonic_now(NULL), CRUX_ERR_INVALID_ARGUMENT);
    zassert_equal(crux_monotonic_now(&now), CRUX_OK);
    zassert_true(now.private_ns >= 0);
    zassert_equal(crux_monotonic_now(&later), CRUX_OK);
    zassert_true(crux_monotonic_is_at_or_before(now, later));
    zassert_equal(crux_thread_sleep_until((crux_monotonic_time_t){-1}), CRUX_ERR_INVALID_ARGUMENT);
    zassert_equal(crux_thread_sleep_until((crux_monotonic_time_t){0}), CRUX_OK);
    zassert_equal(crux_thread_sleep_until(later), CRUX_OK);
}

ZTEST(typed_fractional_sleep, test_exact_and_fractional_tick_deadlines)
{
    BUILD_ASSERT(CONFIG_SYS_CLOCK_TICKS_PER_SEC == 128);
    crux_monotonic_time_t now;
    zassert_equal(crux_monotonic_now(&now), CRUX_OK);
    /* 125 ms is exactly 16 ticks; 126 ms must reach the next tick (17). */
    int64_t epoch = now.private_ns / INT64_C(125000000) + 1;
    crux_monotonic_time_t deadline = {epoch * INT64_C(125000000)};
    zassert_equal(crux_thread_sleep_until(deadline), CRUX_OK);
    zassert_true(k_uptime_ticks() >= epoch * 16);
    zassert_equal(
        crux_thread_sleep_until((crux_monotonic_time_t){deadline.private_ns + INT64_C(1000000)}),
        CRUX_OK);
    zassert_true(k_uptime_ticks() >= epoch * 16 + 1);
    crux_monotonic_time_t after;
    zassert_equal(crux_monotonic_now(&after), CRUX_OK);
    zassert_true(after.private_ns >= deadline.private_ns + INT64_C(1000000));
}

static crux_status_t isr_now_status, isr_sleep_status;
static crux_monotonic_time_t isr_output;
static void isr_probe(const void *unused)
{
    (void)unused;
    isr_output = (crux_monotonic_time_t){73};
    isr_now_status = crux_monotonic_now(&isr_output);
    isr_sleep_status = crux_thread_sleep_until((crux_monotonic_time_t){0});
}
ZTEST(typed_fractional_sleep, test_isr_rejection)
{
    irq_offload(isr_probe, NULL);
    zassert_equal(isr_now_status, CRUX_ERR_NOT_SUPPORTED);
    zassert_equal(isr_output.private_ns, 73);
    zassert_equal(isr_sleep_status, CRUX_ERR_NOT_SUPPORTED);
}
ZTEST_SUITE(typed_fractional_sleep, NULL, NULL, NULL, NULL, NULL);
```
