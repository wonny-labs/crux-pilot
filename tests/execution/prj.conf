## CMakeLists.txt
```
cmake_minimum_required(VERSION 3.20.0)
find_package(Zephyr REQUIRED HINTS $ENV{ZEPHYR_BASE})
project(crux_execution_probes LANGUAGES C)
if(CONFIG_POSIX_THREADS)
    target_sources(app PRIVATE src/posix.c)
else()
    target_sources(app PRIVATE src/native.c)
endif()
target_compile_options(app PRIVATE -Wall -Wextra -Werror)
```

## prj.conf
```kconfig
CONFIG_STD_C17=y
CONFIG_ZTEST=y
CONFIG_INIT_STACKS=y
CONFIG_THREAD_STACK_INFO=y
CONFIG_MAIN_STACK_SIZE=4096
CONFIG_TEST_EXTRA_STACK_SIZE=4096
CONFIG_LOG=n
```

## posix.conf
```kconfig
CONFIG_POSIX_SYSTEM_INTERFACES=y
CONFIG_DYNAMIC_THREAD=y
CONFIG_DYNAMIC_THREAD_POOL_SIZE=8
CONFIG_DYNAMIC_THREAD_STACK_SIZE=4096
CONFIG_POSIX_MONOTONIC_CLOCK=y
CONFIG_POSIX_THREADS=y
CONFIG_POSIX_THREAD_PRIORITY_SCHEDULING=y
CONFIG_POSIX_THREAD_ATTR_STACKSIZE=y
CONFIG_POSIX_SEMAPHORES=y
CONFIG_POSIX_TIMERS=y
CONFIG_POSIX_CLOCK_SELECTION=y
CONFIG_POSIX_MESSAGE_PASSING=y
CONFIG_HEAP_MEM_POOL_SIZE=32768
CONFIG_POSIX_REALTIME_SIGNALS=y
```

## src/native.c
```c
#include <errno.h>
#include <stdint.h>
#include <zephyr/kernel.h>
#include <zephyr/ztest.h>

K_THREAD_STACK_DEFINE(worker_stack, 4096);
static struct k_thread worker;
K_MUTEX_DEFINE(mutex);
K_SEM_DEFINE(signal, 0, 1);
K_SEM_DEFINE(entered, 0, 1);
K_MSGQ_DEFINE(messages, sizeof(uint32_t), 1, 4);
static int worker_result;

static void semaphore_worker(void *a, void *b, void *c)
{
    ARG_UNUSED(a);
    ARG_UNUSED(b);
    ARG_UNUSED(c);
    k_msleep(20);
    k_sem_give(&signal);
}

static void mutex_worker(void *a, void *b, void *c)
{
    ARG_UNUSED(a);
    ARG_UNUSED(b);
    ARG_UNUSED(c);
    k_sem_give(&entered);
    worker_result = k_mutex_lock(&mutex, K_MSEC(20));
    if (worker_result == 0) {
        (void)k_mutex_unlock(&mutex);
    }
}

static void periodic_worker(void *a, void *b, void *c)
{
    ARG_UNUSED(a);
    ARG_UNUSED(b);
    ARG_UNUSED(c);
    int64_t start = k_uptime_get();
    int64_t next = start + 10;
    unsigned int skipped = 0;
    for (int i = 0; i < 6; ++i) {
        (void)k_sleep(K_TIMEOUT_ABS_MS(next));
        int64_t released = k_uptime_get();
        zassert_true(released >= next, "release before deadline");
        printk("PROBE native cycle=%d lateness_ms=%lld\n", i, (long long)(released - next));
        if (i == 1) {
            k_msleep(25);
        }
        next += 10;
        int64_t now = k_uptime_get();
        while (next <= now) {
            next += 10;
            ++skipped;
        }
    }
    zassert_true(skipped >= 2, "deliberate overrun must skip elapsed releases");
    printk("PROBE native periodic elapsed_ms=%lld skipped=%u priority=%d stack_bytes=%zu\n",
           (long long)(k_uptime_get() - start), skipped, k_thread_priority_get(k_current_get()),
           sizeof(worker_stack));
}

static k_tid_t start_worker(k_thread_entry_t entry)
{
    return k_thread_create(&worker, worker_stack, K_THREAD_STACK_SIZEOF(worker_stack), entry, NULL,
                           NULL, NULL, 5, 0, K_NO_WAIT);
}

ZTEST(execution_native, test_lifecycle_periodic_and_stack)
{
    k_tid_t tid = start_worker(periodic_worker);
    zassert_equal(k_thread_join(tid, K_SECONDS(2)), 0);
    size_t unused = 0;
    zassert_equal(k_thread_stack_space_get(tid, &unused), 0);
    printk("PROBE native stack_unused_bytes=%zu\n", unused);
    zassert_true(unused > 0);
    tid = start_worker(semaphore_worker);
    zassert_equal(k_thread_join(tid, K_SECONDS(2)), 0);
    zassert_equal(k_sem_take(&signal, K_NO_WAIT), 0);
}

ZTEST(execution_native, test_mutex_contention_timeout_and_recovery)
{
    int original_priority = k_thread_priority_get(k_current_get());
    k_thread_priority_set(k_current_get(), 7);
    zassert_equal(k_mutex_lock(&mutex, K_NO_WAIT), 0);
    k_tid_t tid = start_worker(mutex_worker);
    zassert_equal(k_sem_take(&entered, K_SECONDS(1)), 0);
    zassert_equal(k_thread_priority_get(k_current_get()), 5);
    zassert_equal(k_thread_join(tid, K_SECONDS(2)), 0);
    zassert_equal(worker_result, -EAGAIN);
    zassert_equal(k_mutex_unlock(&mutex), 0);
    tid = start_worker(mutex_worker);
    zassert_equal(k_thread_join(tid, K_SECONDS(2)), 0);
    zassert_equal(worker_result, 0);
    k_sem_reset(&entered);
    k_thread_priority_set(k_current_get(), original_priority);
}

ZTEST(execution_native, test_semaphore_expiry_wakeup_and_capacity)
{
    k_sem_reset(&signal);
    zassert_equal(k_sem_take(&signal, K_NO_WAIT), -EBUSY);
    int64_t start = k_uptime_get();
    zassert_equal(k_sem_take(&signal, K_MSEC(10)), -EAGAIN);
    zassert_true(k_uptime_get() - start >= 10);
    start = k_uptime_get();
    k_tid_t tid = start_worker(semaphore_worker);
    zassert_equal(k_sem_take(&signal, K_SECONDS(1)), 0);
    zassert_true(k_uptime_get() - start >= 20);
    zassert_equal(k_thread_join(tid, K_SECONDS(1)), 0);
    k_sem_give(&signal);
    k_sem_give(&signal);
    zassert_equal(k_sem_count_get(&signal), 1);
    zassert_equal(k_sem_take(&signal, K_NO_WAIT), 0);
}

ZTEST(execution_native, test_bounded_messages)
{
    uint32_t sent = 42;
    uint32_t received = 0;
    zassert_equal(k_msgq_get(&messages, &received, K_NO_WAIT), -ENOMSG);
    zassert_equal(k_msgq_put(&messages, &sent, K_NO_WAIT), 0);
    zassert_equal(k_msgq_put(&messages, &sent, K_NO_WAIT), -ENOMSG);
    zassert_equal(k_msgq_get(&messages, &received, K_NO_WAIT), 0);
    zassert_equal(received, sent);
    zassert_equal(k_msgq_get(&messages, &received, K_MSEC(10)), -EAGAIN);
}

ZTEST_SUITE(execution_native, NULL, NULL, NULL, NULL, NULL);
```

## src/posix.c
```c
#include <errno.h>
#include <fcntl.h>
#include <mqueue.h>
#include <pthread.h>
#include <sched.h>
#include <semaphore.h>
#include <stdint.h>
#include <stdio.h>
#include <time.h>
#ifdef __ZEPHYR__
#include <zephyr/ztest.h>
#define CHECK(value) zassert_true(value, "%s", #value)
#else
#include <assert.h>
#define CHECK(value) assert(value)
#endif

static sem_t wake_signal;
static pthread_mutex_t mutex;
static int worker_result;

static struct timespec realtime_after_ms(long ms)
{
    struct timespec deadline;
    CHECK(clock_gettime(CLOCK_REALTIME, &deadline) == 0);
    deadline.tv_nsec += ms * 1000000L;
    deadline.tv_sec += deadline.tv_nsec / 1000000000L;
    deadline.tv_nsec %= 1000000000L;
    return deadline;
}

static int64_t monotonic_ms(void)
{
    struct timespec now;
    CHECK(clock_gettime(CLOCK_MONOTONIC, &now) == 0);
    return (int64_t)now.tv_sec * 1000 + now.tv_nsec / 1000000;
}

static void *notify_worker(void *arg)
{
    int policy;
    struct sched_param parameters;
    CHECK(pthread_getschedparam(pthread_self(), &policy, &parameters) == 0);
    printf("PROBE posix worker_policy=%d priority=%d\n", policy, parameters.sched_priority);
    struct timespec delay = {.tv_nsec = 20000000L};
    CHECK(nanosleep(&delay, NULL) == 0);
#ifdef __ZEPHYR__
    size_t unused = 0;
    CHECK(k_thread_stack_space_get(k_current_get(), &unused) == 0);
    CHECK(unused > 0);
    printf("PROBE posix stack_unused_bytes=%zu\n", unused);
#endif
    CHECK(sem_post(&wake_signal) == 0);
    return arg;
}

static void *mutex_worker(void *arg)
{
    (void)arg;
    struct timespec deadline = realtime_after_ms(20);
    worker_result = pthread_mutex_timedlock(&mutex, &deadline);
    if (worker_result == 0) {
        CHECK(pthread_mutex_unlock(&mutex) == 0);
    }
    return NULL;
}

static void test_lifecycle_and_attributes(void)
{
    pthread_attr_t attr;
    CHECK(pthread_attr_init(&attr) == 0);
    size_t stack = 0;
    CHECK(pthread_attr_getstacksize(&attr, &stack) == 0);
    CHECK(pthread_attr_setstacksize(&attr, 0) == EINVAL);
    int policy;
    struct sched_param parameters;
    CHECK(pthread_attr_getschedpolicy(&attr, &policy) == 0);
    CHECK(pthread_attr_getschedparam(&attr, &parameters) == 0);
    printf("PROBE posix default_stack=%zu policy=%d priority=%d\n", stack, policy,
           parameters.sched_priority);
    CHECK(pthread_attr_destroy(&attr) == 0);
    CHECK(sem_init(&wake_signal, 0, 0) == 0);
    for (int i = 0; i < 2; ++i) {
        pthread_t thread;
        void *result = NULL;
        CHECK(pthread_create(&thread, NULL, notify_worker, &wake_signal) == 0);
        CHECK(sem_wait(&wake_signal) == 0);
        CHECK(pthread_join(thread, &result) == 0);
        CHECK(result == &wake_signal);
    }
    CHECK(sem_destroy(&wake_signal) == 0);
#ifdef __ZEPHYR__
    pthread_attr_t held[16];
    int count = 0;
    int allocation_result = 0;
    for (; count < 16; ++count) {
        allocation_result = pthread_attr_init(&held[count]);
        CHECK(allocation_result == 0);
        size_t allocated_size = 0;
        allocation_result = pthread_attr_getstacksize(&held[count], &allocated_size);
        if (allocation_result != 0) {
            break;
        }
    }
    CHECK(count > 0 && count < 16);
    /* This pin reports init success even if no stack could be allocated. */
    CHECK(allocation_result == EINVAL);
    printf("PROBE posix allocated_stack_slots=%d exhaustion=%d\n", count, allocation_result);
    for (int i = 0; i < count; ++i) {
        CHECK(pthread_attr_destroy(&held[i]) == 0);
    }
    CHECK(pthread_attr_init(&attr) == 0);
    CHECK(pthread_attr_getstacksize(&attr, &stack) == 0);
    CHECK(stack == CONFIG_DYNAMIC_THREAD_STACK_SIZE);
    CHECK(pthread_attr_destroy(&attr) == 0);
#endif
}

static void test_mutex_contention(void)
{
    pthread_mutexattr_t attr;
    CHECK(pthread_mutexattr_init(&attr) == 0);
#ifdef __ZEPHYR__
    /* Pinned Zephyr rejects the POSIX protocol attribute; do not claim conformance. */
    CHECK(pthread_mutexattr_setprotocol(&attr, PTHREAD_PRIO_INHERIT) == ENOTSUP);
#else
    CHECK(pthread_mutexattr_setprotocol(&attr, PTHREAD_PRIO_INHERIT) == 0);
#endif
    CHECK(pthread_mutex_init(&mutex, &attr) == 0);
    CHECK(pthread_mutexattr_destroy(&attr) == 0);
    CHECK(pthread_mutex_lock(&mutex) == 0);
    pthread_t thread;
    CHECK(pthread_create(&thread, NULL, mutex_worker, NULL) == 0);
    CHECK(pthread_join(thread, NULL) == 0);
    CHECK(worker_result == ETIMEDOUT);
    CHECK(pthread_mutex_unlock(&mutex) == 0);
    CHECK(pthread_create(&thread, NULL, mutex_worker, NULL) == 0);
    CHECK(pthread_join(thread, NULL) == 0);
    CHECK(worker_result == 0);
    CHECK(pthread_mutex_destroy(&mutex) == 0);
}

static void test_semaphore_timeout(void)
{
    CHECK(sem_init(&wake_signal, 0, 0) == 0);
    errno = 0;
    CHECK(sem_trywait(&wake_signal) == -1 && errno == EAGAIN);
    struct timespec deadline = realtime_after_ms(10);
    int64_t start = monotonic_ms();
    CHECK(sem_timedwait(&wake_signal, &deadline) == -1 && errno == ETIMEDOUT);
    CHECK(monotonic_ms() - start >= 9);
    pthread_t thread;
    start = monotonic_ms();
    CHECK(pthread_create(&thread, NULL, notify_worker, NULL) == 0);
    deadline = realtime_after_ms(1000);
    CHECK(sem_timedwait(&wake_signal, &deadline) == 0);
    CHECK(monotonic_ms() - start >= 19);
    CHECK(pthread_join(thread, NULL) == 0);
    CHECK(sem_destroy(&wake_signal) == 0);
}

static void test_messages(void)
{
    const char *name = "/crux_m2_probe";
    struct mq_attr attr = {.mq_maxmsg = 1, .mq_msgsize = sizeof(uint32_t)};
    mqd_t queue = mq_open(name, O_CREAT | O_EXCL | O_RDWR | O_NONBLOCK, 0600, &attr);
    CHECK(queue != (mqd_t)-1);
    uint32_t sent = 42;
    uint32_t received = 0;
    CHECK(mq_receive(queue, (char *)&received, sizeof(received), NULL) == -1 && errno == EAGAIN);
    CHECK(mq_send(queue, (const char *)&sent, sizeof(sent), 0) == 0);
    CHECK(mq_send(queue, (const char *)&sent, sizeof(sent), 0) == -1 && errno == EAGAIN);
    CHECK(mq_receive(queue, (char *)&received, sizeof(received), NULL) == sizeof(received));
    CHECK(received == sent);
    CHECK(mq_close(queue) == 0);
    CHECK(mq_unlink(name) == 0);
}

static void test_periodic_monotonic(void)
{
    int64_t start = monotonic_ms();
    int64_t next = start + 10;
    unsigned int skipped = 0;
    for (int i = 0; i < 6; ++i) {
        struct timespec deadline = {.tv_sec = next / 1000, .tv_nsec = (next % 1000) * 1000000};
        CHECK(clock_nanosleep(CLOCK_MONOTONIC, TIMER_ABSTIME, &deadline, NULL) == 0);
        int64_t released = monotonic_ms();
        CHECK(released >= next);
        printf("PROBE posix cycle=%d lateness_ms=%lld\n", i, (long long)(released - next));
        if (i == 1) {
            struct timespec work = {.tv_nsec = 25000000L};
            CHECK(nanosleep(&work, NULL) == 0);
        }
        next += 10;
        int64_t now = monotonic_ms();
        while (next <= now) {
            next += 10;
            ++skipped;
        }
    }
    CHECK(skipped >= 2);
    printf("PROBE posix periodic elapsed_ms=%lld skipped=%u\n", (long long)(monotonic_ms() - start),
           skipped);
}

#ifdef __ZEPHYR__
ZTEST(execution_posix, test_lifecycle)
{
    test_lifecycle_and_attributes();
}
ZTEST(execution_posix, test_mutex)
{
    test_mutex_contention();
}
ZTEST(execution_posix, test_semaphore)
{
    test_semaphore_timeout();
}
ZTEST(execution_posix, test_message_exchange)
{
    test_messages();
}
ZTEST(execution_posix, test_periodic)
{
    test_periodic_monotonic();
}
ZTEST_SUITE(execution_posix, NULL, NULL, NULL, NULL, NULL);
#else
int main(void)
{
    test_lifecycle_and_attributes();
    test_mutex_contention();
    test_semaphore_timeout();
    test_messages();
    test_periodic_monotonic();
    puts("POSIX probes: 5 passed");
    return 0;
}
#endif
```
