/* Crux SPI peripheral 0 is a generic peripheral on the board's Arduino header SPI bus. The node
 * exists only so that the provider has a chip select and clock limit to build against; no part
 * is assumed to be fitted. */
/ {
	aliases { crux-spi0 = &crux_spi_peripheral; };
};

&arduino_spi {
	status = "okay";
	crux_spi_peripheral: peripheral@0 {
		compatible = "vnd,crux-spi-peripheral";
		reg = <0>;
		spi-max-frequency = <1000000>;
		status = "okay";
	};
};
