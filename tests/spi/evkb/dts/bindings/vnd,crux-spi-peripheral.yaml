## tests/spi/evkb/dts/bindings/vnd,crux-spi-peripheral.yaml
```yaml
description: Generic SPI peripheral used by the Crux SPI board cross-build
compatible: "vnd,crux-spi-peripheral"
include: spi-device.yaml
```

## tests/spi_consumer_zephyr/testcase.yaml
```yaml
tests:
  crux.spi.flash_id.native_sim:
    tags:
      - crux
      - spi
    platform_allow:
      - native_sim
```

## tests/spi_zephyr/dts/bindings/crux,spi-test-emulator.yaml
```yaml
description: Crux SPI provider software test target
compatible: "crux,spi-test-emulator"
include: spi-device.yaml
```

## tests/spi_zephyr/dts/bindings/vnd,crux-spi-test-emulator.yaml
```yaml
description: Crux SPI provider software test target
compatible: "vnd,crux-spi-test-emulator"
include: spi-device.yaml
```

## tests/spi_zephyr/testcase.yaml
```yaml
tests:
  crux.spi.native_sim:
    tags:
      - crux
      - spi
    platform_allow:
      - native_sim
```

## tests/spike_logging_103/native_sim/testcase.yaml
```yaml
tests:
  crux.spike103.native_uart_fs:
    platform_allow:
      - native_sim/native/64
    tags:
      - logging
      - spike
    timeout: 90
```

## tests/spike_logging_103/udp_sim/testcase.yaml
```yaml
tests:
  crux.spike103.native_uart_udp:
    platform_allow: [native_sim/native/64]
    tags: [logging, networking, spike]
    timeout: 90
```

## tests/support/emmc_sim/Kconfig
```kconfig
# SPDX-License-Identifier: Apache-2.0

config CRUX_EMMC_SIM
	bool "Test-only eMMC simulator"
	default y
	depends on DT_HAS_CRUX_EMMC_SIM_ENABLED && BOARD_NATIVE_SIM
	select SDHC_SUPPORTS_NATIVE_MODE
	help
	  An SD host driver for native_sim that behaves as an eMMC device, so that the unmodified MMC
	  stack runs without hardware. It is a model and cannot be selected on a target.

if CRUX_EMMC_SIM

config CRUX_EMMC_SIM_CACHE_KB
	int "Volatile cache size in KiB, zero for no cache"
	default 64
	help
	  The size that EXT_CSD reports. A held write stays held until a flush, however much is held.
	  --emmc-cache-kb overrides this value at run time.

config CRUX_EMMC_SIM_SECTORS
	int "Capacity in 512-byte sectors"
	default 8192

# The value the RT1060 selections use, so that the stack's bounce path runs here too.
configdefault SDHC_BUFFER_ALIGNMENT
	default 32

endif # CRUX_EMMC_SIM
```

## tests/support/emmc_sim/dts/bindings/crux,emmc-sim.yaml
```yaml
# SPDX-License-Identifier: Apache-2.0

description: |
  Test-only eMMC simulator on native_sim, an SD host controller with one eMMC device behind it. Give
  it a zephyr,mmc-disk child. It is a model written from the needs of the Zephyr MMC stack and is
  not evidence about a device.

compatible: "crux,emmc-sim"

include: sdhc.yaml
```

## tests/sync/zephyr/testcase.yaml
```yaml
tests:
  crux.sync.priority:
    platform_allow:
      - native_sim/native/64
    integration_platforms:
      - native_sim/native/64
    tags:
      - sync
    harness: ztest
  crux.sync.priority.all_mutex_slots:
    platform_allow:
      - native_sim/native/64
    integration_platforms:
      - native_sim/native/64
    tags:
      - sync
    harness: ztest
    extra_configs:
      - CONFIG_CRUX_SYNC_MUTEX_COUNT=64
```

## tests/system/zephyr/testcase.yaml
```yaml
tests:
  crux.system:
    timeout: 20
    platform_allow:
      - native_sim/native/64
    tags:
      - system
      - portable
```

## tests/system_consumer/zephyr/testcase.yaml
```yaml
tests:
  crux.system.consumer:
    platform_allow:
      - native_sim/native/64
    tags:
      - system
      - portable
    harness: console
    harness_config:
      type: one_line
      regex:
        - "System C17/C\\+\\+17 native observations retained; no lifecycle effects"
```

## tests/thread/zephyr/testcase.yaml
```yaml
tests:
  crux.time.typed_clock_sleep:
    platform_allow:
      - native_sim/native/64
    integration_platforms:
      - native_sim/native/64
    tags:
      - time
      - thread
    harness: ztest
```

## tests/thread/zephyr_fractional/testcase.yaml
```yaml
tests:
  crux.thread.typed_fractional:
    harness: ztest
    timeout: 20
    platform_allow: [native_sim/native/64]
    tags: [crux, time, thread]
```

## tests/thread_sync_consumer/zephyr/testcase.yaml
```yaml
tests:
  crux.component.thread_only:
    harness: console
    harness_config:
      type: one_line
      regex: ['COMPONENT_CONSUMER_PASS']
    extra_args: EXTRA_CONF_FILE=thread.conf
    platform_allow: [native_sim/native/64]
    timeout: 15
    tags: [crux, thread]
  crux.component.sync_only:
    harness: console
    harness_config:
      type: one_line
      regex: ['COMPONENT_CONSUMER_PASS']
    extra_args: EXTRA_CONF_FILE=sync.conf
    platform_allow: [native_sim/native/64]
    timeout: 15
    tags: [crux, sync]
```

## tests/time/busy_wait/zephyr/testcase.yaml
```yaml
tests:
  crux.time.busy_wait.native_profile:
    harness: ztest
    platform_allow:
      - native_sim/native/64
    integration_platforms:
      - native_sim/native/64
    tags:
      - crux
      - time
  crux.time.busy_wait.disabled:
    harness: ztest
    platform_allow:
      - native_sim/native/64
    integration_platforms:
      - native_sim/native/64
    extra_configs:
      - CONFIG_CRUX_TIME_BUSY_WAIT=n
    tags:
      - crux
      - time
```

## tests/time/zephyr/testcase.yaml
```yaml
tests:
  crux.time.zephyr_fake_rtc:
    harness: ztest
    platform_allow:
      - native_sim/native/64
    integration_platforms:
      - native_sim/native/64
    extra_args:
      - CRUX_TIME_FAKE_RTC=ON
      - EXTRA_CONF_FILE=fake_rtc.conf
    tags:
      - crux
      - time
      - rtc
  crux.time.zephyr:
    harness: ztest
    platform_allow:
      - native_sim/native/64
    integration_platforms:
      - native_sim/native/64
    tags:
      - crux
      - time
      - rtc
  crux.time.zephyr_missing_rtc:
    harness: ztest
    platform_allow:
      - native_sim/native/64
    integration_platforms:
      - native_sim/native/64
    extra_args:
      - DTC_OVERLAY_FILE=boards/native_sim_no_rtc.overlay
    tags:
      - crux
      - time
      - rtc
```

## tests/zephyr/cli_serial_compile/testcase.yaml
```yaml
tests:
  crux.cli.serial_compile:
    build_only: true
    platform_allow:
      - native_sim/native/64
      - mimxrt1060_evk@B/mimxrt1062/qspi
    tags: [cli, crux, compile_only]
```

## tests/zephyr/file_fatfs_compile/testcase.yaml
```yaml
tests:
  crux.file.fatfs_rt1060_compile:
    build_only: true
    platform_allow: [mimxrt1060_evk@B/mimxrt1062/qspi]
    tags: [filesystem, crux, compile_only]
```

## tests/zephyr_time/testcase.yaml
```yaml
tests:
  crux.time.zephyr:
    harness: ztest
    platform_allow:
      - native_sim/native/64
    integration_platforms:
      - native_sim/native/64
    tags:
      - crux
      - time
      - rtc
  crux.time.zephyr_missing_rtc:
    harness: ztest
    platform_allow:
      - native_sim/native/64
    integration_platforms:
      - native_sim/native/64
    extra_args:
      - DTC_OVERLAY_FILE=boards/native_sim_no_rtc.overlay
    tags:
      - crux
      - time
      - rtc
```
